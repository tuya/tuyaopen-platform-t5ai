## t5_os/bk_idk/middleware/soc/Kconfig
```kconfig
menu "SOC_CONFIG"

	choice SOC
		prompt "ARMINO SoC"
		default SOC_BK7231N if "$ARMINO_SOC" = "bk7231n"
		default SOC_BK7236 if "$ARMINO_SOC" = "bk7236"
		default SOC_BK7236_CP1 if "$ARMINO_SOC" = "bk7236_cp1"
		default SOC_BK723L if "$ARMINO_SOC" = "bk723L"
		default SOC_BK7234 if "$ARMINO_SOC" = "bk7234"
		default SOC_BK7239 if "$ARMINO_SOC" = "bk7239"
		default SOC_BK7239_CP1 if "$ARMINO_SOC" = "bk7239_cp1"
		default SOC_BK7286 if "$ARMINO_SOC" = "bk7286"
		default SOC_BK7286_CP1 if "$ARMINO_SOC" = "bk7286_cp1"
		default SOC_BK7258 if "$ARMINO_SOC" = "bk7258"
		default SOC_BK7258_CP1 if "$ARMINO_SOC" = "bk7258_cp1"
		default SOC_BK7258_CP2 if "$ARMINO_SOC" = "bk7258_cp2"
		default SOC_BK7256 if "$ARMINO_SOC" = "bk7256"
		default SOC_BK7256_CP1 if "$ARMINO_SOC" = "bk7256_cp1"
		default SOC_BK7235 if "$ARMINO_SOC" = "bk7235"
		default SOC_BK7235_CP1 if "$ARMINO_SOC" = "bk7235_cp1"
		default SOC_BK7235 if "$ARMINO_SOC" = "bk7235a"
		default SOC_BK7235 if "$ARMINO_SOC" = "bk7235b"
		default SOC_BK7235M if "$ARMINO_SOC" = "bk7235m"

		config SOC_BK7231N
			bool "BK7231N"
		config SOC_BK7236
			bool "BK7236"
		config SOC_BK7234
			bool "BK7234"
		config SOC_BK7236_CP1
			bool "BK7236_CP1"
		config SOC_BK723L
			bool "BK723L"
		config SOC_BK7239
			bool "BK7239"
		config SOC_BK7239_CP1
			bool "BK7239_CP1"
		config SOC_BK7286
			bool "BK7286"
		config SOC_BK7286_CP1
			bool "BK7286_CP1"
		config SOC_BK7258
			bool "BK7258"
		config SOC_BK7258_CP1
			bool "BK7258_CP1"
		config SOC_BK7258_CP2
			bool "BK7258_CP2"
		config SOC_BK7256
			bool "BK7256"
		config SOC_BK7256_CP1
			bool "BK7256_CP1"
		config SOC_BK7235
			bool "BK7235"
		config SOC_BK7235_CP1
			bool "BK7235_CP1"
		config SOC_BK7235M
			bool "BK7235M"
	endchoice

	choice System
		prompt "System"
		default SYS_CPU1 if "$ARMINO_SOC" = "bk7234_cp1"
		default SYS_CPU1 if "$ARMINO_SOC" = "bk7235_cp1"
		default SYS_CPU1 if "$ARMINO_SOC" = "bk7236_cp1"
		default SYS_CPU1 if "$ARMINO_SOC" = "bk723L_cp1"
		default SYS_CPU1 if "$ARMINO_SOC" = "bk7239_cp1"
		default SYS_CPU1 if "$ARMINO_SOC" = "bk7286_cp1"
		default SYS_CPU1 if "$ARMINO_SOC" = "bk7258_cp1"
		default SYS_CPU2 if "$ARMINO_SOC" = "bk7258_cp2"
		default SYS_CPU1 if "$ARMINO_SOC" = "bk7256_cp1"
		default SYS_CPU0

		config SYS_CPU0
			bool "CPU0 system"

		config SYS_CPU1
			bool "CPU1 system"

		config SYS_CPU2
			bool "CPU2 system"
	endchoice

	config CPU_CNT
			int "System CPU count: 1: single core, 2: dual core, etc."
			default 1

	config SYS_CPU1_OFFSET
		depends on SYS_CPU0
		hex "Set cpu1 core offset"
		default 0x2e0000
		help
			Cpu1 core offset address default 0x2e0000

	config SOC_STR
		string "SoC string"
		default "bk7231n" if SOC_BK7231N
		default "bk7236"  if SOC_BK7236
		default "bk7236_cp1"  if SOC_BK7236_CP1
		default "bk723L"  if SOC_BK723L
		default "bk7234"  if SOC_BK7234
		default "bk7239"  if SOC_BK7239
		default "bk7239_cp1"  if SOC_BK7239_CP1
		default "bk7286"  if SOC_BK7286
		default "bk7286_cp1"  if SOC_BK7286_CP1
		default "bk7258"  if SOC_BK7258
		default "bk7258_cp1"  if SOC_BK7258_CP1
		default "bk7258_cp2"  if SOC_BK7258_CP2
		default "bk7256"  if SOC_BK7256
		default "bk7256_cp1"  if SOC_BK7256_CP1
		default "bk7235"  if SOC_BK7235
		default "bk7235_cp1"  if SOC_BK7235_CP1
		default "bk7235m"  if SOC_BK7235M
		default "$ARMINO_SOC"

	config SOC_ARCH
		string "Soc arch"
		default "unknown"

	config SOC_BK7256XX
		bool "For bk7256 series chipset"
		default n

	config SOC_BK7236XX
		bool "For bk7236 series chipset"
		default n

	config SOC_SMP
		bool "For soc smp feature"
		default n

	config SOC_BK7236_SMP
		bool "For bk7236 smp"
		default n

	config SOC_BK7236_SMP_TEMP
		bool "For bk7236 smp temp"
		default n

	config SOC_BK7239XX
		bool "For bk7239 series chipset"
		default n

	config SOC_BK7239_SMP
		bool "For bk7239 smp"
		default n

	config SOC_BK7239_SMP_TEMP
		bool "For bk7239 smp temp"
		default n

	config SOC_BK7286XX
		bool "For bk7286 series chipset"
		default n

	config SOC_BK7286_FPGA
		bool "For bk7286 FPGA"
		default n

	config SOC_BK7286_SMP
		bool "For bk7286 smp"
		default n

	config SOC_BK7286_SMP_TEMP
		bool "For bk7286 smp temp"
		default n
endmenu
```

## t5_os/bk_idk/projects/wifi/static_ip/main/Kconfig.projbuild
```kconfig
menu "Example Configuration"

    config EXAMPLE_WIFI_SSID
        string "WiFi SSID"
        default "my ssid"
        help
            SSID (network name) for the example to connect to.

    config EXAMPLE_WIFI_PASSWORD
        string "WiFi Password"
        default "my password"
        help
            WiFi password (WPA or WPA2) for the example to use.

    config EXAMPLE_STATIC_IP
		string "static ip4 address"
		default "192.168.1.199"
		help
			set Wi-Fi static ip address

    config EXAMPLE_STATIC_NETMASK
		string "static ip4 netmask"
		default "255.255.255.0"
		help
            set Wi-Fi static netmask

    config EXAMPLE_STATIC_GW
		string "static ip4 gateway"
		default "192.168.1.1"
		help
            set Wi-Fi static gateway

    config EXAMPLE_STATIC_DNS
		string "static ip4 dns server"
		default "192.168.1.1"
		help
            set Wi-Fi static DNS server

endmenu
```

## t5_os/components/audio_algorithm/agc/Kconfig
```kconfig
menu "Demos::Media::Audio::Agc"
	config AUDIO_AGC_TEST
		depends on FATFS
		bool "Enable Audio Agc test"
		default n
endmenu
```

## t5_os/components/audio_algorithm/aud_vad/Kconfig
```kconfig
menu "Demos::Media::Audio::Aud_vad"
	config AUDIO_VAD_TEST
		depends on FATFS
		bool "Enable Audio Vad Test"
		default n
		help
			Enable AUDIO Voice Activity Detection Test
endmenu
```

## t5_os/components/audio_algorithm/wanson_asr/Kconfig
```kconfig
menu "Demos::Media::Audio::Wanson_asr"
	config WANSON_ASR_TEST
		depends on WANSON_ASR
		depends on FATFS
		bool "Enable Wanson Asr Test"
		default n
endmenu
```

## t5_os/components/bk_audio/audio_algorithms/aec_algorithm/Kconfig
```kconfig
menu "Asdf::Audio_algorithm::Aec_algorithm"
	config ASDF_AEC_ALGORITHM
		depends on ASDF
		bool "Enable Audio AEC algorithm"
		default n

	config ASDF_AEC_ALGORITHM_TEST
		depends on ASDF_AEC_ALGORITHM
		bool "Enable Audio AEC algorithm test"
		default n

endmenu
```

## t5_os/components/bk_audio/audio_algorithms/agc_algorithm/Kconfig
```kconfig
menu "Asdf::Audio_algorithm::Agc_algorithm"
	config ASDF_AGC_ALGORITHM
		depends on ASDF
		bool "Enable Audio AGC algorithm"
		default n

	config ASDF_AGC_ALGORITHM_TEST
		depends on ASDF_AGC_ALGORITHM
		bool "Enable Audio AGC algorithm test"
		default n

endmenu
```

## t5_os/components/bk_audio/audio_decoders/g711_decoder/Kconfig
```kconfig
menu "Asdf::Audio_decoders::G711_decoder"
	config ASDF_G711_DECODER
		depends on ASDF
		bool "Enable Audio G711 Decoder"
		default n

	config ASDF_G711_DECODER_TEST
		depends on ASDF_G711_DECODER
		bool "Enable Audio G711 Decoder test"
		default n

endmenu
```

## t5_os/components/bk_audio/audio_decoders/mp3_decoder/Kconfig
```kconfig
menu "Asdf::Audio_decoders::MP3_decoder"
	config ASDF_MP3_DECODER
		depends on ASDF
		bool "Enable Audio MP3 Decoder"
		default n

	config ASDF_MP3_DECODER_TEST
		depends on ASDF_MP3_DECODER
		bool "Enable Audio MP3 Decoder test"
		default n

endmenu
```

## t5_os/components/bk_audio/audio_encoders/g711_encoder/Kconfig
```kconfig
menu "Asdf::Audio_encoders::G711_encoder"
	config ASDF_G711_ENCODER
		depends on ASDF
		bool "Enable Audio G711 encoder"
		default n

	config ASDF_G711_ENCODER_TEST
		depends on ASDF_G711_ENCODER
		bool "Enable Audio G711 encoder test"
		default n

endmenu
```

## t5_os/components/bk_audio/audio_pipeline/Kconfig
```kconfig
menu "Asdf"
	config ASDF
		depends on FREERTOS_USE_QUEUE_SETS
		bool "Enable Audio Software Development Framework"
		default n

	choice ASDF_WORK_CPU
		depends on ASDF
		prompt "Select ASDF work cpu"
		default ASDF_WORK_CPU1

		config ASDF_WORK_CPU1
			bool "ASDF work in cpu1"
			help
				ASDF work in CPU1, need audio coprocess in cpu0

		config ASDF_WORK_CPU0
			bool "ASDF work in cpu0"
			help
				ASDF work in CPU0
	endchoice

	config ASDF_AUTO_TEST
		bool "Enable ASDF auto test"
		default n

	config ASDF_AUTO_TEST_PIPELINE
		depends on ASDF_AUTO_TEST
		bool "Enable ASDF pipeline auto test "
		default n

	config ASDF_AUTO_TEST_ELEMENT
		depends on ASDF_AUTO_TEST
		bool "Enable ASDF element auto test "
		default n

	config ASDF_AUTO_TEST_EVENT
		depends on ASDF_AUTO_TEST
		bool "Enable ASDF event listener auto test "
		default n

endmenu
```

## t5_os/components/bk_audio/audio_streams/fatfs_stream/Kconfig
```kconfig
menu "Asdf::Audio_streams::Fatfs_stream"
	config ASDF_FATFS_STREAM
		depends on ASDF
		bool "Enable Audio Fatfs stream"
		default n
		help
			if ASDF run in cpu0, must enable FATFS manual

	config ASDF_FATFS_STREAM_TEST
		depends on ASDF_FATFS_STREAM
		bool "Enable Audio Fatfs stream test"
		default n

endmenu
```

## t5_os/components/bk_audio/audio_streams/onboard_mic_stream/Kconfig
```kconfig
menu "Asdf::Audio_streams::Onboard_mic_stream"
	config ASDF_ONBOARD_MIC_STREAM
		depends on ASDF
		depends on AUDIO_ADC
		bool "Enable onboard mic stream"
		default n

	config ASDF_ONBOARD_MIC_STREAM_TEST
		depends on ASDF_ONBOARD_MIC_STREAM
		bool "Enable onboard mic stream test"
		default n

endmenu
```

## t5_os/components/bk_audio/audio_streams/onboard_speaker_stream/Kconfig
```kconfig
menu "Asdf::Audio_streams::Onboard_speaker_stream"
	config ASDF_ONBOARD_SPEAKER_STREAM
		depends on ASDF
		depends on AUDIO_DAC
		bool "Enable onboard speaker stream"
		default n

	config ASDF_ONBOARD_SPEAKER_STREAM_TEST
		depends on ASDF_ONBOARD_SPEAKER_STREAM
		bool "Enable onboard speaker stream test"
		default n

endmenu
```

## t5_os/components/bk_audio/audio_streams/raw_stream/Kconfig
```kconfig
menu "Asdf::Audio_streams::raw_stream"
	config ASDF_RAW_STREAM
		depends on ASDF
		bool "Enable raw stream"
		default n

	config ASDF_RAW_STREAM_TEST
		depends on ASDF_RAW_STREAM
		bool "Enable raw stream test"
		default n

endmenu
```

## t5_os/components/bk_peripheral/src/lcd/mcu/Kconfig
```kconfig
menu "MCU LCD"
	config LCD_NT35510_MCU
		depends on LCD
		bool "Enable LCD_NT35510_MCU API"
		default n

	config LCD_ST7796S
		depends on LCD
		bool "Enable LCD_ST7796S API"
		default n

	config LCD_ST7789V
		depends on LCD
		bool "Enable LCD_ST7789V API"
		default n
endmenu
```

## t5_os/components/bk_peripheral/src/lcd/qspi/Kconfig
```kconfig
menu "QSPI LCD"

	config LCD_QSPI_SH8601A
		depends on LCD_QSPI
		bool "Enable LCD_QSPI_SH8601A API"
		default n

    config SH8601A_PARTIAL
        depends on LCD_QSPI_SH8601A
        bool "Enable Lcd Qspi SH8601A_PARTIAL Test"
        default n

	config LCD_QSPI_ST77903_WX20114
		depends on LCD_QSPI
		bool "Enable LCD_QSPI_ST77903_WX20114 API"
		default n

	config LCD_QSPI_ST77903_SAT61478M
		depends on LCD_QSPI
		bool "Enable LCD_QSPI_ST77903_SAT61478M API"
		default n

	config LCD_QSPI_ST77903_H0165Y008T
		depends on LCD_QSPI
		bool "Enable LCD_QSPI_ST77903_H0165Y008T API"
		default n

	config LCD_QSPI_SPD2010
		depends on LCD_QSPI
		bool "Enable LCD_QSPI_SPD2010 API"
		default n

endmenu
```

## t5_os/components/bk_peripheral/src/tp/Kconfig
```kconfig
menu "TP"
	config TP_GT911
		depends on TP
		bool "Enable TP_GT911 API"
		default n

	config TP_GT1151
		depends on TP
		bool "Enable TP_GT1151 API"
		default n

	config TP_FT6336
		depends on TP
		bool "Enable TP_FT6336 API"
		default n

	config TP_HY4633
		depends on TP
		bool "Enable TP_HY4633 API"
		default n
endmenu
```

## t5_os/components/bk_thirdparty/asr/wanson/Kconfig
```kconfig
menu "Bk_thirdparty::Wanson"

	config WANSON_ASR
		bool "Enable Wanson ASR"
		default n
		help
			Enable Wanson Automatic Speech Recognition

endmenu
```

## t5_os/components/bk_thirdparty/jpeg_encoder/Kconfig
```kconfig
menu "Bk_thirdparty::JPEG software encoder"

	config JPEG_SW_ENCODER
		bool "Enable JPEG software encoder"
		default n
		help
			Enable JPEG software encoder
	config JPEG_SW_ENCODER_TEST
		bool "Enable JPEG software encoder cli test"
		depends on JPEG_SW_ENCODER
		default n
	config JPEG_SW_ENCODER_FILE_IO_WITH_SDCARD
		bool "Enable JPEG software encoder file IO"
		depends on JPEG_SW_ENCODER
		default n
	config JPEG_SW_ENCODER_TIME_CONSUMPTION_MEAS
		bool "Enable time consumption measurement"
		depends on JPEG_SW_ENCODER
		default n
endmenu
```

## t5_os/components/cli_test/Kconfig
```kconfig
menu "CLI TEST"
    config IDF_TEST
        bool "Enable IDF_TEST"
        default n
endmenu
```

## t5_os/components/codec/legacy/net_transfer/Kconfig
```kconfig
menu "legacy_App"

	config USE_APP_DEMO_VIDEO_TRANSSER
		depends on WIFI_ENABLE
		depends on DVP_CAMERA
		bool "Enable Use App Demo Video Transser"
		default n

	config APP_DEMO_VIDEO_TRANSFER
		depends on WIFI_ENABLE
		bool "Enable App Demo Video Transser"
		default n

	config NET_WORK_VIDEO_TRANSFER
		depends on WIFI_ENABLE
		bool "Enable Net Work Video Transser"
		default n
	
	config RTSP_SERVER
		depends on WIFI_ENABLE
		bool "Enable Rtsp Video Transser"
		default n

	config P2P
		bool "Enable P2P"
		default n

	config NTP_SYNC_RTC
		depends on AON_RTC
		bool "Enable Ntp Sync Rtc"
		default n
		help
			sync ano rtc using network time

	config VIDEO_AVI
		depends on NTP_SYNC_RTC
		bool "Enable Video Avi"
		default n

endmenu
```

## t5_os/components/display_service/Kconfig
```kconfig
menu "Display Service"

	config MEDIA_DISPLAY_SERVICE
		depends on SYS_CPU1
		bool "Enable Display Service"
		default y

	config LCD_SPI_DISPLAY
		depends on SPI
		bool "Enable LCD SPI Display"
		default n
endmenu
```
