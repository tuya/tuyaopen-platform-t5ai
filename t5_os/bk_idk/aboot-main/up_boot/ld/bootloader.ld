/* This file is generated by nds_ldsag (version (2021-07-02) ). */
ENTRY(_start)
SECTIONS
{
	PROVIDE (__executable_start = 0x00001F00);
	NDS_SAG_LMA_bootloader = 0x00001F00 ;
	. = 0x00001F00;
	. = ALIGN(ALIGNOF(.nds_vector));
	.nds_vector 	: { KEEP(*(.nds_vector )) KEEP(*(SORT(.nds_vector.* ))) }
	. = ALIGN(8);
	. = ALIGN(ALIGNOF(.nds_init));
	.nds_init 	: { KEEP(*(EXCLUDE_FILE (*driver_flash.o *drv_uart.o *driver_uart2.o *fal_flash.o *fal_partition.o *data_move.o *inflate.o ).nds_init )) } = 0x0100
	. = ALIGN(ALIGNOF(.interp));
	.interp 	: { *(EXCLUDE_FILE (*driver_flash.o *drv_uart.o *driver_uart2.o *fal_flash.o *fal_partition.o *data_move.o *inflate.o ).interp ) }
	. = ALIGN(ALIGNOF(.note.gnu.build-id));
	.note.gnu.build-id 	: { *(EXCLUDE_FILE (*driver_flash.o *drv_uart.o *driver_uart2.o *fal_flash.o *fal_partition.o *data_move.o *inflate.o ).note.gnu.build-id ) }
	. = ALIGN(ALIGNOF(.note.ABI-tag));
	.note.ABI-tag 	: { *(EXCLUDE_FILE (*driver_flash.o *drv_uart.o *driver_uart2.o *fal_flash.o *fal_partition.o *data_move.o *inflate.o ).note.ABI-tag ) }
	. = ALIGN(ALIGNOF(.hash));
	.hash 	: { *(EXCLUDE_FILE (*driver_flash.o *drv_uart.o *driver_uart2.o *fal_flash.o *fal_partition.o *data_move.o *inflate.o ).hash ) }
	. = ALIGN(ALIGNOF(.gnu.hash));
	.gnu.hash 	: { *(EXCLUDE_FILE (*driver_flash.o *drv_uart.o *driver_uart2.o *fal_flash.o *fal_partition.o *data_move.o *inflate.o ).gnu.hash ) }
	. = ALIGN(ALIGNOF(.dynsym));
	.dynsym 	: { *(EXCLUDE_FILE (*driver_flash.o *drv_uart.o *driver_uart2.o *fal_flash.o *fal_partition.o *data_move.o *inflate.o ).dynsym ) }
	. = ALIGN(ALIGNOF(.dynstr));
	.dynstr 	: { *(EXCLUDE_FILE (*driver_flash.o *drv_uart.o *driver_uart2.o *fal_flash.o *fal_partition.o *data_move.o *inflate.o ).dynstr ) }
	. = ALIGN(ALIGNOF(.gnu.version));
	.gnu.version 	: { *(EXCLUDE_FILE (*driver_flash.o *drv_uart.o *driver_uart2.o *fal_flash.o *fal_partition.o *data_move.o *inflate.o ).gnu.version ) }
	. = ALIGN(ALIGNOF(.gnu.version_d));
	.gnu.version_d 	: { *(EXCLUDE_FILE (*driver_flash.o *drv_uart.o *driver_uart2.o *fal_flash.o *fal_partition.o *data_move.o *inflate.o ).gnu.version_d ) }
	. = ALIGN(ALIGNOF(.gnu.version_r));
	.gnu.version_r 	: { *(EXCLUDE_FILE (*driver_flash.o *drv_uart.o *driver_uart2.o *fal_flash.o *fal_partition.o *data_move.o *inflate.o ).gnu.version_r ) }
	. = ALIGN(ALIGNOF(.rela.init));
	.rela.init 	: { *(EXCLUDE_FILE (*driver_flash.o *drv_uart.o *driver_uart2.o *fal_flash.o *fal_partition.o *data_move.o *inflate.o ).rela.init ) }
	. = ALIGN(ALIGNOF(.rela.text));
	.rela.text 	: { *(EXCLUDE_FILE (*driver_flash.o *drv_uart.o *driver_uart2.o *fal_flash.o *fal_partition.o *data_move.o *inflate.o ).rela.text EXCLUDE_FILE (*driver_flash.o *drv_uart.o *driver_uart2.o *fal_flash.o *fal_partition.o *data_move.o *inflate.o ).rela.text.* EXCLUDE_FILE (*driver_flash.o *drv_uart.o *driver_uart2.o *fal_flash.o *fal_partition.o *data_move.o *inflate.o ).rela.gnu.linkonce.t.* ) }
	. = ALIGN(ALIGNOF(.rela.fini));
	.rela.fini 	: { *(EXCLUDE_FILE (*driver_flash.o *drv_uart.o *driver_uart2.o *fal_flash.o *fal_partition.o *data_move.o *inflate.o ).rela.fini ) }
	. = ALIGN(ALIGNOF(.rela.rodata));
	.rela.rodata 	: { *(EXCLUDE_FILE (*driver_flash.o *drv_uart.o *driver_uart2.o *fal_flash.o *fal_partition.o *data_move.o *inflate.o ).rela.rodata EXCLUDE_FILE (*driver_flash.o *drv_uart.o *driver_uart2.o *fal_flash.o *fal_partition.o *data_move.o *inflate.o ).rela.rodata.* EXCLUDE_FILE (*driver_flash.o *drv_uart.o *driver_uart2.o *fal_flash.o *fal_partition.o *data_move.o *inflate.o ).rela.gnu.linkonce.r.* ) }
	. = ALIGN(ALIGNOF(.rela.data.rel.ro));
	.rela.data.rel.ro 	: { *(EXCLUDE_FILE (*driver_flash.o *drv_uart.o *driver_uart2.o *fal_flash.o *fal_partition.o *data_move.o *inflate.o ).rel.data.rel.ro* ) }
	. = ALIGN(ALIGNOF(.rela.data));
	.rela.data 	: { *(EXCLUDE_FILE (*driver_flash.o *drv_uart.o *driver_uart2.o *fal_flash.o *fal_partition.o *data_move.o *inflate.o ).rela.data EXCLUDE_FILE (*driver_flash.o *drv_uart.o *driver_uart2.o *fal_flash.o *fal_partition.o *data_move.o *inflate.o ).rela.data.* EXCLUDE_FILE (*driver_flash.o *drv_uart.o *driver_uart2.o *fal_flash.o *fal_partition.o *data_move.o *inflate.o ).rela.gnu.linkonce.d.* ) }
	. = ALIGN(ALIGNOF(.rela.tdata));
	.rela.tdata 	: { *(EXCLUDE_FILE (*driver_flash.o *drv_uart.o *driver_uart2.o *fal_flash.o *fal_partition.o *data_move.o *inflate.o ).rela.tdata EXCLUDE_FILE (*driver_flash.o *drv_uart.o *driver_uart2.o *fal_flash.o *fal_partition.o *data_move.o *inflate.o ).rela.tdata.* EXCLUDE_FILE (*driver_flash.o *drv_uart.o *driver_uart2.o *fal_flash.o *fal_partition.o *data_move.o *inflate.o ).rela.gnu.linkonce.td.* ) }
	. = ALIGN(ALIGNOF(.rela.tbss));
	.rela.tbss 	: { *(EXCLUDE_FILE (*driver_flash.o *drv_uart.o *driver_uart2.o *fal_flash.o *fal_partition.o *data_move.o *inflate.o ).rela.tbss EXCLUDE_FILE (*driver_flash.o *drv_uart.o *driver_uart2.o *fal_flash.o *fal_partition.o *data_move.o *inflate.o ).rela.tbss.* EXCLUDE_FILE (*driver_flash.o *drv_uart.o *driver_uart2.o *fal_flash.o *fal_partition.o *data_move.o *inflate.o ).rela.gnu.linkonce.tb.* ) }
	. = ALIGN(ALIGNOF(.rela.ctors));
	.rela.ctors 	: { *(EXCLUDE_FILE (*driver_flash.o *drv_uart.o *driver_uart2.o *fal_flash.o *fal_partition.o *data_move.o *inflate.o ).rela.ctors ) }
	. = ALIGN(ALIGNOF(.rela.dtors));
	.rela.dtors 	: { *(EXCLUDE_FILE (*driver_flash.o *drv_uart.o *driver_uart2.o *fal_flash.o *fal_partition.o *data_move.o *inflate.o ).rela.dtors ) }
	. = ALIGN(ALIGNOF(.rela.dyn));
	.rela.dyn 	: { *(EXCLUDE_FILE (*driver_flash.o *drv_uart.o *driver_uart2.o *fal_flash.o *fal_partition.o *data_move.o *inflate.o )rela.dyn ) *(EXCLUDE_FILE (*driver_flash.o *drv_uart.o *driver_uart2.o *fal_flash.o *fal_partition.o *data_move.o *inflate.o ).rela__libc_subfreeres ) *(EXCLUDE_FILE (*driver_flash.o *drv_uart.o *driver_uart2.o *fal_flash.o *fal_partition.o *data_move.o *inflate.o ).rela__libc_atexit ) *(EXCLUDE_FILE (*driver_flash.o *drv_uart.o *driver_uart2.o *fal_flash.o *fal_partition.o *data_move.o *inflate.o ).rela__libc_thread_subfreeres ) *(EXCLUDE_FILE (*driver_flash.o *drv_uart.o *driver_uart2.o *fal_flash.o *fal_partition.o *data_move.o *inflate.o ).rela.init_array ) *(EXCLUDE_FILE (*driver_flash.o *drv_uart.o *driver_uart2.o *fal_flash.o *fal_partition.o *data_move.o *inflate.o ).rela.fini_array ) }
	. = ALIGN(ALIGNOF(.rela.got));
	.rela.got 	: { *(EXCLUDE_FILE (*driver_flash.o *drv_uart.o *driver_uart2.o *fal_flash.o *fal_partition.o *data_move.o *inflate.o ).rela.got ) }
	. = ALIGN(ALIGNOF(.rela.sdata));
	.rela.sdata 	: { *(EXCLUDE_FILE (*driver_flash.o *drv_uart.o *driver_uart2.o *fal_flash.o *fal_partition.o *data_move.o *inflate.o ).rela.sdata EXCLUDE_FILE (*driver_flash.o *drv_uart.o *driver_uart2.o *fal_flash.o *fal_partition.o *data_move.o *inflate.o ).rela.sdata.* EXCLUDE_FILE (*driver_flash.o *drv_uart.o *driver_uart2.o *fal_flash.o *fal_partition.o *data_move.o *inflate.o ).rela.gnu.linkonce.s.* ) }
	. = ALIGN(ALIGNOF(.rela.sbss));
	.rela.sbss 	: { *(EXCLUDE_FILE (*driver_flash.o *drv_uart.o *driver_uart2.o *fal_flash.o *fal_partition.o *data_move.o *inflate.o ).rela.sbss EXCLUDE_FILE (*driver_flash.o *drv_uart.o *driver_uart2.o *fal_flash.o *fal_partition.o *data_move.o *inflate.o ).rela.sbss.* EXCLUDE_FILE (*driver_flash.o *drv_uart.o *driver_uart2.o *fal_flash.o *fal_partition.o *data_move.o *inflate.o ).rela.gnu.linkonce.sb.* ) }
	. = ALIGN(ALIGNOF(.rela.sdata2));
	.rela.sdata2 	: { *(EXCLUDE_FILE (*driver_flash.o *drv_uart.o *driver_uart2.o *fal_flash.o *fal_partition.o *data_move.o *inflate.o ).rela.sdata2 EXCLUDE_FILE (*driver_flash.o *drv_uart.o *driver_uart2.o *fal_flash.o *fal_partition.o *data_move.o *inflate.o ).rela.sdata2.* EXCLUDE_FILE (*driver_flash.o *drv_uart.o *driver_uart2.o *fal_flash.o *fal_partition.o *data_move.o *inflate.o ).rela.gnu.linkonce.s2.* ) }
	. = ALIGN(ALIGNOF(.rela.sbss2));
	.rela.sbss2 	: { *(EXCLUDE_FILE (*driver_flash.o *drv_uart.o *driver_uart2.o *fal_flash.o *fal_partition.o *data_move.o *inflate.o ).rela.sbss2 EXCLUDE_FILE (*driver_flash.o *drv_uart.o *driver_uart2.o *fal_flash.o *fal_partition.o *data_move.o *inflate.o ).rela.sbss2.* EXCLUDE_FILE (*driver_flash.o *drv_uart.o *driver_uart2.o *fal_flash.o *fal_partition.o *data_move.o *inflate.o ).rela.gnu.linkonce.sb2.* ) }
	. = ALIGN(ALIGNOF(.rela.bss));
	.rela.bss 	: { *(EXCLUDE_FILE (*driver_flash.o *drv_uart.o *driver_uart2.o *fal_flash.o *fal_partition.o *data_move.o *inflate.o ).rela.bss EXCLUDE_FILE (*driver_flash.o *drv_uart.o *driver_uart2.o *fal_flash.o *fal_partition.o *data_move.o *inflate.o ).rela.bss.* EXCLUDE_FILE (*driver_flash.o *drv_uart.o *driver_uart2.o *fal_flash.o *fal_partition.o *data_move.o *inflate.o ).rela.gnu.linkonce.b.* ) }
	. = ALIGN(ALIGNOF(.rela.plt));
	.rela.plt 	: { *(EXCLUDE_FILE (*driver_flash.o *drv_uart.o *driver_uart2.o *fal_flash.o *fal_partition.o *data_move.o *inflate.o ).rela.plt ) }
	. = ALIGN(ALIGNOF(.init));
	.init 	: { KEEP(*(EXCLUDE_FILE (*driver_flash.o *drv_uart.o *driver_uart2.o *fal_flash.o *fal_partition.o *data_move.o *inflate.o ).init )) }
	. = ALIGN(ALIGNOF(.plt));
	.plt 	: { *(EXCLUDE_FILE (*driver_flash.o *drv_uart.o *driver_uart2.o *fal_flash.o *fal_partition.o *data_move.o *inflate.o ).plt ) }
	. = ALIGN(ALIGNOF(.text));
	.text 	: { *(EXCLUDE_FILE (*driver_flash.o *drv_uart.o *driver_uart2.o *fal_flash.o *fal_partition.o *data_move.o *inflate.o ).text EXCLUDE_FILE (*driver_flash.o *drv_uart.o *driver_uart2.o *fal_flash.o *fal_partition.o *data_move.o *inflate.o ).stub EXCLUDE_FILE (*driver_flash.o *drv_uart.o *driver_uart2.o *fal_flash.o *fal_partition.o *data_move.o *inflate.o ).text.* EXCLUDE_FILE (*driver_flash.o *drv_uart.o *driver_uart2.o *fal_flash.o *fal_partition.o *data_move.o *inflate.o ).gnu.linkonce.t.* ) KEEP(*(EXCLUDE_FILE (*driver_flash.o *drv_uart.o *driver_uart2.o *fal_flash.o *fal_partition.o *data_move.o *inflate.o ).text.*personality* )) *(EXCLUDE_FILE (*driver_flash.o *drv_uart.o *driver_uart2.o *fal_flash.o *fal_partition.o *data_move.o *inflate.o ).gnu.warning ) . = ALIGN(4); } = 0x0100
	. = ALIGN(ALIGNOF(.fini));
	.fini 	: { KEEP(*(EXCLUDE_FILE (*driver_flash.o *drv_uart.o *driver_uart2.o *fal_flash.o *fal_partition.o *data_move.o *inflate.o ).fini )) }
	. = ALIGN(ALIGNOF(.exec.itable));
	.exec.itable 	: { *(EXCLUDE_FILE (*driver_flash.o *drv_uart.o *driver_uart2.o *fal_flash.o *fal_partition.o *data_move.o *inflate.o ).exec.itable ) }
	PROVIDE (__etext = .);
	PROVIDE (_etext = .);
	PROVIDE (etext = .);
	. = ALIGN(ALIGNOF(.rodata));
	.rodata 	: { *(EXCLUDE_FILE (*driver_flash.o *drv_uart.o *driver_uart2.o *fal_flash.o *fal_partition.o *data_move.o *inflate.o ).rodata EXCLUDE_FILE (*driver_flash.o *drv_uart.o *driver_uart2.o *fal_flash.o *fal_partition.o *data_move.o *inflate.o ).rodata.* EXCLUDE_FILE (*driver_flash.o *drv_uart.o *driver_uart2.o *fal_flash.o *fal_partition.o *data_move.o *inflate.o ).gnu.linkonce.r.* ) }
	. = ALIGN(ALIGNOF(.rodata1));
	.rodata1 	: { *(EXCLUDE_FILE (*driver_flash.o *drv_uart.o *driver_uart2.o *fal_flash.o *fal_partition.o *data_move.o *inflate.o ).rodata1 ) }
	. = ALIGN(ALIGNOF(.sdata2));
	.sdata2 	: { *(EXCLUDE_FILE (*driver_flash.o *drv_uart.o *driver_uart2.o *fal_flash.o *fal_partition.o *data_move.o *inflate.o ).sdata2 EXCLUDE_FILE (*driver_flash.o *drv_uart.o *driver_uart2.o *fal_flash.o *fal_partition.o *data_move.o *inflate.o ).sdata2.* EXCLUDE_FILE (*driver_flash.o *drv_uart.o *driver_uart2.o *fal_flash.o *fal_partition.o *data_move.o *inflate.o ).gnu.linkonce.s2.* ) }
	. = ALIGN(ALIGNOF(.sbss2));
	.sbss2 	: { *(EXCLUDE_FILE (*driver_flash.o *drv_uart.o *driver_uart2.o *fal_flash.o *fal_partition.o *data_move.o *inflate.o ).sbss2 EXCLUDE_FILE (*driver_flash.o *drv_uart.o *driver_uart2.o *fal_flash.o *fal_partition.o *data_move.o *inflate.o ).sbss2.* EXCLUDE_FILE (*driver_flash.o *drv_uart.o *driver_uart2.o *fal_flash.o *fal_partition.o *data_move.o *inflate.o ).gnu.linkonce.sb2.* ) }
	. = ALIGN(ALIGNOF(.eh_frame_hdr));
	.eh_frame_hdr 	: { *(EXCLUDE_FILE (*driver_flash.o *drv_uart.o *driver_uart2.o *fal_flash.o *fal_partition.o *data_move.o *inflate.o ).eh_frame_hdr ) }
	. = ALIGN(8);
	. = 0x10000000;
	ITCM_BEGIN = .;
	. = ALIGN(8);
	. = ALIGN(ALIGNOF(".nds_init_*driver_flash.o"));
	".nds_init_*driver_flash.o" 	: AT(ALIGN(ALIGN(LOADADDR (.eh_frame_hdr) + SIZEOF (.eh_frame_hdr), ALIGNOF(".nds_init_*driver_flash.o")), 8))
		{ KEEP(*driver_flash.o(.nds_init )) KEEP(*drv_uart.o(.nds_init )) KEEP(*driver_uart2.o(.nds_init )) KEEP(*fal_flash.o(.nds_init )) KEEP(*fal_partition.o(.nds_init )) KEEP(*data_move.o(.nds_init )) KEEP(*inflate.o(.nds_init )) } = 0x0100
	_itcm_lma_start =  LOADADDR (".nds_init_*driver_flash.o");
	_itcm_ema_start = ADDR(".nds_init_*driver_flash.o");
	. = ALIGN(ALIGNOF(".interp_*driver_flash.o"));
	".interp_*driver_flash.o" 	: AT(ALIGN(LOADADDR (".nds_init_*driver_flash.o") + SIZEOF (".nds_init_*driver_flash.o"), ALIGNOF(".interp_*driver_flash.o")))
		{ KEEP(*driver_flash.o(.interp )) KEEP(*drv_uart.o(.interp )) KEEP(*driver_uart2.o(.interp )) KEEP(*fal_flash.o(.interp )) KEEP(*fal_partition.o(.interp )) KEEP(*data_move.o(.interp )) KEEP(*inflate.o(.interp )) }
	. = ALIGN(ALIGNOF(".note.gnu.build-id_*driver_flash.o"));
	".note.gnu.build-id_*driver_flash.o" 	: AT(ALIGN(LOADADDR (".interp_*driver_flash.o") + SIZEOF (".interp_*driver_flash.o"), ALIGNOF(".note.gnu.build-id_*driver_flash.o")))
		{ KEEP(*driver_flash.o(.note.gnu.build-id )) KEEP(*drv_uart.o(.note.gnu.build-id )) KEEP(*driver_uart2.o(.note.gnu.build-id )) KEEP(*fal_flash.o(.note.gnu.build-id )) KEEP(*fal_partition.o(.note.gnu.build-id )) KEEP(*data_move.o(.note.gnu.build-id )) KEEP(*inflate.o(.note.gnu.build-id )) }
	. = ALIGN(ALIGNOF(".note.ABI-tag_*driver_flash.o"));
	".note.ABI-tag_*driver_flash.o" 	: AT(ALIGN(LOADADDR (".note.gnu.build-id_*driver_flash.o") + SIZEOF (".note.gnu.build-id_*driver_flash.o"), ALIGNOF(".note.ABI-tag_*driver_flash.o")))
		{ KEEP(*driver_flash.o(.note.ABI-tag )) KEEP(*drv_uart.o(.note.ABI-tag )) KEEP(*driver_uart2.o(.note.ABI-tag )) KEEP(*fal_flash.o(.note.ABI-tag )) KEEP(*fal_partition.o(.note.ABI-tag )) KEEP(*data_move.o(.note.ABI-tag )) KEEP(*inflate.o(.note.ABI-tag )) }
	. = ALIGN(ALIGNOF(".hash_*driver_flash.o"));
	".hash_*driver_flash.o" 	: AT(ALIGN(LOADADDR (".note.ABI-tag_*driver_flash.o") + SIZEOF (".note.ABI-tag_*driver_flash.o"), ALIGNOF(".hash_*driver_flash.o")))
		{ KEEP(*driver_flash.o(.hash )) KEEP(*drv_uart.o(.hash )) KEEP(*driver_uart2.o(.hash )) KEEP(*fal_flash.o(.hash )) KEEP(*fal_partition.o(.hash )) KEEP(*data_move.o(.hash )) KEEP(*inflate.o(.hash )) }
	. = ALIGN(ALIGNOF(".gnu.hash_*driver_flash.o"));
	".gnu.hash_*driver_flash.o" 	: AT(ALIGN(LOADADDR (".hash_*driver_flash.o") + SIZEOF (".hash_*driver_flash.o"), ALIGNOF(".gnu.hash_*driver_flash.o")))
		{ KEEP(*driver_flash.o(.gnu.hash )) KEEP(*drv_uart.o(.gnu.hash )) KEEP(*driver_uart2.o(.gnu.hash )) KEEP(*fal_flash.o(.gnu.hash )) KEEP(*fal_partition.o(.gnu.hash )) KEEP(*data_move.o(.gnu.hash )) KEEP(*inflate.o(.gnu.hash )) }
	. = ALIGN(ALIGNOF(".dynsym_*driver_flash.o"));
	".dynsym_*driver_flash.o" 	: AT(ALIGN(LOADADDR (".gnu.hash_*driver_flash.o") + SIZEOF (".gnu.hash_*driver_flash.o"), ALIGNOF(".dynsym_*driver_flash.o")))
		{ KEEP(*driver_flash.o(.dynsym )) KEEP(*drv_uart.o(.dynsym )) KEEP(*driver_uart2.o(.dynsym )) KEEP(*fal_flash.o(.dynsym )) KEEP(*fal_partition.o(.dynsym )) KEEP(*data_move.o(.dynsym )) KEEP(*inflate.o(.dynsym )) }
	. = ALIGN(ALIGNOF(".dynstr_*driver_flash.o"));
	".dynstr_*driver_flash.o" 	: AT(ALIGN(LOADADDR (".dynsym_*driver_flash.o") + SIZEOF (".dynsym_*driver_flash.o"), ALIGNOF(".dynstr_*driver_flash.o")))
		{ KEEP(*driver_flash.o(.dynstr )) KEEP(*drv_uart.o(.dynstr )) KEEP(*driver_uart2.o(.dynstr )) KEEP(*fal_flash.o(.dynstr )) KEEP(*fal_partition.o(.dynstr )) KEEP(*data_move.o(.dynstr )) KEEP(*inflate.o(.dynstr )) }
	. = ALIGN(ALIGNOF(".gnu.version_*driver_flash.o"));
	".gnu.version_*driver_flash.o" 	: AT(ALIGN(LOADADDR (".dynstr_*driver_flash.o") + SIZEOF (".dynstr_*driver_flash.o"), ALIGNOF(".gnu.version_*driver_flash.o")))
		{ KEEP(*driver_flash.o(.gnu.version )) KEEP(*drv_uart.o(.gnu.version )) KEEP(*driver_uart2.o(.gnu.version )) KEEP(*fal_flash.o(.gnu.version )) KEEP(*fal_partition.o(.gnu.version )) KEEP(*data_move.o(.gnu.version )) KEEP(*inflate.o(.gnu.version )) }
	. = ALIGN(ALIGNOF(".gnu.version_d_*driver_flash.o"));
	".gnu.version_d_*driver_flash.o" 	: AT(ALIGN(LOADADDR (".gnu.version_*driver_flash.o") + SIZEOF (".gnu.version_*driver_flash.o"), ALIGNOF(".gnu.version_d_*driver_flash.o")))
		{ KEEP(*driver_flash.o(.gnu.version_d )) KEEP(*drv_uart.o(.gnu.version_d )) KEEP(*driver_uart2.o(.gnu.version_d )) KEEP(*fal_flash.o(.gnu.version_d )) KEEP(*fal_partition.o(.gnu.version_d )) KEEP(*data_move.o(.gnu.version_d )) KEEP(*inflate.o(.gnu.version_d )) }
	. = ALIGN(ALIGNOF(".gnu.version_r_*driver_flash.o"));
	".gnu.version_r_*driver_flash.o" 	: AT(ALIGN(LOADADDR (".gnu.version_d_*driver_flash.o") + SIZEOF (".gnu.version_d_*driver_flash.o"), ALIGNOF(".gnu.version_r_*driver_flash.o")))
		{ KEEP(*driver_flash.o(.gnu.version_r )) KEEP(*drv_uart.o(.gnu.version_r )) KEEP(*driver_uart2.o(.gnu.version_r )) KEEP(*fal_flash.o(.gnu.version_r )) KEEP(*fal_partition.o(.gnu.version_r )) KEEP(*data_move.o(.gnu.version_r )) KEEP(*inflate.o(.gnu.version_r )) }
	. = ALIGN(ALIGNOF(".rela.init_*driver_flash.o"));
	".rela.init_*driver_flash.o" 	: AT(ALIGN(LOADADDR (".gnu.version_r_*driver_flash.o") + SIZEOF (".gnu.version_r_*driver_flash.o"), ALIGNOF(".rela.init_*driver_flash.o")))
		{ KEEP(*driver_flash.o(.rela.init )) KEEP(*drv_uart.o(.rela.init )) KEEP(*driver_uart2.o(.rela.init )) KEEP(*fal_flash.o(.rela.init )) KEEP(*fal_partition.o(.rela.init )) KEEP(*data_move.o(.rela.init )) KEEP(*inflate.o(.rela.init )) }
	. = ALIGN(ALIGNOF(".rela.text_*driver_flash.o"));
	".rela.text_*driver_flash.o" 	: AT(ALIGN(LOADADDR (".rela.init_*driver_flash.o") + SIZEOF (".rela.init_*driver_flash.o"), ALIGNOF(".rela.text_*driver_flash.o")))
		{ KEEP(*driver_flash.o(.rela.text .rela.text.* .rela.gnu.linkonce.t.* )) KEEP(*drv_uart.o(.rela.text .rela.text.* .rela.gnu.linkonce.t.* )) KEEP(*driver_uart2.o(.rela.text .rela.text.* .rela.gnu.linkonce.t.* )) KEEP(*fal_flash.o(.rela.text .rela.text.* .rela.gnu.linkonce.t.* )) KEEP(*fal_partition.o(.rela.text .rela.text.* .rela.gnu.linkonce.t.* )) KEEP(*data_move.o(.rela.text .rela.text.* .rela.gnu.linkonce.t.* )) KEEP(*inflate.o(.rela.text .rela.text.* .rela.gnu.linkonce.t.* )) }
	. = ALIGN(ALIGNOF(".rela.fini_*driver_flash.o"));
	".rela.fini_*driver_flash.o" 	: AT(ALIGN(LOADADDR (".rela.text_*driver_flash.o") + SIZEOF (".rela.text_*driver_flash.o"), ALIGNOF(".rela.fini_*driver_flash.o")))
		{ KEEP(*driver_flash.o(.rela.fini )) KEEP(*drv_uart.o(.rela.fini )) KEEP(*driver_uart2.o(.rela.fini )) KEEP(*fal_flash.o(.rela.fini )) KEEP(*fal_partition.o(.rela.fini )) KEEP(*data_move.o(.rela.fini )) KEEP(*inflate.o(.rela.fini )) }
	. = ALIGN(ALIGNOF(".rela.rodata_*driver_flash.o"));
	".rela.rodata_*driver_flash.o" 	: AT(ALIGN(LOADADDR (".rela.fini_*driver_flash.o") + SIZEOF (".rela.fini_*driver_flash.o"), ALIGNOF(".rela.rodata_*driver_flash.o")))
		{ KEEP(*driver_flash.o(.rela.rodata .rela.rodata.* .rela.gnu.linkonce.r.* )) KEEP(*drv_uart.o(.rela.rodata .rela.rodata.* .rela.gnu.linkonce.r.* )) KEEP(*driver_uart2.o(.rela.rodata .rela.rodata.* .rela.gnu.linkonce.r.* )) KEEP(*fal_flash.o(.rela.rodata .rela.rodata.* .rela.gnu.linkonce.r.* )) KEEP(*fal_partition.o(.rela.rodata .rela.rodata.* .rela.gnu.linkonce.r.* )) KEEP(*data_move.o(.rela.rodata .rela.rodata.* .rela.gnu.linkonce.r.* )) KEEP(*inflate.o(.rela.rodata .rela.rodata.* .rela.gnu.linkonce.r.* )) }
	. = ALIGN(ALIGNOF(".rela.data.rel.ro_*driver_flash.o"));
	".rela.data.rel.ro_*driver_flash.o" 	: AT(ALIGN(LOADADDR (".rela.rodata_*driver_flash.o") + SIZEOF (".rela.rodata_*driver_flash.o"), ALIGNOF(".rela.data.rel.ro_*driver_flash.o")))
		{ KEEP(*driver_flash.o(.rel.data.rel.ro* )) KEEP(*drv_uart.o(.rel.data.rel.ro* )) KEEP(*driver_uart2.o(.rel.data.rel.ro* )) KEEP(*fal_flash.o(.rel.data.rel.ro* )) KEEP(*fal_partition.o(.rel.data.rel.ro* )) KEEP(*data_move.o(.rel.data.rel.ro* )) KEEP(*inflate.o(.rel.data.rel.ro* )) }
	. = ALIGN(ALIGNOF(".rela.data_*driver_flash.o"));
	".rela.data_*driver_flash.o" 	: AT(ALIGN(LOADADDR (".rela.data.rel.ro_*driver_flash.o") + SIZEOF (".rela.data.rel.ro_*driver_flash.o"), ALIGNOF(".rela.data_*driver_flash.o")))
		{ KEEP(*driver_flash.o(.rela.data .rela.data.* .rela.gnu.linkonce.d.* )) KEEP(*drv_uart.o(.rela.data .rela.data.* .rela.gnu.linkonce.d.* )) KEEP(*driver_uart2.o(.rela.data .rela.data.* .rela.gnu.linkonce.d.* )) KEEP(*fal_flash.o(.rela.data .rela.data.* .rela.gnu.linkonce.d.* )) KEEP(*fal_partition.o(.rela.data .rela.data.* .rela.gnu.linkonce.d.* )) KEEP(*data_move.o(.rela.data .rela.data.* .rela.gnu.linkonce.d.* )) KEEP(*inflate.o(.rela.data .rela.data.* .rela.gnu.linkonce.d.* )) }
	. = ALIGN(ALIGNOF(".rela.tdata_*driver_flash.o"));
	".rela.tdata_*driver_flash.o" 	: AT(ALIGN(LOADADDR (".rela.data_*driver_flash.o") + SIZEOF (".rela.data_*driver_flash.o"), ALIGNOF(".rela.tdata_*driver_flash.o")))
		{ KEEP(*driver_flash.o(.rela.tdata .rela.tdata.* .rela.gnu.linkonce.td.* )) KEEP(*drv_uart.o(.rela.tdata .rela.tdata.* .rela.gnu.linkonce.td.* )) KEEP(*driver_uart2.o(.rela.tdata .rela.tdata.* .rela.gnu.linkonce.td.* )) KEEP(*fal_flash.o(.rela.tdata .rela.tdata.* .rela.gnu.linkonce.td.* )) KEEP(*fal_partition.o(.rela.tdata .rela.tdata.* .rela.gnu.linkonce.td.* )) KEEP(*data_move.o(.rela.tdata .rela.tdata.* .rela.gnu.linkonce.td.* )) KEEP(*inflate.o(.rela.tdata .rela.tdata.* .rela.gnu.linkonce.td.* )) }
	. = ALIGN(ALIGNOF(".rela.tbss_*driver_flash.o"));
	".rela.tbss_*driver_flash.o" 	: AT(ALIGN(LOADADDR (".rela.tdata_*driver_flash.o") + SIZEOF (".rela.tdata_*driver_flash.o"), ALIGNOF(".rela.tbss_*driver_flash.o")))
		{ KEEP(*driver_flash.o(.rela.tbss .rela.tbss.* .rela.gnu.linkonce.tb.* )) KEEP(*drv_uart.o(.rela.tbss .rela.tbss.* .rela.gnu.linkonce.tb.* )) KEEP(*driver_uart2.o(.rela.tbss .rela.tbss.* .rela.gnu.linkonce.tb.* )) KEEP(*fal_flash.o(.rela.tbss .rela.tbss.* .rela.gnu.linkonce.tb.* )) KEEP(*fal_partition.o(.rela.tbss .rela.tbss.* .rela.gnu.linkonce.tb.* )) KEEP(*data_move.o(.rela.tbss .rela.tbss.* .rela.gnu.linkonce.tb.* )) KEEP(*inflate.o(.rela.tbss .rela.tbss.* .rela.gnu.linkonce.tb.* )) }
	. = ALIGN(ALIGNOF(".rela.ctors_*driver_flash.o"));
	".rela.ctors_*driver_flash.o" 	: AT(ALIGN(LOADADDR (".rela.tbss_*driver_flash.o") + SIZEOF (".rela.tbss_*driver_flash.o"), ALIGNOF(".rela.ctors_*driver_flash.o")))
		{ KEEP(*driver_flash.o(.rela.ctors )) KEEP(*drv_uart.o(.rela.ctors )) KEEP(*driver_uart2.o(.rela.ctors )) KEEP(*fal_flash.o(.rela.ctors )) KEEP(*fal_partition.o(.rela.ctors )) KEEP(*data_move.o(.rela.ctors )) KEEP(*inflate.o(.rela.ctors )) }
	. = ALIGN(ALIGNOF(".rela.dtors_*driver_flash.o"));
	".rela.dtors_*driver_flash.o" 	: AT(ALIGN(LOADADDR (".rela.ctors_*driver_flash.o") + SIZEOF (".rela.ctors_*driver_flash.o"), ALIGNOF(".rela.dtors_*driver_flash.o")))
		{ KEEP(*driver_flash.o(.rela.dtors )) KEEP(*drv_uart.o(.rela.dtors )) KEEP(*driver_uart2.o(.rela.dtors )) KEEP(*fal_flash.o(.rela.dtors )) KEEP(*fal_partition.o(.rela.dtors )) KEEP(*data_move.o(.rela.dtors )) KEEP(*inflate.o(.rela.dtors )) }
	. = ALIGN(ALIGNOF(".rela.dyn_*driver_flash.o"));
	".rela.dyn_*driver_flash.o" 	: AT(ALIGN(LOADADDR (".rela.dtors_*driver_flash.o") + SIZEOF (".rela.dtors_*driver_flash.o"), ALIGNOF(".rela.dyn_*driver_flash.o")))
		{ KEEP(*driver_flash.o(rela.dyn )) KEEP(*drv_uart.o(rela.dyn )) KEEP(*driver_uart2.o(rela.dyn )) KEEP(*fal_flash.o(rela.dyn )) KEEP(*fal_partition.o(rela.dyn )) KEEP(*data_move.o(rela.dyn )) KEEP(*inflate.o(rela.dyn )) KEEP(*driver_flash.o(.rela__libc_subfreeres )) KEEP(*drv_uart.o(.rela__libc_subfreeres )) KEEP(*driver_uart2.o(.rela__libc_subfreeres )) KEEP(*fal_flash.o(.rela__libc_subfreeres )) KEEP(*fal_partition.o(.rela__libc_subfreeres )) KEEP(*data_move.o(.rela__libc_subfreeres )) KEEP(*inflate.o(.rela__libc_subfreeres )) KEEP(*driver_flash.o(.rela__libc_atexit )) KEEP(*drv_uart.o(.rela__libc_atexit )) KEEP(*driver_uart2.o(.rela__libc_atexit )) KEEP(*fal_flash.o(.rela__libc_atexit )) KEEP(*fal_partition.o(.rela__libc_atexit )) KEEP(*data_move.o(.rela__libc_atexit )) KEEP(*inflate.o(.rela__libc_atexit )) KEEP(*driver_flash.o(.rela__libc_thread_subfreeres )) KEEP(*drv_uart.o(.rela__libc_thread_subfreeres )) KEEP(*driver_uart2.o(.rela__libc_thread_subfreeres )) KEEP(*fal_flash.o(.rela__libc_thread_subfreeres )) KEEP(*fal_partition.o(.rela__libc_thread_subfreeres )) KEEP(*data_move.o(.rela__libc_thread_subfreeres )) KEEP(*inflate.o(.rela__libc_thread_subfreeres )) KEEP(*driver_flash.o(.rela.init_array )) KEEP(*drv_uart.o(.rela.init_array )) KEEP(*driver_uart2.o(.rela.init_array )) KEEP(*fal_flash.o(.rela.init_array )) KEEP(*fal_partition.o(.rela.init_array )) KEEP(*data_move.o(.rela.init_array )) KEEP(*inflate.o(.rela.init_array )) KEEP(*driver_flash.o(.rela.fini_array )) KEEP(*drv_uart.o(.rela.fini_array )) KEEP(*driver_uart2.o(.rela.fini_array )) KEEP(*fal_flash.o(.rela.fini_array )) KEEP(*fal_partition.o(.rela.fini_array )) KEEP(*data_move.o(.rela.fini_array )) KEEP(*inflate.o(.rela.fini_array )) }
	. = ALIGN(ALIGNOF(".rela.got_*driver_flash.o"));
	".rela.got_*driver_flash.o" 	: AT(ALIGN(LOADADDR (".rela.dyn_*driver_flash.o") + SIZEOF (".rela.dyn_*driver_flash.o"), ALIGNOF(".rela.got_*driver_flash.o")))
		{ KEEP(*driver_flash.o(.rela.got )) KEEP(*drv_uart.o(.rela.got )) KEEP(*driver_uart2.o(.rela.got )) KEEP(*fal_flash.o(.rela.got )) KEEP(*fal_partition.o(.rela.got )) KEEP(*data_move.o(.rela.got )) KEEP(*inflate.o(.rela.got )) }
	. = ALIGN(ALIGNOF(".rela.sdata_*driver_flash.o"));
	".rela.sdata_*driver_flash.o" 	: AT(ALIGN(LOADADDR (".rela.got_*driver_flash.o") + SIZEOF (".rela.got_*driver_flash.o"), ALIGNOF(".rela.sdata_*driver_flash.o")))
		{ KEEP(*driver_flash.o(.rela.sdata .rela.sdata.* .rela.gnu.linkonce.s.* )) KEEP(*drv_uart.o(.rela.sdata .rela.sdata.* .rela.gnu.linkonce.s.* )) KEEP(*driver_uart2.o(.rela.sdata .rela.sdata.* .rela.gnu.linkonce.s.* )) KEEP(*fal_flash.o(.rela.sdata .rela.sdata.* .rela.gnu.linkonce.s.* )) KEEP(*fal_partition.o(.rela.sdata .rela.sdata.* .rela.gnu.linkonce.s.* )) KEEP(*data_move.o(.rela.sdata .rela.sdata.* .rela.gnu.linkonce.s.* )) KEEP(*inflate.o(.rela.sdata .rela.sdata.* .rela.gnu.linkonce.s.* )) }
	. = ALIGN(ALIGNOF(".rela.sbss_*driver_flash.o"));
	".rela.sbss_*driver_flash.o" 	: AT(ALIGN(LOADADDR (".rela.sdata_*driver_flash.o") + SIZEOF (".rela.sdata_*driver_flash.o"), ALIGNOF(".rela.sbss_*driver_flash.o")))
		{ KEEP(*driver_flash.o(.rela.sbss .rela.sbss.* .rela.gnu.linkonce.sb.* )) KEEP(*drv_uart.o(.rela.sbss .rela.sbss.* .rela.gnu.linkonce.sb.* )) KEEP(*driver_uart2.o(.rela.sbss .rela.sbss.* .rela.gnu.linkonce.sb.* )) KEEP(*fal_flash.o(.rela.sbss .rela.sbss.* .rela.gnu.linkonce.sb.* )) KEEP(*fal_partition.o(.rela.sbss .rela.sbss.* .rela.gnu.linkonce.sb.* )) KEEP(*data_move.o(.rela.sbss .rela.sbss.* .rela.gnu.linkonce.sb.* )) KEEP(*inflate.o(.rela.sbss .rela.sbss.* .rela.gnu.linkonce.sb.* )) }
	. = ALIGN(ALIGNOF(".rela.sdata2_*driver_flash.o"));
	".rela.sdata2_*driver_flash.o" 	: AT(ALIGN(LOADADDR (".rela.sbss_*driver_flash.o") + SIZEOF (".rela.sbss_*driver_flash.o"), ALIGNOF(".rela.sdata2_*driver_flash.o")))
		{ KEEP(*driver_flash.o(.rela.sdata2 .rela.sdata2.* .rela.gnu.linkonce.s2.* )) KEEP(*drv_uart.o(.rela.sdata2 .rela.sdata2.* .rela.gnu.linkonce.s2.* )) KEEP(*driver_uart2.o(.rela.sdata2 .rela.sdata2.* .rela.gnu.linkonce.s2.* )) KEEP(*fal_flash.o(.rela.sdata2 .rela.sdata2.* .rela.gnu.linkonce.s2.* )) KEEP(*fal_partition.o(.rela.sdata2 .rela.sdata2.* .rela.gnu.linkonce.s2.* )) KEEP(*data_move.o(.rela.sdata2 .rela.sdata2.* .rela.gnu.linkonce.s2.* )) KEEP(*inflate.o(.rela.sdata2 .rela.sdata2.* .rela.gnu.linkonce.s2.* )) }
	. = ALIGN(ALIGNOF(".rela.sbss2_*driver_flash.o"));
	".rela.sbss2_*driver_flash.o" 	: AT(ALIGN(LOADADDR (".rela.sdata2_*driver_flash.o") + SIZEOF (".rela.sdata2_*driver_flash.o"), ALIGNOF(".rela.sbss2_*driver_flash.o")))
		{ KEEP(*driver_flash.o(.rela.sbss2 .rela.sbss2.* .rela.gnu.linkonce.sb2.* )) KEEP(*drv_uart.o(.rela.sbss2 .rela.sbss2.* .rela.gnu.linkonce.sb2.* )) KEEP(*driver_uart2.o(.rela.sbss2 .rela.sbss2.* .rela.gnu.linkonce.sb2.* )) KEEP(*fal_flash.o(.rela.sbss2 .rela.sbss2.* .rela.gnu.linkonce.sb2.* )) KEEP(*fal_partition.o(.rela.sbss2 .rela.sbss2.* .rela.gnu.linkonce.sb2.* )) KEEP(*data_move.o(.rela.sbss2 .rela.sbss2.* .rela.gnu.linkonce.sb2.* )) KEEP(*inflate.o(.rela.sbss2 .rela.sbss2.* .rela.gnu.linkonce.sb2.* )) }
	. = ALIGN(ALIGNOF(".rela.bss_*driver_flash.o"));
	".rela.bss_*driver_flash.o" 	: AT(ALIGN(LOADADDR (".rela.sbss2_*driver_flash.o") + SIZEOF (".rela.sbss2_*driver_flash.o"), ALIGNOF(".rela.bss_*driver_flash.o")))
		{ KEEP(*driver_flash.o(.rela.bss .rela.bss.* .rela.gnu.linkonce.b.* )) KEEP(*drv_uart.o(.rela.bss .rela.bss.* .rela.gnu.linkonce.b.* )) KEEP(*driver_uart2.o(.rela.bss .rela.bss.* .rela.gnu.linkonce.b.* )) KEEP(*fal_flash.o(.rela.bss .rela.bss.* .rela.gnu.linkonce.b.* )) KEEP(*fal_partition.o(.rela.bss .rela.bss.* .rela.gnu.linkonce.b.* )) KEEP(*data_move.o(.rela.bss .rela.bss.* .rela.gnu.linkonce.b.* )) KEEP(*inflate.o(.rela.bss .rela.bss.* .rela.gnu.linkonce.b.* )) }
	. = ALIGN(ALIGNOF(".rela.plt_*driver_flash.o"));
	".rela.plt_*driver_flash.o" 	: AT(ALIGN(LOADADDR (".rela.bss_*driver_flash.o") + SIZEOF (".rela.bss_*driver_flash.o"), ALIGNOF(".rela.plt_*driver_flash.o")))
		{ KEEP(*driver_flash.o(.rela.plt )) KEEP(*drv_uart.o(.rela.plt )) KEEP(*driver_uart2.o(.rela.plt )) KEEP(*fal_flash.o(.rela.plt )) KEEP(*fal_partition.o(.rela.plt )) KEEP(*data_move.o(.rela.plt )) KEEP(*inflate.o(.rela.plt )) }
	. = ALIGN(ALIGNOF(".init_*driver_flash.o"));
	".init_*driver_flash.o" 	: AT(ALIGN(LOADADDR (".rela.plt_*driver_flash.o") + SIZEOF (".rela.plt_*driver_flash.o"), ALIGNOF(".init_*driver_flash.o")))
		{ KEEP(*driver_flash.o(.init )) KEEP(*drv_uart.o(.init )) KEEP(*driver_uart2.o(.init )) KEEP(*fal_flash.o(.init )) KEEP(*fal_partition.o(.init )) KEEP(*data_move.o(.init )) KEEP(*inflate.o(.init )) }
	. = ALIGN(ALIGNOF(".plt_*driver_flash.o"));
	".plt_*driver_flash.o" 	: AT(ALIGN(LOADADDR (".init_*driver_flash.o") + SIZEOF (".init_*driver_flash.o"), ALIGNOF(".plt_*driver_flash.o")))
		{ KEEP(*driver_flash.o(.plt )) KEEP(*drv_uart.o(.plt )) KEEP(*driver_uart2.o(.plt )) KEEP(*fal_flash.o(.plt )) KEEP(*fal_partition.o(.plt )) KEEP(*data_move.o(.plt )) KEEP(*inflate.o(.plt )) }
	. = ALIGN(ALIGNOF(".text_*driver_flash.o"));
	".text_*driver_flash.o" 	: AT(ALIGN(LOADADDR (".plt_*driver_flash.o") + SIZEOF (".plt_*driver_flash.o"), ALIGNOF(".text_*driver_flash.o")))
		{ KEEP(*driver_flash.o(.text .stub .text.* .gnu.linkonce.t.* )) KEEP(*drv_uart.o(.text .stub .text.* .gnu.linkonce.t.* )) KEEP(*driver_uart2.o(.text .stub .text.* .gnu.linkonce.t.* )) KEEP(*fal_flash.o(.text .stub .text.* .gnu.linkonce.t.* )) KEEP(*fal_partition.o(.text .stub .text.* .gnu.linkonce.t.* )) KEEP(*data_move.o(.text .stub .text.* .gnu.linkonce.t.* )) KEEP(*inflate.o(.text .stub .text.* .gnu.linkonce.t.* )) KEEP(*driver_flash.o(.text.*personality* )) KEEP(*drv_uart.o(.text.*personality* )) KEEP(*driver_uart2.o(.text.*personality* )) KEEP(*fal_flash.o(.text.*personality* )) KEEP(*fal_partition.o(.text.*personality* )) KEEP(*data_move.o(.text.*personality* )) KEEP(*inflate.o(.text.*personality* )) KEEP(*driver_flash.o(.gnu.warning )) KEEP(*drv_uart.o(.gnu.warning )) KEEP(*driver_uart2.o(.gnu.warning )) KEEP(*fal_flash.o(.gnu.warning )) KEEP(*fal_partition.o(.gnu.warning )) KEEP(*data_move.o(.gnu.warning )) KEEP(*inflate.o(.gnu.warning )) . = ALIGN(4); } = 0x0100
	. = ALIGN(ALIGNOF(".fini_*driver_flash.o"));
	".fini_*driver_flash.o" 	: AT(ALIGN(LOADADDR (".text_*driver_flash.o") + SIZEOF (".text_*driver_flash.o"), ALIGNOF(".fini_*driver_flash.o")))
		{ KEEP(*driver_flash.o(.fini )) KEEP(*drv_uart.o(.fini )) KEEP(*driver_uart2.o(.fini )) KEEP(*fal_flash.o(.fini )) KEEP(*fal_partition.o(.fini )) KEEP(*data_move.o(.fini )) KEEP(*inflate.o(.fini )) }
	. = ALIGN(ALIGNOF(".exec.itable_*driver_flash.o"));
	".exec.itable_*driver_flash.o" 	: AT(ALIGN(LOADADDR (".fini_*driver_flash.o") + SIZEOF (".fini_*driver_flash.o"), ALIGNOF(".exec.itable_*driver_flash.o")))
		{ KEEP(*driver_flash.o(.exec.itable )) KEEP(*drv_uart.o(.exec.itable )) KEEP(*driver_uart2.o(.exec.itable )) KEEP(*fal_flash.o(.exec.itable )) KEEP(*fal_partition.o(.exec.itable )) KEEP(*data_move.o(.exec.itable )) KEEP(*inflate.o(.exec.itable )) }
	PROVIDE (__etext = .);
	PROVIDE (_etext = .);
	PROVIDE (etext = .);
	. = ALIGN(ALIGNOF(".rodata_*driver_flash.o"));
	".rodata_*driver_flash.o" 	: AT(ALIGN(LOADADDR (".exec.itable_*driver_flash.o") + SIZEOF (".exec.itable_*driver_flash.o"), ALIGNOF(".rodata_*driver_flash.o")))
		{ KEEP(*driver_flash.o(.rodata .rodata.* .gnu.linkonce.r.* )) KEEP(*drv_uart.o(.rodata .rodata.* .gnu.linkonce.r.* )) KEEP(*driver_uart2.o(.rodata .rodata.* .gnu.linkonce.r.* )) KEEP(*fal_flash.o(.rodata .rodata.* .gnu.linkonce.r.* )) KEEP(*fal_partition.o(.rodata .rodata.* .gnu.linkonce.r.* )) KEEP(*data_move.o(.rodata .rodata.* .gnu.linkonce.r.* )) KEEP(*inflate.o(.rodata .rodata.* .gnu.linkonce.r.* )) }
	. = ALIGN(ALIGNOF(".rodata1_*driver_flash.o"));
	".rodata1_*driver_flash.o" 	: AT(ALIGN(LOADADDR (".rodata_*driver_flash.o") + SIZEOF (".rodata_*driver_flash.o"), ALIGNOF(".rodata1_*driver_flash.o")))
		{ KEEP(*driver_flash.o(.rodata1 )) KEEP(*drv_uart.o(.rodata1 )) KEEP(*driver_uart2.o(.rodata1 )) KEEP(*fal_flash.o(.rodata1 )) KEEP(*fal_partition.o(.rodata1 )) KEEP(*data_move.o(.rodata1 )) KEEP(*inflate.o(.rodata1 )) }
	. = ALIGN(ALIGNOF(".sdata2_*driver_flash.o"));
	".sdata2_*driver_flash.o" 	: AT(ALIGN(LOADADDR (".rodata1_*driver_flash.o") + SIZEOF (".rodata1_*driver_flash.o"), ALIGNOF(".sdata2_*driver_flash.o")))
		{ KEEP(*driver_flash.o(.sdata2 .sdata2.* .gnu.linkonce.s2.* )) KEEP(*drv_uart.o(.sdata2 .sdata2.* .gnu.linkonce.s2.* )) KEEP(*driver_uart2.o(.sdata2 .sdata2.* .gnu.linkonce.s2.* )) KEEP(*fal_flash.o(.sdata2 .sdata2.* .gnu.linkonce.s2.* )) KEEP(*fal_partition.o(.sdata2 .sdata2.* .gnu.linkonce.s2.* )) KEEP(*data_move.o(.sdata2 .sdata2.* .gnu.linkonce.s2.* )) KEEP(*inflate.o(.sdata2 .sdata2.* .gnu.linkonce.s2.* )) }
	. = ALIGN(ALIGNOF(".sbss2_*driver_flash.o"));
	".sbss2_*driver_flash.o" 	: AT(ALIGN(LOADADDR (".sdata2_*driver_flash.o") + SIZEOF (".sdata2_*driver_flash.o"), ALIGNOF(".sbss2_*driver_flash.o")))
		{ KEEP(*driver_flash.o(.sbss2 .sbss2.* .gnu.linkonce.sb2.* )) KEEP(*drv_uart.o(.sbss2 .sbss2.* .gnu.linkonce.sb2.* )) KEEP(*driver_uart2.o(.sbss2 .sbss2.* .gnu.linkonce.sb2.* )) KEEP(*fal_flash.o(.sbss2 .sbss2.* .gnu.linkonce.sb2.* )) KEEP(*fal_partition.o(.sbss2 .sbss2.* .gnu.linkonce.sb2.* )) KEEP(*data_move.o(.sbss2 .sbss2.* .gnu.linkonce.sb2.* )) KEEP(*inflate.o(.sbss2 .sbss2.* .gnu.linkonce.sb2.* )) }
	. = ALIGN(ALIGNOF(".eh_frame_hdr_*driver_flash.o"));
	".eh_frame_hdr_*driver_flash.o" 	: AT(ALIGN(LOADADDR (".sbss2_*driver_flash.o") + SIZEOF (".sbss2_*driver_flash.o"), ALIGNOF(".eh_frame_hdr_*driver_flash.o")))
		{ KEEP(*driver_flash.o(.eh_frame_hdr )) KEEP(*drv_uart.o(.eh_frame_hdr )) KEEP(*driver_uart2.o(.eh_frame_hdr )) KEEP(*fal_flash.o(.eh_frame_hdr )) KEEP(*fal_partition.o(.eh_frame_hdr )) KEEP(*data_move.o(.eh_frame_hdr )) KEEP(*inflate.o(.eh_frame_hdr )) }
	. = ALIGN(8);
	.itcm_write_flash 	: AT(ALIGN(ALIGN(LOADADDR (".eh_frame_hdr_*driver_flash.o") + SIZEOF (".eh_frame_hdr_*driver_flash.o"), ALIGNOF(.itcm_write_flash)), 8))
		{ KEEP(*(.itcm_write_flash )) }
	_itcm_lma_end =  LOADADDR (.itcm_write_flash) + SIZEOF (.itcm_write_flash);
	_itcm_ema_end = .;
	ITCM_SIZE = . - ITCM_BEGIN;
	. = 0x30000000;
	SRAM2_BEGIN = .;
	_data_lmastart =  LOADADDR (.itcm_write_flash) + SIZEOF (.itcm_write_flash);
	_data_start = .;
	. = ALIGN(8);
	. = ALIGN(0x20);
	. = ALIGN(ALIGNOF(.eh_frame));
	.eh_frame 	: AT(ALIGN(LOADADDR (.itcm_write_flash) + SIZEOF (.itcm_write_flash), 32))
		{ KEEP(*(.eh_frame )) }
	. = ALIGN(ALIGNOF(.gcc_except_table));
	.gcc_except_table 	: AT(ALIGN(LOADADDR (.eh_frame) + SIZEOF (.eh_frame), ALIGNOF(.gcc_except_table)))
		{ KEEP(*(.gcc_except_table )) *(.gcc_except_table.* ) }
	. = ALIGN(ALIGNOF(.tdata));
	.tdata 	: AT(ALIGN(LOADADDR (.gcc_except_table) + SIZEOF (.gcc_except_table), ALIGNOF(.tdata)))
		{ *(.tdata .tdata.* .gnu.linkonce.td.* ) }
	. = ALIGN(8);
	. = ALIGN(ALIGNOF(.preinit_array));
	.preinit_array 	: AT(ALIGN(ALIGN(LOADADDR (.tdata) + SIZEOF (.tdata), ALIGNOF(.preinit_array)), 8))
		{; PROVIDE (__preinit_array_start = .); KEEP(*(.preinit_array )); PROVIDE (__preinit_array_end = .); }
	. = ALIGN(ALIGNOF(.init_array));
	.init_array 	: AT(ALIGN(LOADADDR (.preinit_array) + SIZEOF (.preinit_array), ALIGNOF(.init_array)))
		{; PROVIDE (__init_array_start = .); KEEP(*(SORT_BY_INIT_PRIORITY(.init_array.* ))) KEEP(*(.init_array )); PROVIDE (__init_array_end = .); }
	. = ALIGN(ALIGNOF(.fini_array));
	.fini_array 	: AT(ALIGN(LOADADDR (.init_array) + SIZEOF (.init_array), ALIGNOF(.fini_array)))
		{; PROVIDE (__fini_array_start = .); KEEP(*(SORT_BY_INIT_PRIORITY(.fini_array.* ))) KEEP(*(.fini_array )); PROVIDE (__fini_array_end = .); }
	. = ALIGN(ALIGNOF(.tm_clone_table));
	.tm_clone_table 	: AT(ALIGN(LOADADDR (.fini_array) + SIZEOF (.fini_array), ALIGNOF(.tm_clone_table)))
		{ *(.tm_clone_table ) }
	. = ALIGN(ALIGNOF(.ctors));
	.ctors 	: AT(ALIGN(LOADADDR (.tm_clone_table) + SIZEOF (.tm_clone_table), ALIGNOF(.ctors)))
		{ KEEP(*crtbegin*.o(.ctors)) KEEP(*(EXCLUDE_FILE (*crtend*.o) .ctors)) KEEP(*(SORT(.ctors.* ))) KEEP(*(.ctors )) }
	. = ALIGN(ALIGNOF(.dtors));
	.dtors 	: AT(ALIGN(LOADADDR (.ctors) + SIZEOF (.ctors), ALIGNOF(.dtors)))
		{ KEEP(*crtbegin*.o(.dtors)) KEEP(*(EXCLUDE_FILE (*crtend*.o) .dtors)) KEEP(*(SORT(.dtors.* ))) KEEP(*(.dtors )) }
	. = ALIGN(ALIGNOF(.jcr));
	.jcr 	: AT(ALIGN(LOADADDR (.dtors) + SIZEOF (.dtors), ALIGNOF(.jcr)))
		{ KEEP(*(.jcr )) }
	. = ALIGN(ALIGNOF(.data.rel.ro));
	.data.rel.ro 	: AT(ALIGN(LOADADDR (.jcr) + SIZEOF (.jcr), ALIGNOF(.data.rel.ro)))
		{ *(.data.rel.ro.local ) *(.data.rel.ro* ) }
	. = ALIGN(ALIGNOF(.dynamic));
	.dynamic 	: AT(ALIGN(LOADADDR (.data.rel.ro) + SIZEOF (.data.rel.ro), ALIGNOF(.dynamic)))
		{ *(.dynamic ) }
	. = ALIGN(8);
	. = ALIGN(ALIGNOF(.got));
	.got 	: AT(ALIGN(ALIGN(LOADADDR (.dynamic) + SIZEOF (.dynamic), ALIGNOF(.got)), 8))
		{ *(.got.plt ) *(.got ) }
	. = ALIGN(ALIGNOF(.data));
	.data 	: AT(ALIGN(LOADADDR (.got) + SIZEOF (.got), ALIGNOF(.data)))
		{ *(.data .data.* .gnu.linkonce.d.* ) KEEP(*(.gnu.linkonce.d.*personality* )) SORT(CONSTRUCTORS) . = ALIGN(8); }
	. = ALIGN(ALIGNOF(.data1));
	.data1 	: AT(ALIGN(LOADADDR (.data) + SIZEOF (.data), ALIGNOF(.data1)))
		{ *(.data1 ) . = ALIGN(8); }
	. = ALIGN(8);
	. = ALIGN(ALIGNOF(.sdata));
	.sdata 	: AT(ALIGN(ALIGN(LOADADDR (.data1) + SIZEOF (.data1), ALIGNOF(.sdata)), 8))
		{ *(.srodata.cst16 ) *(.srodata.cst8 ) *(.srodata.cst4 ) *(.srodata.cst2 ) *(.srodata .srodata.* ) *(.sdata .sdata.* .gnu.linkonce.s.* ) }
	. = ALIGN(ALIGNOF(.sdata_d));
	.sdata_d 	: AT(ALIGN(LOADADDR (.sdata) + SIZEOF (.sdata), ALIGNOF(.sdata_d)))
		{ *(.sdata_d .sdata_d.* ) }
	. = ALIGN(ALIGNOF(.sdata_w));
	.sdata_w 	: AT(ALIGN(LOADADDR (.sdata_d) + SIZEOF (.sdata_d), ALIGNOF(.sdata_w)))
		{ *(.sdata_w .sdata_w.* ) }
	. = ALIGN(ALIGNOF(.sdata_h));
	.sdata_h 	: AT(ALIGN(LOADADDR (.sdata_w) + SIZEOF (.sdata_w), ALIGNOF(.sdata_h)))
		{ *(.sdata_h .sdata_h.* ) }
	. = ALIGN(ALIGNOF(.sdata_b));
	.sdata_b 	: AT(ALIGN(LOADADDR (.sdata_h) + SIZEOF (.sdata_h), ALIGNOF(.sdata_b)))
		{ *(.sdata_b .sdata_b.* ) }
	. = ALIGN(ALIGNOF(.sdata_f));
	.sdata_f 	: AT(ALIGN(LOADADDR (.sdata_b) + SIZEOF (.sdata_b), ALIGNOF(.sdata_f)))
		{ *(.sdata_f .sdata_f.* ) }
	. = ALIGN(8);
	_edata = .;
	PROVIDE (edata = .);
	. = ALIGN(8);
	__bss_start = .;
	PROVIDE (__sbss_start = .);
	PROVIDE (___sbss_start = .);
	.tbss 	(NOLOAD)	: { *(.tbss .tbss.* .gnu.linkonce.tb.* ) *(.tcommon ) }
	.sbss 	(NOLOAD)	: { *(.dynsbss ) *(.sbss .sbss.* .gnu.linkonce.sb.* ) *(.scommon .scommon.* ) }
	.sbss_f 	(NOLOAD)	: { *(.sbss_f .sbss_f.* ) *(.scommon_f .scommon_f.* ) }
	.sbss_b 	(NOLOAD)	: { *(.sbss_b .sbss_b.* ) *(.scommon_b .scommon_b.* ) . = ALIGN(2); }
	.sbss_h 	(NOLOAD)	: { *(.sbss_h .sbss_h.* ) *(.scommon_h .scommon_h.* ) . = ALIGN(4); }
	.sbss_w 	(NOLOAD)	: { *(.sbss_w .sbss_w.* ) *(.scommon_w .scommon_w.* ) *(.dynsbss ) *(.scommon ) . = ALIGN(8); }
	.sbss_d 	(NOLOAD)	: { *(.sbss_d .sbss_d.* ) *(.scommon_d .scommon_d.* ) }
	.bss 	(NOLOAD)	: { *(.dynbss ) *(.bss .bss.* .gnu.linkonce.b.* ) *(COMMON ) . = ALIGN(8); }
	PROVIDE (__sbss_end = .);
	PROVIDE (___sbss_end = .);
	. = ALIGN(8);
	_end = .;
	PROVIDE (end = .);
	PROVIDE (_stack = 0x30060000);
	SRAM2_SIZE = . - SRAM2_BEGIN;
	.stab	0 : { *(.stab) }
	.stabstr	0 : { *(.stabstr) }
	.stab.excl	0 : { *(.stab.excl) }
	.stab.exclstr	0 : { *(.stab.exclstr) }
	.stab.index	0 : { *(.stab.index) }
	.stab.indexstr	0 : { *(.stab.indexstr) }
	.comment	0 : { *(.comment) }
	.debug	0 : { *(.debug) }
	.line	0 : { *(.line) }
	.debug_srcinfo	0 : { *(.debug_srcinfo) }
	.debug_sfnames	0 : { *(.debug_sfnames) }
	.debug_aranges	0 : { *(.debug_aranges) }
	.debug_pubnames	0 : { *(.debug_pubnames) }
	.debug_info	0 : { *(.debug_info .gnu.linkonce.wi.*) }
	.debug_abbrev	0 : { *(.debug_abbrev) }
	.debug_line	0 : { *(.debug_line) }
	.debug_frame	0 : { *(.debug_frame) }
	.debug_str	0 : { *(.debug_str) }
	.debug_loc	0 : { *(.debug_loc) }
	.debug_macinfo	0 : { *(.debug_macinfo) }
	.debug_weaknames	0 : { *(.debug_weaknames) }
	.debug_funcnames	0 : { *(.debug_funcnames) }
	.debug_typenames	0 : { *(.debug_typenames) }
	.debug_varnames	0 : { *(.debug_varnames) }
}
ASSERT((DEFINED (_RELAX_END_) ? ITCM_SIZE : 0x0)<= 0x8000, "ITCM OVERFLOW");
ASSERT((DEFINED (_RELAX_END_) ? SRAM2_SIZE : 0x0)<= 0x50000, "SRAM2 OVERFLOW");
