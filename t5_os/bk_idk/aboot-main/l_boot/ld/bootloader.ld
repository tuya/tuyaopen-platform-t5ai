/* This file is generated by nds_ldsag (version (2021-07-02) ). */
ENTRY(_start)
SECTIONS
{
	PROVIDE (__executable_start = 0x00000000);
	NDS_SAG_LMA_bootloader = 0x00000000 ;
	. = 0x00000000;
	.nds_vector 	: { *(.nds_vector ) }
	. = ALIGN(8);
	. = ALIGN(ALIGNOF(.nds32_init));
	.nds32_init 	: { KEEP(*(.nds32_init )) } = 0x9200
	. = ALIGN(ALIGNOF(.interp));
	.interp 	: { *(.interp ) }
	. = ALIGN(ALIGNOF(.note.gnu.build-id));
	.note.gnu.build-id 	: { *(.note.gnu.build-id ) }
	. = ALIGN(ALIGNOF(.note.ABI-tag));
	.note.ABI-tag 	: { *(.note.ABI-tag ) }
	. = ALIGN(ALIGNOF(.hash));
	.hash 	: { *(.hash ) }
	. = ALIGN(ALIGNOF(.gnu.hash));
	.gnu.hash 	: { *(.gnu.hash ) }
	. = ALIGN(ALIGNOF(.dynsym));
	.dynsym 	: { *(.dynsym ) }
	. = ALIGN(ALIGNOF(.dynstr));
	.dynstr 	: { *(.dynstr ) }
	. = ALIGN(ALIGNOF(.gnu.version));
	.gnu.version 	: { *(.gnu.version ) }
	. = ALIGN(ALIGNOF(.gnu.version_d));
	.gnu.version_d 	: { *(.gnu.version_d ) }
	. = ALIGN(ALIGNOF(.gnu.version_r));
	.gnu.version_r 	: { *(.gnu.version_r ) }
	. = ALIGN(ALIGNOF(.rel.init));
	.rel.init 	: { *(.rel.init ) }
	. = ALIGN(ALIGNOF(.rela.init));
	.rela.init 	: { *(.rela.init ) }
	. = ALIGN(ALIGNOF(.rel.text));
	.rel.text 	: { *(.rel.text .rel.text.* .rel.gnu.linkonce.t.* ) }
	. = ALIGN(ALIGNOF(.rela.text));
	.rela.text 	: { *(.rela.text .rela.text.* .rela.gnu.linkonce.t.* ) }
	. = ALIGN(ALIGNOF(.rel.fini));
	.rel.fini 	: { *(.rel.fini ) }
	. = ALIGN(ALIGNOF(.rela.fini));
	.rela.fini 	: { *(.rela.fini ) }
	. = ALIGN(ALIGNOF(.rel.rodata));
	.rel.rodata 	: { *(.rel.rodata .rel.rodata.* .rel.gnu.linkonce.r.* ) }
	. = ALIGN(ALIGNOF(.rela.rodata));
	.rela.rodata 	: { *(.rela.rodata .rela.rodata.* .rela.gnu.linkonce.r.* ) }
	. = ALIGN(ALIGNOF(.rel.data.rel.ro));
	.rel.data.rel.ro 	: { *(.rel.data.rel.ro* ) }
	. = ALIGN(ALIGNOF(.rela.data.rel.ro));
	.rela.data.rel.ro 	: { *(.rel.data.rel.ro* ) }
	. = ALIGN(ALIGNOF(.rel.data));
	.rel.data 	: { *(.rel.data .rel.data.* .rel.gnu.linkonce.d.* ) }
	. = ALIGN(ALIGNOF(.rela.data));
	.rela.data 	: { *(.rela.data .rela.data.* .rela.gnu.linkonce.d.* ) }
	. = ALIGN(ALIGNOF(.rel.tdata));
	.rel.tdata 	: { *(.rel.tdata .rel.tdata.* .rel.gnu.linkonce.td.* ) }
	. = ALIGN(ALIGNOF(.rela.tdata));
	.rela.tdata 	: { *(.rela.tdata .rela.tdata.* .rela.gnu.linkonce.td.* ) }
	. = ALIGN(ALIGNOF(.rel.tbss));
	.rel.tbss 	: { *(.rel.tbss .rel.tbss.* .rel.gnu.linkonce.tb.* ) }
	. = ALIGN(ALIGNOF(.rela.tbss));
	.rela.tbss 	: { *(.rela.tbss .rela.tbss.* .rela.gnu.linkonce.tb.* ) }
	. = ALIGN(ALIGNOF(.rel.ctors));
	.rel.ctors 	: { *(.rel.ctors ) }
	. = ALIGN(ALIGNOF(.rela.ctors));
	.rela.ctors 	: { *(.rela.ctors ) }
	. = ALIGN(ALIGNOF(.rel.dtors));
	.rel.dtors 	: { *(.rel.dtors ) }
	. = ALIGN(ALIGNOF(.rela.dtors));
	.rela.dtors 	: { *(.rela.dtors ) }
	. = ALIGN(ALIGNOF(.rela.dyn));
	.rela.dyn 	: { *(rela.dyn ) *(.rela__libc_subfreeres ) *(.rela__libc_atexit ) *(.rela__libc_thread_subfreeres ) *(.rela.init_array ) *(.rela.fini_array ) }
	. = ALIGN(ALIGNOF(.rel.got));
	.rel.got 	: { *(.rel.got ) }
	. = ALIGN(ALIGNOF(.rela.got));
	.rela.got 	: { *(.rela.got ) }
	. = ALIGN(ALIGNOF(.rel.sdata));
	.rel.sdata 	: { *(.rel.sdata .rel.sdata.* .rel.gnu.linkonce.s.* ) }
	. = ALIGN(ALIGNOF(.rela.sdata));
	.rela.sdata 	: { *(.rela.sdata .rela.sdata.* .rela.gnu.linkonce.s.* ) }
	. = ALIGN(ALIGNOF(.rel.sbss));
	.rel.sbss 	: { *(.rel.sbss .rel.sbss.* .rel.gnu.linkonce.sb.* ) }
	. = ALIGN(ALIGNOF(.rela.sbss));
	.rela.sbss 	: { *(.rela.sbss .rela.sbss.* .rela.gnu.linkonce.sb.* ) }
	. = ALIGN(ALIGNOF(.rel.sdata2));
	.rel.sdata2 	: { *(.rel.sdata2 .rel.sdata2.* .rel.gnu.linkonce.s2.* ) }
	. = ALIGN(ALIGNOF(.rela.sdata2));
	.rela.sdata2 	: { *(.rela.sdata2 .rela.sdata2.* .rela.gnu.linkonce.s2.* ) }
	. = ALIGN(ALIGNOF(.rel.sbss2));
	.rel.sbss2 	: { *(.rel.sbss2 .rel.sbss2.* .rel.gnu.linkonce.sb2.* ) }
	. = ALIGN(ALIGNOF(.rela.sbss2));
	.rela.sbss2 	: { *(.rela.sbss2 .rela.sbss2.* .rela.gnu.linkonce.sb2.* ) }
	. = ALIGN(ALIGNOF(.rel.bss));
	.rel.bss 	: { *(.rel.bss .rel.bss.* .rel.gnu.linkonce.b.* ) }
	. = ALIGN(ALIGNOF(.rela.bss));
	.rela.bss 	: { *(.rela.bss .rela.bss.* .rela.gnu.linkonce.b.* ) }
	. = ALIGN(ALIGNOF(.rel.plt));
	.rel.plt 	: { *(.rel.plt ) }
	. = ALIGN(ALIGNOF(.rela.plt));
	.rela.plt 	: { *(.rela.plt ) }
	. = ALIGN(ALIGNOF(.init));
	.init 	: { KEEP(*(.init )) }
	. = ALIGN(ALIGNOF(.plt));
	.plt 	: { *(.plt ) }
	. = ALIGN(ALIGNOF(.text));
	.text 	: { *(.text .stub .text.* .gnu.linkonce.t.* ) KEEP(*(.text.*personality* )) *(.gnu.warning ) . = ALIGN(4); } = 0x9200
	. = ALIGN(ALIGNOF(.fini));
	.fini 	: { KEEP(*(.fini )) }
	. = ALIGN(ALIGNOF(.ex9.itable));
	.ex9.itable 	: { *(.ex9.itable ) }
	PROVIDE (__etext = .);
	PROVIDE (_etext = .);
	PROVIDE (etext = .);
	. = ALIGN(ALIGNOF(.rodata));
	.rodata 	: { *(.rodata .rodata.* .gnu.linkonce.r.* ) }
	. = ALIGN(ALIGNOF(.rodata1));
	.rodata1 	: { *(.rodata1 ) }
	. = ALIGN(ALIGNOF(.sdata2));
	.sdata2 	: { *(.sdata2 .sdata2.* .gnu.linkonce.s2.* ) }
	. = ALIGN(ALIGNOF(.sbss2));
	.sbss2 	: { *(.sbss2 .sbss2.* .gnu.linkonce.sb2.* ) }
	. = ALIGN(ALIGNOF(.eh_frame_hdr));
	.eh_frame_hdr 	: { *(.eh_frame_hdr ) }
	. = 0x10000000;
	ITCM_BEGIN = .;
	. = ALIGN(8);
	. = ALIGN(ALIGNOF(".nds32_init_*main.c.obj"));
	".nds32_init_*main.c.obj" 	: AT(ALIGN(ALIGN(LOADADDR (.eh_frame_hdr) + SIZEOF (.eh_frame_hdr), ALIGNOF(".nds32_init_*main.c.obj")), 8))
		{ KEEP(*main.c.obj(.nds32_init )) } = 0x9200
	_itcm_lma_start =  LOADADDR (".nds32_init_*main.c.obj");
	_itcm_ema_start = ADDR(".nds32_init_*main.c.obj");
	. = ALIGN(ALIGNOF(".init_*main.c.obj"));
	".init_*main.c.obj" 	: AT(ALIGN(LOADADDR (".nds32_init_*main.c.obj") + SIZEOF (".nds32_init_*main.c.obj"), ALIGNOF(".init_*main.c.obj")))
		{ KEEP(*main.c.obj(.init )) }
	. = ALIGN(ALIGNOF(".plt_*main.c.obj"));
	".plt_*main.c.obj" 	: AT(ALIGN(LOADADDR (".init_*main.c.obj") + SIZEOF (".init_*main.c.obj"), ALIGNOF(".plt_*main.c.obj")))
		{ *main.c.obj(.plt ) }
	. = ALIGN(ALIGNOF(".text_*main.c.obj"));
	".text_*main.c.obj" 	: AT(ALIGN(LOADADDR (".plt_*main.c.obj") + SIZEOF (".plt_*main.c.obj"), ALIGNOF(".text_*main.c.obj")))
		{ *main.c.obj(.text .stub .text.* .gnu.linkonce.t.* ) KEEP(*main.c.obj(.text.*personality* )) *main.c.obj(.gnu.warning ) . = ALIGN(4); } = 0x9200
	. = ALIGN(ALIGNOF(".fini_*main.c.obj"));
	".fini_*main.c.obj" 	: AT(ALIGN(LOADADDR (".text_*main.c.obj") + SIZEOF (".text_*main.c.obj"), ALIGNOF(".fini_*main.c.obj")))
		{ KEEP(*main.c.obj(.fini )) }
	. = ALIGN(ALIGNOF(".ex9.itable_*main.c.obj"));
	".ex9.itable_*main.c.obj" 	: AT(ALIGN(LOADADDR (".fini_*main.c.obj") + SIZEOF (".fini_*main.c.obj"), ALIGNOF(".ex9.itable_*main.c.obj")))
		{ *main.c.obj(.ex9.itable ) }
	PROVIDE (__etext = .);
	PROVIDE (_etext = .);
	PROVIDE (etext = .);
	_itcm_lma_end =  LOADADDR (".ex9.itable_*main.c.obj") + SIZEOF (".ex9.itable_*main.c.obj");
	_itcm_ema_end = .;
	ITCM_SIZE = . - ITCM_BEGIN;
	. = 0x30010000;
	SRAM2_BEGIN = .;
	. = ALIGN(8);
	. = ALIGN(0x20);
	. = ALIGN(ALIGNOF(.eh_frame));
	.eh_frame 	: AT(ALIGN(LOADADDR (".ex9.itable_*main.c.obj") + SIZEOF (".ex9.itable_*main.c.obj"), 32))
		{ KEEP(*(.eh_frame )) }
	_data_lmastart =  LOADADDR (.eh_frame);
	_data_start = ADDR(.eh_frame);
	. = ALIGN(ALIGNOF(.gcc_except_table));
	.gcc_except_table 	: AT(ALIGN(LOADADDR (.eh_frame) + SIZEOF (.eh_frame), ALIGNOF(.gcc_except_table)))
		{ KEEP(*(.gcc_except_table )) *(.gcc_except_table.* ) }
	. = ALIGN(ALIGNOF(.tdata));
	.tdata 	: AT(ALIGN(LOADADDR (.gcc_except_table) + SIZEOF (.gcc_except_table), ALIGNOF(.tdata)))
		{ *(.tdata .tdata.* .gnu.linkonce.td.* ) }
	. = ALIGN(4);
	. = ALIGN(ALIGNOF(.preinit_array));
	.preinit_array 	: AT(ALIGN(ALIGN(LOADADDR (.tdata) + SIZEOF (.tdata), ALIGNOF(.preinit_array)), 4))
		{; PROVIDE (__preinit_array_start = .); KEEP(*(.preinit_array )); PROVIDE (__preinit_array_end = .); }
	. = ALIGN(ALIGNOF(.init_array));
	.init_array 	: AT(ALIGN(LOADADDR (.preinit_array) + SIZEOF (.preinit_array), ALIGNOF(.init_array)))
		{; PROVIDE (__init_array_start = .); KEEP(*(.init_array )); PROVIDE (__init_array_end = .); }
	. = ALIGN(ALIGNOF(.fini_array));
	.fini_array 	: AT(ALIGN(LOADADDR (.init_array) + SIZEOF (.init_array), ALIGNOF(.fini_array)))
		{; PROVIDE (__fini_array_start = .); KEEP(*(.fini_array )); PROVIDE (__fini_array_end = .); }
	. = ALIGN(ALIGNOF(.ctors));
	.ctors 	: AT(ALIGN(LOADADDR (.fini_array) + SIZEOF (.fini_array), ALIGNOF(.ctors)))
		{ KEEP(*crtbegin*.o(.ctors)) KEEP(*(EXCLUDE_FILE (*crtend*.o) .ctors)) KEEP(*(SORT(.ctors.* ))) KEEP(*(.ctors )) }
	. = ALIGN(ALIGNOF(.dtors));
	.dtors 	: AT(ALIGN(LOADADDR (.ctors) + SIZEOF (.ctors), ALIGNOF(.dtors)))
		{ KEEP(*crtbegin*.o(.dtors)) KEEP(*(EXCLUDE_FILE (*crtend*.o) .dtors)) KEEP(*(SORT(.dtors.* ))) KEEP(*(.dtors )) }
	. = ALIGN(ALIGNOF(.jcr));
	.jcr 	: AT(ALIGN(LOADADDR (.dtors) + SIZEOF (.dtors), ALIGNOF(.jcr)))
		{ KEEP(*(.jcr )) }
	. = ALIGN(ALIGNOF(.data.rel.ro));
	.data.rel.ro 	: AT(ALIGN(LOADADDR (.jcr) + SIZEOF (.jcr), ALIGNOF(.data.rel.ro)))
		{ *(.data.rel.ro.local ) *(.data.rel.ro* ) }
	. = ALIGN(ALIGNOF(.dynamic));
	.dynamic 	: AT(ALIGN(LOADADDR (.data.rel.ro) + SIZEOF (.data.rel.ro), ALIGNOF(.dynamic)))
		{ *(.dynamic ) }
	. = ALIGN(ALIGNOF(.data));
	.data 	: AT(ALIGN(LOADADDR (.dynamic) + SIZEOF (.dynamic), ALIGNOF(.data)))
		{ *(.data .data.* .gnu.linkonce.d.* ) KEEP(*(.gnu.linkonce.d.*personality* )) SORT(CONSTRUCTORS) . = ALIGN(8); }
	. = ALIGN(ALIGNOF(.data1));
	.data1 	: AT(ALIGN(LOADADDR (.data) + SIZEOF (.data), ALIGNOF(.data1)))
		{ *(.data1 ) . = ALIGN(8); }
	. = ALIGN(4);
	. = ALIGN(ALIGNOF(.got));
	.got 	: AT(ALIGN(ALIGN(LOADADDR (.data1) + SIZEOF (.data1), ALIGNOF(.got)), 4))
		{ *(.got.plt ) *(.got ) }
	. = ALIGN(ALIGNOF(.sdata));
	.sdata 	: AT(ALIGN(LOADADDR (.got) + SIZEOF (.got), ALIGNOF(.sdata)))
		{ *(.sdata .sdata.* .gnu.linkonce.s.* ) }
	. = ALIGN(ALIGNOF(.sdata_d));
	.sdata_d 	: AT(ALIGN(LOADADDR (.sdata) + SIZEOF (.sdata), ALIGNOF(.sdata_d)))
		{ *(.sdata_d .sdata_d.* ) }
	. = ALIGN(ALIGNOF(.sdata_w));
	.sdata_w 	: AT(ALIGN(LOADADDR (.sdata_d) + SIZEOF (.sdata_d), ALIGNOF(.sdata_w)))
		{ *(.sdata_w .sdata_w.* ) }
	. = ALIGN(ALIGNOF(.sdata_h));
	.sdata_h 	: AT(ALIGN(LOADADDR (.sdata_w) + SIZEOF (.sdata_w), ALIGNOF(.sdata_h)))
		{ *(.sdata_h .sdata_h.* ) }
	. = ALIGN(ALIGNOF(.sdata_b));
	.sdata_b 	: AT(ALIGN(LOADADDR (.sdata_h) + SIZEOF (.sdata_h), ALIGNOF(.sdata_b)))
		{ *(.sdata_b .sdata_b.* ) }
	. = ALIGN(ALIGNOF(.sdata_f));
	.sdata_f 	: AT(ALIGN(LOADADDR (.sdata_b) + SIZEOF (.sdata_b), ALIGNOF(.sdata_f)))
		{ *(.sdata_f .sdata_f.* ) }
	. = ALIGN(4);
	_edata = .;
	PROVIDE (edata = .);
	. = ALIGN(8);
	__bss_start = .;
	PROVIDE (__sbss_start = .);
	PROVIDE (___sbss_start = .);
	.tbss 	(NOLOAD)	: { *(.tbss .tbss.* .gnu.linkonce.tb.* ) *(.tcommon ) }
	.sbss 	(NOLOAD)	: { *(.dynsbss ) *(.sbss .sbss.* .gnu.linkonce.sb.* ) *(.scommon .scommon.* ) }
	.sbss_f 	(NOLOAD)	: { *(.sbss_f .sbss_f.* ) *(.scommon_f .scommon_f.* ) }
	.sbss_b 	(NOLOAD)	: { *(.sbss_b .sbss_b.* ) *(.scommon_b .scommon_b.* ) . = ALIGN(2); }
	.sbss_h 	(NOLOAD)	: { *(.sbss_h .sbss_h.* ) *(.scommon_h .scommon_h.* ) . = ALIGN(4); }
	.sbss_w 	(NOLOAD)	: { *(.sbss_w .sbss_w.* ) *(.scommon_w .scommon_w.* ) *(.dynsbss ) *(.scommon ) . = ALIGN(8); }
	.sbss_d 	(NOLOAD)	: { *(.sbss_d .sbss_d.* ) *(.scommon_d .scommon_d.* ) }
	.bss 	(NOLOAD)	: { *(.dynbss ) *(.bss .bss.* .gnu.linkonce.b.* ) *(COMMON ) . = ALIGN(4); }
	PROVIDE (__sbss_end = .);
	PROVIDE (___sbss_end = .);
	. = ALIGN(4);
	_end = .;
	PROVIDE (end = .);
	PROVIDE (_stack = 0x30040000);
	SRAM2_SIZE = . - SRAM2_BEGIN;
	.stab	0 : { *(.stab) }
	.stabstr	0 : { *(.stabstr) }
	.stab.excl	0 : { *(.stab.excl) }
	.stab.exclstr	0 : { *(.stab.exclstr) }
	.stab.index	0 : { *(.stab.index) }
	.stab.indexstr	0 : { *(.stab.indexstr) }
	.note.nds32	0 : { *(.note.nds32) *(.note.nds32.*) }
	.comment	0 : { *(.comment) }
	.debug	0 : { *(.debug) }
	.line	0 : { *(.line) }
	.debug_srcinfo	0 : { *(.debug_srcinfo) }
	.debug_sfnames	0 : { *(.debug_sfnames) }
	.debug_aranges	0 : { *(.debug_aranges) }
	.debug_pubnames	0 : { *(.debug_pubnames) }
	.debug_info	0 : { *(.debug_info .gnu.linkonce.wi.*) }
	.debug_abbrev	0 : { *(.debug_abbrev) }
	.debug_line	0 : { *(.debug_line) }
	.debug_frame	0 : { *(.debug_frame) }
	.debug_str	0 : { *(.debug_str) }
	.debug_loc	0 : { *(.debug_loc) }
	.debug_macinfo	0 : { *(.debug_macinfo) }
	.debug_weaknames	0 : { *(.debug_weaknames) }
	.debug_funcnames	0 : { *(.debug_funcnames) }
	.debug_typenames	0 : { *(.debug_typenames) }
	.debug_varnames	0 : { *(.debug_varnames) }
}
ASSERT((DEFINED (_RELAX_END_) ? ITCM_SIZE : 0x0)<= 0x8000, "ITCM OVERFLOW");
ASSERT((DEFINED (_RELAX_END_) ? SRAM2_SIZE : 0x0)<= 0x20000, "SRAM2 OVERFLOW");
