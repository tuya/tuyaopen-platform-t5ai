## t5_os/ap/components/littlefs/Kconfig
```kconfig
menu "Littlefs"
	config LITTLEFS
		bool "Enable Littlefs"
		default n

	choice LITTLEFS_PARTITION
		depends on LITTLEFS
		prompt "choose partition"
		default LITTLEFS_NO_CONFIG_PARTITION

		config LITTLEFS_USE_LITTLEFS_PARTITION
			depends on LITTLEFS
			bool "use littlefs partition as littlefs partition"
		config LITTLEFS_USE_USR_CONFIG_PARTITION
			depends on LITTLEFS
			bool "use usr_config partition as littlefs partition"
		config LITTLEFS_NO_CONFIG_PARTITION
			depends on LITTLEFS
			bool "no config littlefs partition"

	config LFS_THREADSAFE
		depends on "LITTLEFS"
		bool "Thread safe"
		default y

	endchoice
endmenu
```

## t5_os/ap/components/media_utils/Kconfig
```kconfig
menu "Media Utils"


	config PSRAM_MEDIA_MALLOC_ENABLE
		depends on PSRAM_AS_SYS_MEMORY
		bool "multimedia function use malloc psram as mem"
		default y

	config MEDIA_DEBUG_TIMER_ENABLE
		depends on MEDIA
		bool "enable software timer to printf some camera info"
		default y
endmenu
```

## t5_os/ap/components/webclient/Kconfig
```kconfig
menu "Webclient"
	config WEBCLIENT
		bool "Enable Webclient"
		default n
	config WEBCLIENT_TLS
		depends on WEBCLIENT && (MBEDTLS || PSA_MBEDTLS)
		bool "Enable Webclient"
		default n
endmenu
```

## t5_os/ap/middleware/driver/general_dma/Kconfig
```kconfig
menu "GENERAL_DMA"
	config GENERAL_DMA
		bool "Enable General DMA"
		default y

	config DMA_LOGIC_CHAN_CNT
		prompt "Current CPU-CORE software system uses how many dma-logic-channels. \
		        Total of all CPU-COREs dma logic chan count should be not bigger then total dma hardware supportted channels"
		int "12"
		default 12

	config DMA_LOGIC_CHAN_ID_MIN
		prompt "Current CPU-CORE software system min dma-logic-channel-id. \
		        Be care overlap the other CPU-CORE software system's dma-logic-channel-id. \
		        The value should be set like this: \
		        CPU0 is from 0; \
		        CPU1 is from CPU0_DMA_LOGIC_CHAN_CNT"
		int "0"
		default 0
endmenu
```

## t5_os/ap/middleware/driver/jpeg_dec/Kconfig
```kconfig
menu "JPEG_DEC"
	config JPEGDEC_HW
		bool "Enable JPEGDEC Display"
		default n

	config JPEGDEC_HW_SUPPORT_DRI
		depends on JPEGDEC_HW
		bool "Enable JPEGDEC support dri"
		default y

	config JPEGDEC_HW_SUPPORT_FFD9_CHECK
		depends on JPEGDEC_HW
		bool "Enable JPEGDEC ff d9 check"
		default n

endmenu
```

## t5_os/ap/middleware/driver/jpeg_enc/Kconfig
```kconfig
menu "JPEG_ENC"
	config JPEGENC_HW
		depends on YUV_BUF
		bool "Enable HardWare JPEG ENCODE"
		default n
endmenu
```

## t5_os/ap/middleware/driver/mailbox/Kconfig
```kconfig
menu "MAILBOX"
	config MAILBOX
		bool "Enable mail_box"
		default n

	config MAILBOX_V2_0
		bool "Use mailbox v2.0 driver"
		default n

	config MAILBOX_IPC
		bool "Enable mailbox socket ipc driver"
		default y

	config MAILBOX_IPC_API_TASK_STACK_SIZE
		int "Set MAILBOX IPC API Task Stack Size"
		default 2048
		help
			Stack size of MAILBOX IPC API Task

    config SLAVE_HEART_BEAT
		depends on MAILBOX
		bool "Enable heartbeat mechanism when dual core communication"
		default n
endmenu
```

## t5_os/ap/middleware/driver/otp/Kconfig
```kconfig
menu "OTP"
	config OTP_V1
		bool "Enable OTP function Version 1"
		default n

	config PHY_RFCALI_TO_OTP
		bool "Enable rfcali_to_otp"
		default n
		help
			Use OTP to save rfcali data

	config AON_ENCP
		bool "Always enable encp"
		default n
endmenu
```

## t5_os/ap/middleware/driver/psram/Kconfig
```kconfig
menu "PSRAM"
	config PSRAM
		bool "Enable PSRAM"
		default n

	config PSRAM_AS_SYS_MEMORY
		depends on PSRAM
		bool "Enable psram_malloc API"
		default n

	config PSRAM_WRITE_THROUGH
		depends on PSRAM
		bool "Enable PSRAM write through"
		default n

	config PSRAM_CALIBRATE
		depends on PSRAM
		bool "Enable PSRAM calibrate"
		default n

	config PSRAM_AUTO_DETECT
		depends on PSRAM && EASY_FLASH && EASY_FLASH_V4
		bool "Enable PSRAM id auto detect function"
		default n
endmenu
```

## t5_os/ap/middleware/driver/pwr_clk/Kconfig
```kconfig
menu "PWR_CLK"
	config EXTERN_32K
		bool "Use an external 32k crystal"
		default n
	config MEM_AUTO_POWER_DISABLE
		bool "mem auto power disable"
		default n
	config CP1_AUTO_POWER_DISABLE
		bool "cp1 auto power disable"
		default n
	config CPU_DEFAULT_FREQ_60M
		bool "set cpu default frequency 60M"
		default n
	config RESERVE_1K_SRAM_UNINITIAL
		bool "reserve 1k sram uninitialized"
		default n
	config LPO_SRC_26M32K
		bool "32k use the 26m divide"
		default n
	config BUCK_ENABLE
		bool "buck enable"
		default n
	config BUCK_ANALOG_DISABLE
		depends on BUCK_ENABLE
		bool "buck disable analog"
		default n
	config BAKP_POWER_DOMAIN_DISABLE
		 bool "bakp power domain disable"
		default n
	config BAKP_POWER_DOMAIN_PM_CONTROL
		 bool "used for PM control of bakp domain power on and off"
		default n
	config AHBP_POWER_DOMAIN_LV_DISABLE
		 bool "ahbp power domain disable"
		default n
	config PSRAM_POWER_DOMAIN_LV_DISABLE
		 bool "psram power domain disable"
		default n
	config DCO_CLK_ENABLE
		bool "Enable dco clk"
		default n
	config EXTERN_32K_PIN_MULT
		 bool "extern32k pin multiplexing"
		default n
	config CLI_CODE_SIZE_OPTIMIZE_ENABLE
		 bool "cli command code size optimize"
		default n
	config VBSPBUFLP1V_ENABLE
		 bool "enable vbspbuflp1v"
		default n
	config LPO_MP_A_FORCE_USE_EXT32K
		 bool "MP_A force use the external 32k"
		default n
	config ROSC_CALIB_SW
		 bool "enable calibrate rc32k by software"
		default n
	config ROSC_COMPENSATION
		 bool "enable rosc compensation for rtc tick"
		default n
	config LP_VOL
		hex "Set Low power voltage value"
		default 0x6
		help
			Set Low power voltage default value 0.6v(0.45+0.025*6)
	config DIGLDO_LOW_VOLTAGE_ENABLE
		 bool "enable dig ldo low voltage "
		default y
	config CLK_FORCE_MAX_CPU_FREQ_320M
		 bool "force max cpu frequency 320M"
		default n
	config PM_26M_STABILITY_DELAY_TIME_HARDWARE
		 int "26M CRYSTAL HARDWARE STABILITY DELAY TIME"
		default 1300
		help
			config the 26M crystal hardware stability time
	config PM_DEMO_ENABLE
		bool "enable PM demo, Applications can develop their own low-power solutions based on this demo"
		default n
	config PM_CLI_ENABLE
		bool "enable PM demo, Applications can develop their own low-power solutions based on this demo"
		default n
	config PM_LV_SUBCORES_ON
		bool "CPU0 and CPU1,CPU2 ON when enter low voltage"
		default n
endmenu
```

## t5_os/ap/middleware/driver/qspi/Kconfig
```kconfig
menu "QSPI"
	config QSPI
		bool "Enable QSPI"
		default n

	config QSPI_STATIS
		bool "Enable QSPI Statis"
		default n

	config QSPI_MST_FLASH
		bool "Enable QSPI Flash"
		depends on QSPI
		default n
		help
			BEKEN Chip sets QSPI interface as a master device, the slave device is a flash,
			then BEKEN Chip can access the flash with QSPI interface.
			The application can read/writes data to flash directly by QSPI Flash API,
			or reads/writes by file system API if enable relates macro, I.E. CONFIG_FATFS, CONFIG_LITTLEFS, CONFIG_VFS...

	config QSPI_FLASH_GD
		depends on QSPI_MST_FLASH
		bool "Enable GD Flash"
		default n

	config QSPI_TEST
		depends on QSPI && DRIVER_TEST
		bool "Enable qspi test"
		default n

	config QSPI_LINE_MODE
		int "qspi line mode choose"
		range 1 8
		default 4
		help
		The value should be changed if need to change qspi line mode
endmenu
```

## t5_os/ap/middleware/driver/rtc/Kconfig
```kconfig
menu "AON_RTC"
	config AON_RTC
		bool "Enable AON_RTC"
		default y

	config AON_RTC_64BIT
		bool "Enable AON_RTC_64BIT"
		default y

	config AON_RTC_KEEP_TIME_SUPPORT
		bool "Enable rtc keep time when enter deepsleep,set data on flash"
		default n

endmenu
```

## t5_os/ap/middleware/driver/saradc/Kconfig
```kconfig
menu "SARADC"
	config SARADC
		bool "Enable SARADC"
		default y

	config SARADC_CLIENT
		bool "Enable SARADC client"
		depends on SARADC
		default y

	config SARADC_MB
		bool "Enable SARADC mailbox"
		depends on SARADC
		default n

	config SARADC_TEST
		depends on SARADC
		bool "Enable SARADC test"
		default y

	config SARADC_EXAMPLE
		depends on SARADC
		bool "Enable SARADC example"
		default n

endmenu
```

## t5_os/ap/middleware/driver/spinlock/Kconfig
```kconfig
menu "SPINLOCK"
	config SPINLOCK
		bool "Enable SPINLOCK"
		default y

	config SPINLOCK_SECTION
		bool "Enable SPINLOCK special section,only SMP needs to enble it"
		default n

	config SPINLOCK_DYNAMIC_CNT
		int "How many spinlocks maybe dynamic allocated by the system"
		default 160

	config SPINLOCK_STATIC_CNT
		int "How many spinlocks maybe static allocated by the system"
		default 64
    
    config SPINLOCK_DEBUG
        depends on SPINLOCK_SECTION
        bool "Enable Spinlock Debug"
        default n 

endmenu
```

## t5_os/ap/middleware/driver/wdt/Kconfig
```kconfig
comment "===Main Tip: On the AP side, the WDT related configuration should not be set to Y. If you want to configure WDT, please go to the CP side to configure it. Please refer to the documentation for the reason..==="
menu "Watchdog"
	config INT_WDT
		bool "Enable Interrupt Watchdog"
		default n

	config INT_WDT_PERIOD_MS
		int "Interrupt Watchdog Period(ms)"
		default 1000

	config TASK_WDT
		bool "Enable Task Watchdog"
		default n

	config TASK_WDT_PERIOD_MS
		int "Task Watchdog Period(ms)"
		default 60000

	config NMI_WDT_EN
		bool "Enable NMI Watchdog"
		default n
endmenu
```

## t5_os/ap/middleware/soc/Kconfig
```kconfig
menu "SOC_CONFIG"

	choice SOC
		prompt "ARMINO SoC"

		default SOC_BK7258 if "$ARMINO_SOC" = "bk7258"
		default SOC_BK7258_AP if "$ARMINO_SOC" = "bk7258_ap"
		default SOC_BK7257 if "$ARMINO_SOC" = "bk7257"
		default SOC_BK7257_AP if "$ARMINO_SOC" = "bk7257_ap"


		config SOC_BK7258
			select SOC_BK7236XX
			bool "BK7258"
		config SOC_BK7258_AP
			select SOC_BK7236XX
			bool "BK7258_AP"
		config SOC_BK7257
			select SOC_BK7236XX
			bool "BK7257"
		config SOC_BK7257_AP
			select SOC_BK7236XX
			bool "BK7257_AP"

	endchoice


	config CPU_CNT
			int "System CPU count: 1: single core, 2: dual core, etc."
			default 1


	config SOC_STR
		string "SoC string"
		default "bk7258"  if SOC_BK7258
		default "bk7258_ap"  if SOC_BK7258_AP
		default "bk7257"  if SOC_BK7257
		default "bk7257_ap"  if SOC_BK7257_AP
		default "$ARMINO_SOC"

	config SOC_ARCH
		string "Soc arch"
		default "unknown"

	config SOC_BK7236XX
		bool "For bk7236 series chipset"
		default n

	config SOC_SMP
		bool "For soc smp feature"
		default n

endmenu
```

## t5_os/bk_idk/components/bk_airkiss/Kconfig
```kconfig
menu "Modules::Bk_airkiss"
	config BK_AIRKISS
		depends on WIFI_ENABLE
		bool "Enable Bk Airkiss" 
		default n
endmenu
```

## t5_os/bk_idk/components/bk_pm/Kconfig
```kconfig
menu "PM"
	config PM_ENABLE
		bool "pm enable"
		default n

	config PM_SUPER_DEEP_SLEEP
		bool "Enable super deep sleep"
		default n
endmenu
```

## t5_os/bk_idk/components/bk_usb/Kconfig
```kconfig
menu "Bk_usb"

	config USB
		bool "Enable Usb"
		default n

	config USB_VBAT_CONTROL_GPIO_ID
		depends on USB
		hex "Vbat control gpio id"
		default 0xFF
		help
			USB VBAT CONTROL GPIO ID

	menu "Modify USB Mailbox"
		depends on MAILBOX
			config USB_MAILBOX
				bool "Enable Multi-core operation USB"
				default n
				help
					Enable Multi-core operation USB
					
		config USB_MAILBOX_MASTER
			bool "Enable USB mailbox master"
			default n

		config USB_MAILBOX_SLAVE
			bool "Enable USB mailbox slave"
			default n

		config USB_MAILBOX_MASTER_CPU1_TO_CPU2
			bool "Enable USB mailbox master cpu1 to cpu2"
			default n

		config USB_MAILBOX_SLAVE_CPU2_TO_CPU1
			bool "Enable USB mailbox slave cpu2 to cpu1"
			default n

		config USB_MAILBOX_MASTER_CPU1_TO_CPU0
			bool "Enable USB mailbox master cpu1 to cpu2"
			default n

		config USB_MAILBOX_SLAVE_CPU0_TO_CPU1
			bool "Enable USB mailbox slave cpu1 to cpu2"
			default n
	endmenu

	menu "Modify Usb Config"
		depends on USB

		choice USB_IP_VERSION
			prompt "Select USB IP"
			default MUSB_MHDRC

			config MUSB_FDRC
				bool "MUSBFDRC"
			config MUSB_MHDRC
				bool "MUSBMHDRC"
			config SYNOPSYS_DWC2_USB_IP
				bool "SYNOPSYS_DWC2_USB_IP"
		endchoice

		choice USB_PROTOCOL_STACK
			prompt "Select Usb Protocol Stack"
			default MENTOR_USB

			config MENTOR_USB
				depends on !USB_MAILBOX_MASTER
				bool "MENTOR_USB"
			config CHERRY_USB
				depends on !USB_MAILBOX_MASTER
				bool "CHERRY_USB"
		endchoice

		config USB_HOST
			bool "Enable USB Host Mode"
			default y
	
		config USB_DEVICE
			bool "Enable USB Device Mode"
			default n

		choice USB_PORT
			prompt "Select Usb Port"
			default USB2_PORT

			config USB1_PORT
				bool "USB1_PORT"
			config USB2_PORT
				bool "USB2_PORT"
		endchoice

		config TASK_USB_PRIO
			int "Set Task Usb Prio"
			range 1 10
			default 7
			help
				Priority of USB task

		config USB_DMA_ENABLE
			bool "Enable usb ip DMA"
			default n

		config USB_HUB
			bool "Enable USB hub"
			default y

		config USB_MSD
			bool "Enable Usb Msd"
			default n

        config USB_UPC
            bool "Enable Usb Upc"
            default n

		config USB_HID
			bool "Enable Usb Hid"
			default n

		config USB_CCD
			bool "Enable Usb Ccd"
			default n

		config USB_UVC
			bool "Enable Usb Uvc"
			default n

		config USB_UAC
			depends on USB_UVC
			bool "Enable Usb Uac"
			default n

		menu "Modify Usb Uac Config"
			depends on USB_UAC
			config USB_UAC_MIC
				bool "Enable Usb Uac Mic"
				default n

			config USB_UAC_SPEAKER
				bool "Enable Usb Uac Speaker"
				default n

		endmenu

		config USB_CHARGE
			bool "Enable Usb Charge"
			default n

	endmenu

	menu "Modify USB Demo Config"
		depends on USB && HTTP
			config UVC_OTA_DEMO
				bool "Enable Uvc ota demo"
				default n
				help
					Enable uvc ota interface And Requires an HTTP module
	endmenu

	menu "Modify USB Demo Config"
		depends on USB
			config UVC_UAC_DEMO
				bool "Enable Fusion device uvc_uac"
				default n
				help
					Enable fusion device video and audio

		config UVC_UAC_DEMO_DEBUG
			bool "Enable Usb Uvc_Uac Debug"
			default n
	endmenu

	menu "Modify Dsp Config"

		config DSP
			bool "Enable Dsp"
			default n

		#TODO delete it
		config DSP_SRC_ADD
			hex "Set Dsp Src Add"
			default 0x130000
			help
				set dsp source address

	endmenu

    
    config STANDARD_DUALSTREAM
        depends on USB
        bool "Standard dual stream"
        default n
    
    config UVC_DUAL_DEVICE
        #depends on STANDARD_DUALSTREAM
        int "the num for uvc_device"
        range 1 2
        default 1 if !STANDARD_DUALSTREAM
        default 2 if STANDARD_DUALSTREAM

endmenu
```

## t5_os/bk_idk/components/wolfssl/Kconfig
```kconfig
menu "modules::wolfssl"

	config WOLFSSL_BEKEN
		bool "Enable WOLFSSL BEKEN"
		default n if !WPA3
		default y if WPA3
endmenu
```

## t5_os/bk_idk/middleware/arch/riscv/Kconfig
```kconfig
menu "Arch::Riscv"
	config CPU_FREQ_HZ
		int "Enable Cpu Freq Hz"
		default 120000000
		help
			CPU frequency

	config ARCH_RISCV
		bool "Enable Arch RISCV"
		default n

	menu "Modify Arch Riscv Config"
		depends on ARCH_RISCV

		config NEST_INT_SUPPORT
			bool "Enable Nest Int Support"
			default n
			help
				Support nest interrupt

		config DUMP_ENABLE
			bool "Enable Dump Feature"
			default n
			help
				Dump all memory when exception happen

		config MEMDUMP_ALL
			bool "Enable Memdump All"
			default y
			help
				Dump all memory when exception happen

		config SAVE_BOOT_TIME_POINT
			bool "Enable Save Boot Time Point"
			default n

		config CACHE_ENABLE
			bool "Enable Cache Enable"
			default n
			help
				Enable Cache

		config CACHE_CUSTOM_SRAM_MAPPING
			depends on CACHE_ENABLE
			bool "Enable Cache Custom Sram Mapping"
			default n
			help
				Custom defined sram mapping

	   config HEAP_IN_CACHE
			   depends on CACHE_ENABLE
			   bool "Enable Heap in Cache"
			   default y
			   help
					   Custom enable heap in Cache

	endmenu
endmenu
```
