## t5_os/ap/components/bk_asr_service/Kconfig
```kconfig
menu "ASR Service"

	config ASR_SERVICE
		bool "Enable ASR Service"
		depends on ADK && ADK_RAW_STREAM && ADK_ONBOARD_MIC_STREAM && ADK_ONBOARD_SPEAKER_STREAM && (ADK_AEC_ALGORITHM || ADK_AEC_V3_ALGORITHM) && WANSON_ASR
		default n
		help
			Enable ASR Service Interface API used for ASR
	
	choice ASR_SERVICE_USE_MEMORY
		depends on ASR_SERVICE
		prompt "Select asr service use memory"
		default ASR_SERVICE_USE_SRAM

		config ASR_SERVICE_USE_SRAM
			bool "Enable asr service use sram"
			help
				asr service use sram memory

		config ASR_SERVICE_USE_PSRAM
			depends on PSRAM
			bool "Enable asr service use psram"
			help
				asr service use psram memory
	endchoice

	choice ASR_SERVICE_MIC
		depends on ASR_SERVICE
		prompt "Select asr service with mic"
		default ASR_SERVICE_WITH_MIC

		config ASR_SERVICE_WITH_MIC
			bool "Enable asr service with mic"
			help
				asr service with mic

		config ASR_SERVICE_NO_MIC
			bool "Enable asr service no mic"
			help
				the mic will be opened by other modules, the asr src is from the mic multioutput.
	endchoice

	config AUD_ASR_READ_SERVICE
		depends on ASR_SERVICE 
		bool "Enable Audio ASR Service"
		default n
		help
			Enable Aud asr Service to read service mic data
endmenu
```

## t5_os/ap/components/bk_audio/audio_algorithms/aec_algorithm/Kconfig
```kconfig
menu "Adk::Audio_algorithm::Aec_algorithm"
	config ADK_AEC_ALGORITHM
		depends on ADK
		bool "Enable Audio AEC algorithm"
		default n

	config ADK_AEC_ALGORITHM_TEST
		depends on ADK_AEC_ALGORITHM
		depends on ADK_FATFS_STREAM
		bool "Enable Audio AEC algorithm test"
		default n

endmenu
```

## t5_os/ap/components/bk_audio/audio_algorithms/aec_v3_algorithm/Kconfig
```kconfig
menu "Adk::Audio_algorithm::Aec_algorithm"
	config ADK_AEC_V3_ALGORITHM
		depends on ADK
		bool "Enable Audio AEC algorithm"
		default n

	config ADK_AEC_V3_ALGORITHM_TEST
		depends on ADK_AEC_ALGORITHM
		depends on ADK_FATFS_STREAM
		bool "Enable Audio AEC algorithm test"
		default n
	config AUD_AI_NS_SUPPORT
	        depends on ADK_AEC_V3_ALGORITHM
		bool "Support AEC AI NS function"
		default n

	config AUD_AI_NS_USE_STATIC_SRAM
		depends on AUD_AI_NS_SUPPORT
		bool "AEC AI NS Extra buffer in SRAM"
		default n
endmenu
```

## t5_os/ap/components/bk_audio/audio_algorithms/agc_algorithm/Kconfig
```kconfig
menu "Adk::Audio_algorithm::Agc_algorithm"
	config ADK_AGC_ALGORITHM
		depends on ADK
		bool "Enable Audio AGC algorithm"
		default n

	config ADK_AGC_ALGORITHM_TEST
		depends on ADK_AGC_ALGORITHM
		bool "Enable Audio AGC algorithm test"
		default n

endmenu
```

## t5_os/ap/components/bk_audio/audio_algorithms/eq_algorithm/Kconfig
```kconfig
menu "Adk::Audio_algorithm::EQ_algorithm"
	config ADK_EQ_ALGORITHM
		depends on ADK
		bool "Enable Audio EQ algorithm"
		default n

	config ADK_EQ_ALGORITHM_TEST
		depends on ADK_EQ_ALGORITHM && ADK_ARRAY_STREAM && ADK_UART_STREAM
		bool "Enable Audio EQ algorithm test"
		default n

endmenu
```

## t5_os/ap/components/bk_audio/audio_algorithms/rsp_algorithm/Kconfig
```kconfig
menu "Adk::Audio_algorithm::Rsp_algorithm"
	config ADK_RSP_ALGORITHM
		depends on ADK
		bool "Enable Audio RSP algorithm"
		default n

	#config ADK_RSP_ALGORITHM_TEST
	#	depends on ADK_RSP_ALGORITHM
	#	depends on ADK_FATFS_STREAM
	#	bool "Enable Audio RSP algorithm test"
	#	default n

endmenu
```

## t5_os/ap/components/bk_audio/audio_decoders/acc_decoder/Kconfig
```kconfig
menu "Adk::Audio_decoders::AAC_decoder"
	config ADK_AAC_DECODER
		depends on ADK
		bool "Enable Audio AAC Decoder"
		default n

	config ADK_AAC_DECODER_TEST
		depends on ADK_AAC_DECODER && ADK_FATFS_STREAM
		bool "Enable Audio AAC Decoder test"
		default n

endmenu
```

## t5_os/ap/components/bk_audio/audio_decoders/g711_decoder/Kconfig
```kconfig
menu "Adk::Audio_decoders::G711_decoder"
	config ADK_G711_DECODER
		depends on ADK
		bool "Enable Audio G711 Decoder"
		default n

	config ADK_G711_DECODER_TEST
		depends on ADK_G711_DECODER
		bool "Enable Audio G711 Decoder test"
		default n

endmenu
```

## t5_os/ap/components/bk_audio/audio_decoders/g722_decoder/Kconfig
```kconfig
menu "Adk::Audio_decoders::G722_decoder"
	config ADK_G722_DECODER
		depends on ADK
		bool "Enable Audio G722 Decoder"
		default n

	config ADK_G722_DECODER_TEST
		depends on ADK_G722_DECODER && ADK_ARRAY_STREAM && ADK_UART_STREAM
		bool "Enable Audio G722 Decoder test"
		default n

endmenu
```

## t5_os/ap/components/bk_audio/audio_decoders/mp3_decoder/Kconfig
```kconfig
menu "Adk::Audio_decoders::MP3_decoder"
	config ADK_MP3_DECODER
		depends on ADK
		bool "Enable Audio MP3 Decoder"
		default n

	config ADK_MP3_DECODER_TEST
		depends on ADK_MP3_DECODER
		bool "Enable Audio MP3 Decoder test"
		default n

endmenu
```

## t5_os/ap/components/bk_audio/audio_decoders/opus_dec/Kconfig
```kconfig
menu "Adk::Audio_decoders::Opus_dec"
	config ADK_OPUS_DECODER
		depends on ADK
		bool "Enable Audio Opus Decoder"
		default n

	config ADK_OPUS_DECODER_TEST
		depends on ADK_OPUS_DECODER && ADK_FRAME_ARRAY_STREAM && ADK_UART_STREAM
		bool "Enable Audio Opus Decoder test"
		default n

endmenu
```

## t5_os/ap/components/bk_audio/audio_decoders/wav_decoder/Kconfig
```kconfig
menu "Adk::Audio_decoders::Wav_decoder"
	config ADK_WAV_DECODER
		depends on ADK
		bool "Enable Audio WAV Decoder"
		default y

	config ADK_WAV_DECODER_TEST
		depends on ADK_WAV_DECODER && ADK_ARRAY_STREAM && ADK_ONBOARD_SPEAKER_STREAM
		bool "Enable Audio Wav Decoder test"
		default y

endmenu
```

## t5_os/ap/components/bk_audio/audio_encoders/aac_encoder/Kconfig
```kconfig
menu "Adk::Audio_encoders::AAC_encoder"
	config ADK_AAC_ENCODER
		depends on ADK
		bool "Enable Audio AAC encoder"
		default n

	config ADK_AAC_ENCODER_TEST
		depends on ADK_AAC_ENCODER && ADK_ONBOARD_MIC_STREAM && ADK_UART_STREAM
		bool "Enable Audio AAC encoder test"
		default n

endmenu
```

## t5_os/ap/components/bk_audio/audio_encoders/g711_encoder/Kconfig
```kconfig
menu "Adk::Audio_encoders::G711_encoder"
	config ADK_G711_ENCODER
		depends on ADK
		bool "Enable Audio G711 encoder"
		default n

	config ADK_G711_ENCODER_TEST
		depends on ADK_G711_ENCODER
		bool "Enable Audio G711 encoder test"
		default n

endmenu
```

## t5_os/ap/components/bk_audio/audio_encoders/g722_encoder/Kconfig
```kconfig
menu "Adk::Audio_encoders::G722_encoder"
    config ADK_G722_ENCODER
        depends on ADK
        bool "Enable Audio G722 encoder"
        default n

    config ADK_G722_ENCODER_TEST
        depends on ADK_G722_ENCODER && ADK_ARRAY_STREAM && ADK_UART_STREAM
        bool "Enable Audio G722 encoder test"
        default n

endmenu
```

## t5_os/ap/components/bk_audio/audio_encoders/opus_enc/Kconfig
```kconfig
menu "Adk::Audio_encoders::Opus_enc"
	config ADK_OPUS_ENCODER
		depends on ADK
		bool "Enable Audio Opus encoder"
		default n

	config ADK_OPUS_ENCODER_TEST
		depends on ADK_OPUS_ENCODER && ADK_FRAME_ARRAY_STREAM && ADK_UART_STREAM
		bool "Enable Audio Opus encoder test"
		default n

endmenu
```

## t5_os/ap/components/bk_audio/audio_pipeline/Kconfig
```kconfig
menu "Adk"
	config ADK
		depends on FREERTOS_USE_QUEUE_SETS
		bool "Enable Audio Development Kit"
		default n

	choice ADK_USE_MEMORY
		depends on ADK
		prompt "Select ADK use memory"
		default ADK_USE_PSRAM

		config ADK_USE_SRAM
			bool "Enable ADK use sram"
			help
				ADK use sram memory

		config ADK_USE_PSRAM
			depends on PSRAM
			bool "Enable ADK use psram"
			help
				ADK use psram memory
	endchoice

	config ADK_AUTO_TEST
		depends on ADK
		bool "Enable ADK auto test"
		default n

	config ADK_AUTO_TEST_PIPELINE
		depends on ADK_AUTO_TEST
		bool "Enable ADK pipeline auto test "
		default n

	config ADK_AUTO_TEST_ELEMENT
		depends on ADK_AUTO_TEST
		bool "Enable ADK element auto test "
		default n

	config ADK_AUTO_TEST_EVENT
		depends on ADK_AUTO_TEST
		bool "Enable ADK event listener auto test "
		default n

endmenu
```

## t5_os/ap/components/bk_audio/audio_streams/array_stream/Kconfig
```kconfig
menu "Adk::Audio_streams::Array_stream"
	config ADK_ARRAY_STREAM
		depends on ADK
		bool "Enable Audio Array stream"
		default n

	config ADK_ARRAY_STREAM_TEST
		depends on ADK_ARRAY_STREAM
		bool "Enable Audio Array stream test"
		default n

endmenu
```

## t5_os/ap/components/bk_audio/audio_streams/fatfs_stream/Kconfig
```kconfig
menu "Adk::Audio_streams::Fatfs_stream"
	config ADK_FATFS_STREAM
		depends on ADK
		depends on FATFS
		bool "Enable Audio Fatfs stream"
		default n

	config ADK_FATFS_STREAM_TEST
		depends on ADK_FATFS_STREAM
		bool "Enable Audio Fatfs stream test"
		default n

endmenu
```

## t5_os/ap/components/bk_audio/audio_streams/frame_array_stream/Kconfig
```kconfig
menu "Adk::Audio_streams::Array_stream"
	config ADK_FRAME_ARRAY_STREAM
		depends on ADK
		bool "Enable Audio Frame Array stream"
		default n

	config ADK_FRAME_ARRAY_STREAM_TEST
		depends on ADK_FRAME_ARRAY_STREAM
		bool "Enable Audio Frame Array stream test"
		default n

endmenu
```

## t5_os/ap/components/bk_audio/audio_streams/onboard_dual_dmic_mic_stream/Kconfig
```kconfig
menu "Adk::Audio_streams::Onboard_mic_stream"
	config ADK_ONBOARD_DUAL_DMIC_MIC_STREAM
		depends on ADK
		depends on AUDIO_DMIC
		bool "Enable onboard mic stream"
		default n

endmenu
```

## t5_os/ap/components/bk_audio/audio_streams/onboard_mic_stream/Kconfig
```kconfig
menu "Adk::Audio_streams::Onboard_mic_stream"
	config ADK_ONBOARD_MIC_STREAM
		depends on ADK
		depends on AUDIO_ADC
		bool "Enable onboard mic stream"
		default n

	config ADK_ONBOARD_MIC_STREAM_TEST
		depends on ADK_ONBOARD_MIC_STREAM && ADK_UART_STREAM
		bool "Enable onboard mic stream test"
		default n

endmenu
```

## t5_os/ap/components/bk_audio/audio_streams/onboard_speaker_stream/Kconfig
```kconfig
menu "Adk::Audio_streams::Onboard_speaker_stream"
	config ADK_ONBOARD_SPEAKER_STREAM
		depends on ADK
		depends on AUDIO_DAC
		bool "Enable onboard speaker stream"
		default n

	config ADK_ONBOARD_SPEAKER_STREAM_SUPPORT_MULTIPLE_SOURCE
		depends on ADK_ONBOARD_SPEAKER_STREAM
		bool "Enable onboard speaker stream to support multiple sources. The module automatically selects playback based on the priority of multiple sources."
		default n

	config ADK_ONBOARD_SPEAKER_STREAM_TEST
		depends on ADK_ONBOARD_SPEAKER_STREAM
		bool "Enable onboard speaker stream test"
		default n

endmenu
```

## t5_os/ap/components/bk_audio/audio_streams/raw_stream/Kconfig
```kconfig
menu "Adk::Audio_streams::raw_stream"
	config ADK_RAW_STREAM
		depends on ADK
		bool "Enable raw stream"
		default n

	config ADK_RAW_STREAM_TEST
		depends on ADK_RAW_STREAM
		bool "Enable raw stream test"
		default n

endmenu
```

## t5_os/ap/components/bk_audio/audio_streams/uac_mic_stream/Kconfig
```kconfig
menu "Adk::Audio_streams::Uac_mic_stream"
	config ADK_UAC_MIC_STREAM
		depends on ADK
		depends on USBH_UAC
		bool "Enable uac mic stream"
		default n

	config ADK_UAC_MIC_STREAM_TEST
		depends on ADK_UAC_MIC_STREAM
		depends on ADK_UART_STREAM
		bool "Enable uac mic stream test"
		default n

endmenu
```
