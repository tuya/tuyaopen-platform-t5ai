// Copyright 2025-2026 Beken
//
// Licensed under the Apache License, Version 2.0 (the "License");
// you may not use this file except in compliance with the License.
// You may obtain a copy of the License at
//
//     http://www.apache.org/licenses/LICENSE-2.0
//
// Unless required by applicable law or agreed to in writing, software
// distributed under the License is distributed on an "AS IS" BASIS,
// WITHOUT WARRANTIES OR CONDITIONS OF ANY KIND, either express or implied.
// See the License for the specific language governing permissions and
// limitations under the License.


#include "FreeRTOS.h"
#include "task.h"
#include <components/bk_audio/audio_pipeline/audio_pipeline.h>
#include <components/bk_audio/audio_pipeline/audio_mem.h>
#include <components/bk_audio/audio_decoders/mp3_decoder.h>
#include <os/os.h>
#include <components/bk_audio/audio_streams/array_stream.h>
#include <components/bk_audio/audio_streams/onboard_speaker_stream.h>

#define TAG  "MP3_DECODER_TEST"

#define TEST_CHECK_NULL(ptr) do {\
        if (ptr == NULL) {\
            BK_LOGD(TAG, "TEST_CHECK_NULL fail \n");\
            return BK_FAIL;\
        }\
    } while(0)


// MP3测试数据数组（实际使用时替换为真实MP3数据）
static const uint8_t MP3_TEST_DATA[] = {
0x49, 
0x44, 0x33, 0x04, 0x00, 0x00, 0x00, 0x00, 0x00, 0x23, 0x54, 0x53, 0x53, 0x45, 0x00, 0x00, 0x00, 
0x0F, 0x00, 0x00, 0x03, 0x4C, 0x61, 0x76, 0x66, 0x35, 0x38, 0x2E, 0x32, 0x39, 0x2E, 0x31, 0x30, 
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0xAA, 0xAA, 0xAA, 0xAA, 0xAA, 0xAA, 0xAA, 0xAA, 0xAA, 0xAA, 0xAA, 0xAA, 
};

static const int MP3_TEST_DATA_LEN = sizeof(MP3_TEST_DATA);

bk_err_t adk_mp3_decoder_test_case_0(void)
{
    audio_pipeline_handle_t pipeline;
    audio_element_handle_t array_stream, mp3_dec, speaker_stream;
    audio_event_iface_handle_t evt;

    BK_LOGD(TAG, "--------- %s ----------\n", __func__);
    AUDIO_MEM_SHOW("start \n");

    // 步骤1: 初始化音频管道
    audio_pipeline_cfg_t pipeline_cfg = DEFAULT_AUDIO_PIPELINE_CONFIG();
    pipeline = audio_pipeline_init(&pipeline_cfg);
    TEST_CHECK_NULL(pipeline);

    // 步骤2: 初始化array_stream（使用数组作为MP3数据源）
    array_stream_cfg_t array_cfg = DEFAULT_ARRAY_STREAM_CONFIG();
    array_cfg.type = AUDIO_STREAM_READER;
    array_cfg.buf_sz = MP3_DECODER_MAIN_BUFF_SIZE;
    array_stream = array_stream_init(&array_cfg);
    TEST_CHECK_NULL(array_stream);
    array_stream_set_data(array_stream, (uint8_t *)MP3_TEST_DATA, MP3_TEST_DATA_LEN);

    // 步骤3: 初始化MP3解码器
    mp3_decoder_cfg_t mp3_cfg = DEFAULT_MP3_DECODER_CONFIG();
    mp3_dec = mp3_decoder_init(&mp3_cfg);
    TEST_CHECK_NULL(mp3_dec);

    // 步骤4: 初始化板载扬声器流
    onboard_speaker_stream_cfg_t speaker_cfg = DEFAULT_ONBOARD_SPEAKER_STREAM_CONFIG();
    speaker_stream = onboard_speaker_stream_init(&speaker_cfg);
    TEST_CHECK_NULL(speaker_stream);

    // 步骤5: 注册音频元素到管道
    audio_pipeline_register(pipeline, array_stream, "array_stream");
    audio_pipeline_register(pipeline, mp3_dec, "mp3_dec");
    audio_pipeline_register(pipeline, speaker_stream, "speaker_stream");

    // 步骤6: 链接音频元素 [array_stream] -> [mp3_dec] -> [speaker_stream]
    const char *link_tag[3] = {"array_stream", "mp3_dec", "speaker_stream"};
    audio_pipeline_link(pipeline, link_tag, 3);

    // 步骤7: 创建事件监听器
    audio_event_iface_cfg_t evt_cfg = AUDIO_EVENT_IFACE_DEFAULT_CFG();
    evt = audio_event_iface_init(&evt_cfg);
    audio_pipeline_set_listener(pipeline, evt);

    // 步骤8: 启动音频管道
    audio_pipeline_run(pipeline);

    // 步骤9: 等待播放完成或错误事件
    while (1)
    {
        audio_event_iface_msg_t msg;
        bk_err_t ret = audio_event_iface_listen(evt, &msg, portMAX_DELAY);
        if (ret != BK_OK)
        {
            BK_LOGE(TAG, "Event interface error : %d \n", ret);
            continue;
        }

        // 处理解码器音乐信息报告
        if (msg.source == mp3_dec && msg.cmd == AEL_MSG_CMD_REPORT_MUSIC_INFO)
        {
            audio_element_info_t music_info = {0};
            audio_element_getinfo(mp3_dec, &music_info);
            BK_LOGD(TAG, "Received music info: sample_rates=%d, bits=%d, ch=%d\n",
                    music_info.sample_rates, music_info.bits, music_info.channels);

            onboard_speaker_stream_set_param(speaker_stream, music_info.sample_rates, music_info.bits, music_info.channels);
            continue;
        }

        // 处理播放完成或错误事件
        if (msg.cmd == AEL_MSG_CMD_REPORT_STATUS && msg.source == speaker_stream)
        {
            int status = (int)msg.data;
            if (status == AEL_STATUS_STATE_STOPPED || status == AEL_STATUS_STATE_FINISHED ||
                status == AEL_STATUS_ERROR_PROCESS)
            {
                BK_LOGW(TAG, "Stop event received, status=%d\n", status);
                break;
            }
        }
    }

    // 步骤10: 清理资源
    audio_pipeline_stop(pipeline);
    audio_pipeline_wait_for_stop(pipeline);
    audio_pipeline_terminate(pipeline);

    audio_pipeline_unregister(pipeline, array_stream);
    audio_pipeline_unregister(pipeline, mp3_dec);
    audio_pipeline_unregister(pipeline, speaker_stream);
    audio_pipeline_remove_listener(pipeline);

    audio_event_iface_destroy(evt);
    audio_pipeline_deinit(pipeline);

    audio_element_deinit(array_stream);
    audio_element_deinit(mp3_dec);
    audio_element_deinit(speaker_stream);

    AUDIO_MEM_SHOW("end \n");
    BK_LOGD(TAG, "--------- %s end ----------\n", __func__);
    return BK_OK;
}

