## t5_os/ap/middleware/soc/bk7257_ap/bk7257_ap.defconfig
```kconfig
#The value config in bk7257.defconfig will over write the Kconfig's default value.
#If the default value in Kconfig satisfy your needs, then you needn't to config again here.

CONFIG_SOC_ARCH="cm33"
CONFIG_SOC_BK7236XX=y
CONFIG_SOC_BK7236_V5=y

CONFIG_SOC_BK7257=y
CONFIG_SOC_STR="bk7257_ap"
CONFIG_ARCH_CM33=y
CONFIG_CMSIS=y
CONFIG_DEFAULT_CMSIS_START=n

CONFIG_CPU_CNT=2
CONFIG_SOC_SMP=y
CONFIG_BUILD_DEFAULT_VERSION=y

#
# Spinlock
#
CONFIG_SPINLOCK=y
CONFIG_SPINLOCK_SECTION=y
CONFIG_SPINLOCK_DYNAMIC_CNT=512
CONFIG_SPINLOCK_STATIC_CNT=128
# end of Spinlock


CONFIG_MAILBOX=y
CONFIG_MAILBOX_V2_0=y
CONFIG_SLAVE_HEART_BEAT=y


#
# Test Configuration
#
CONFIG_INTERRUPT_TEST=y
CONFIG_AON_PMU_TEST=y



#Enable for FPGA board
CONFIG_SPE=1
CONFIG_SPE_TEST=y

#
# ARMINO Configuration
#

#
# Common Configuration
#
CONFIG_CACHE_ENABLE=n
CONFIG_MPU=y

#
# Debug
#
CONFIG_ASSERT_REBOOT=y
# CONFIG_ASSERT_HALT is not set
# CONFIG_ASSERT_REBOOT is not set
# CONFIG_JTAG is not set
# end of Debug
# end of Common Configuration

#
# Features Configuration
#
#CONFIG_LWIP_V2_0 is not set
CONFIG_LWIP_V2_1=y
CONFIG_NO_HOSTED=y
CONFIG_LWIP_MEM_LIBC_MALLOC=y
CONFIG_LWIP_MEMP_MEM_MALLOC=y
# CONFIG_SEMI_HOSTED is not set
# CONFIG_FULLY_HOSTED is not set
# CONFIG_WIFI_SENSOR is not set
CONFIG_ANA_REG_WRITE_POLL_REG_B=n
# end of Features Configuration



#
# Components Configuration
#

#
# Application
#
# CONFIG_DEMO_TEST is not set
# CONFIG_FTPD_UPGRADE is not set
CONFIG_ALI_MQTT=n

CONFIG_HTTP=y
CONFIG_OTA_HTTP=y
CONFIG_HTTP_OTA_WITH_BLE=y

# CONFIG_OTA_TFTP is not set
CONFIG_IPERF_TEST=y
# end of Application

CONFIG_AT=n
CONFIG_AT_CMD=n

#
# Audio
#
CONFIG_AUDIO=y
CONFIG_AUDIO_ADC=y
CONFIG_AUDIO_DAC=y
CONFIG_AUDIO_TEST=y
# end of Audio

#
# Calibration
#
CONFIG_CALI=y
CONFIG_MANUAL_CALI=y
CONFIG_TPC_PA_MAP=y
# end of Calibration

#
# ATE
#
CONFIG_ATE=n
CONFIG_ATE_TEST=n
# end of ATE

#
# BLE
#
CONFIG_BLE_5_X=n
CONFIG_BTDM_5_2=n
CONFIG_BTDM_5_T_MINDTREE=n
CONFIG_BT=n
CONFIG_BLUETOOTH=n
# CONFIG_BLE_4_2 is not set
# end of BLE

#
# Cli
#
CONFIG_CLI=y
CONFIG_LOG_LEVEL=6
CONFIG_SHELL_ASYNCLOG=y
CONFIG_DYM_LOG_MEM_MAX=0x10000
CONFIG_MAX_COMMANDS=256
CONFIG_BKREG=n
# CONFIG_TCP_SERVER_TEST is not set
# CONFIG_AIRKISS_TEST is not set
# CONFIG_WIFI_RAW_TX_TEST is not set
# CONFIG_I2C1_TEST is not set
# CONFIG_I2C2_TEST is not set
# CONFIG_UART_TEST is not set
# CONFIG_SPI_TEST is not set
# CONFIG_PERI_TEST is not set
# CONFIG_RF_OTA_TEST is not set
# end of Cli

#
# RF
#
CONFIG_RF_POLICY_BLE_REQ=y
# CONFIG_RF_POLICY_WIFI_REQ is not set
# CONFIG_RF_POLICY_CO_REQ is not set
# end of RF

#
# Internal Kconfig
#
CONFIG_CHECK_MISMATCH=y
CONFIG_MCU_PS=n
CONFIG_DEEP_PS=n
CONFIG_TICK_CALI=y
CONFIG_STA_PS=n
# end of Internal Kconfig

#
# FreeRTOS
#
CONFIG_FREERTOS=y
CONFIG_FREERTOS_SMP=y
CONFIG_FREERTOS_TRACE=n
CONFIG_FREERTOS_ALLOW_OS_API_IN_IRQ_DISABLED=y
CONFIG_OS_SMP_AFFINITY_DEMO=y

#
# Memory Debug
#
# CONFIG_MALLOC_STATIS is not set
CONFIG_MEM_DEBUG=y
# end of Memory Debug
# end of FreeRTOS
CONFIG_CM_BACKTRACE=y

#
# Startup
#
CONFIG_APP_MAIN_TASK_PRIO=4
CONFIG_APP_MAIN_TASK_STACK_SIZE=4096
# end of Startup

#
# System
#
CONFIG_FLASH_SIZE_4M=y
CONFIG_FLASH=y
CONFIG_FLASH_MB=y
# CONFIG_BASE_MAC_FROM_EFUSE is not set
# CONFIG_BASE_MAC_FROM_RF_OTP_FLASH is not set
CONFIG_NEW_MAC_POLICY=y
CONFIG_BK_MAC_ADDR_CHECK=y
CONFIG_RESET_REASON=n
# end of System

#
# Mbedtls
#
CONFIG_PSA_MBEDTLS=y
CONFIG_FULL_MBEDTLS=n
CONFIG_MBEDTLS_USE_PSA_CRYPTO=n
CONFIG_TRUSTENGINE=y
CONFIG_SW_CRYPTO=n
CONFIG_TE200_ENTROPY=y
CONFIG_MBEDTLS_LOG_LEVEL="OFF"
CONFIG_AON_ENCP=y
CONFIG_PSA_MBEDTLS_TEST=n
CONFIG_TRUSTENGINE_TEST=n
# end of Mbedtls
#

# USB configuration
#
CONFIG_USB=y
CONFIG_USB_VBAT_CONTROL_GPIO_ID=0x1C
CONFIG_TASK_USB_PRIO=2
CONFIG_CHERRY_USB=y
CONFIG_USB_DMA_ENABLE=y
CONFIG_USB_HOST=y
CONFIG_USBH_MSC=y
CONFIG_USBH_UVC=y
CONFIG_USBH_UAC=y
CONFIG_USBH_SERIAL_CH340=y

CONFIG_USB_HUB=y
CONFIG_USB_HUB_MULTIPLE_DEVICES=y
CONFIG_USBHOST_HUB_MAX_EHPORTS=4
CONFIG_USBHOST_HUB_PORT_SUPPORT_MAX_DEVICE=5
CONFIG_USBHOST_HUB_PORT_1_VBAT_CONTROL_GPIO_ID=0xFF

CONFIG_USB_DEVICE=n
CONFIG_USBD_MSC=n
CONFIG_USBD_HID=n
# end of USB configuration

#
# WiFi
#
CONFIG_WIFI_ENABLE=n
CONFIG_WIFI6_CODE_STACK=n
CONFIG_WIFI6=n
CONFIG_WIFI4=n
CONFIG_MSDU_RESV_TAIL_LENGTH=16
CONFIG_TASK_RECONNECT_PRIO=4
CONFIG_WIFI_MAC_VERSION="V22"
CONFIG_WIFI_MDM_VERSION="v32"
CONFIG_WIFI_PLF_VERSION="v32"
CONFIG_MM_PS_SET_LISTEN_INTERVAL_VALUE=30
CONFIG_MOBILE_CONNECT_SAP_STATISTICS=y
# CONFIG_AP_MONITOR_COEXIST is not set
# CONFIG_WIFI_FAST_CONNECT is not set
# CONFIG_BSSID_CONNECT is not set
# CONFIG_WFA_CERT is not set
# CONFIG_LESS_MEMERY_IN_RWNX is not set
# CONFIG_AP_PROBEREQ_CB is not set
# CONFIG_MM_PS_BASED_ON_LISTEN_INTERVAL is not set
CONFIG_WIFI6_IP_DEBUG=y
# end of WiFi

CONFIG_BLE_PS=n

#
# BLE 5.x
#
# CONFIG_BLE_HOST_NONE is not set
CONFIG_BLE_HOST_RW=n
# CONFIG_BLE_HOST_ZEPHYR is not set
CONFIG_BLE_MESH_NONE=n
# CONFIG_BLE_MESH_RW is not set
CONFIG_BLE_ADV_NUM=1
CONFIG_BLE_SCAN_NUM=1
CONFIG_BLE_INIT_NUM=1
CONFIG_BLE_CONN_NUM=1
# end of BLE 5.x

#
# Driver
#

#
# AON_RTC
#
CONFIG_AON_RTC=y
# end of AON_RTC


CONFIG_SYSTEM_CTRL=y
CONFIG_HAL_DEBUG_SYS=y
CONFIG_AON_PMU=y

# I2C
#
#
CONFIG_I2C=y
CONFIG_I2C_SUPPORT_ID_BITS=2
CONFIG_SIM_I2C=n

#
# UART
#
CONFIG_UART0=y
CONFIG_UART1=y
CONFIG_UART2=y

CONFIG_SYS_PRINT_DEV_MAILBOX=y
CONFIG_SYS_PRINT_DEV_UART=n
CONFIG_UART_PRINT_PORT=1
CONFIG_PRINTF_BUF_SIZE=256
# CONFIG_BACKGROUND_PRINT is not set
CONFIG_KFIFO_SIZE=128
CONFIG_UART_ERR_INTERRUPT=y
# CONFIG_UART_STATIS is not set
# end of UART

#
# TRNG
#
CONFIG_TRNG_SUPPORT=y
# end of TRNG

#depends on CONFIG_TRNG_SUPPORT
CONFIG_RANDOM_MAC_ADDR=y

#
# FATFS
#
CONFIG_FATFS=y
CONFIG_FATFS_SDCARD=y
CONFIG_FATFS_SPI_0_FLASH=n
CONFIG_FATFS_SPI_1_FLASH=n
CONFIG_FATFS_QSPI_0_FLASH=n
CONFIG_FATFS_QSPI_1_FLASH=n
# end of FATFS



CONFIG_LITTLEFS=y
CONFIG_LFS_THREADSAFE=y


CONFIG_MAC_PHY_BYPASS=y

#
# SDIO
#
CONFIG_SDCARD=y
CONFIG_SDCARD_DEFAULT_CLOCK_FREQ=14
CONFIG_SDCARD_POWER_GPIO_CTRL=y
CONFIG_SDCARD_DEBUG_SUPPORT=n
CONFIG_SDCARD_BUSWIDTH_4LINE=n
CONFIG_SDIO_4LINES_EN=n
CONFIG_SDIO=y
CONFIG_SDIO_V1P0=n
CONFIG_SDIO_V2P0=y
CONFIG_SDIO_V2P1=n
CONFIG_SDIO_GDMA_EN=n
CONFIG_SDIO_HOST=y
CONFIG_SDIO_HOST_DEFAULT_CLOCK_FREQ=7
CONFIG_SDIO_HOST_CLR_WRITE_INT=y
CONFIG_SDIO_PM_CB_SUPPORT=n
CONFIG_PIN_SDIO_GROUP_1=n
CONFIG_SDIO_SLAVE=n
# end of SDIO

#
# SPI
#
CONFIG_SPI_DMA=y
# CONFIG_SPI_SLAVE is not set
# CONFIG_SPI_MASTER is not set
CONFIG_SPI=y
CONFIG_SPI_STATIS=y
CONFIG_SPI_SUPPORT_TX_FIFO_WR_READY=y
# CONFIG_HSLAVE_SPI is not set
CONFIG_SPI_MST_FLASH=y
# CONFIG_SPI_MST_PSRAM is not set
# end of SPI
#
# QSPI
#
CONFIG_QSPI=y
CONFIG_QSPI_TEST=y
CONFIG_QSPI_MST_FLASH=y
CONFIG_QSPI_FLASH_GD=y
# end of QSPI

#
# GENERAL_DMA
#
CONFIG_GENERAL_DMA=y
CONFIG_DMA_LOGIC_CHAN_CNT=12
CONFIG_DMA_LOGIC_CHAN_ID_MIN=0
# end of GENERAL_DMA

#
# PSRAM
#
CONFIG_PSRAM=n
CONFIG_PSRAM_AS_SYS_MEMORY=n
CONFIG_TASK_STACK_IN_PSRAM=n
# end of PSRAM

#
# Video
#
CONFIG_MEDIA=y
CONFIG_LCD=y
CONFIG_LCD_QSPI=y

CONFIG_LCD_GC9503V=n
CONFIG_LCD_H050IWV=y
CONFIG_LCD_HX8282=y
CONFIG_LCD_MD0430R=y
CONFIG_LCD_MD0700R=y
CONFIG_LCD_NT35512=n
CONFIG_LCD_NT35510=n
CONFIG_LCD_NT35510_MCU=y
CONFIG_LCD_ST7282=y
CONFIG_LCD_ST7796S=y
CONFIG_LCD_ST7701S_LY=y
CONFIG_LCD_ST7701S=y
CONFIG_LCD_ST7701SN=y
CONFIG_LCD_AML01=y

#
# lcd function macro
#
CONFIG_LCD_MEDIA=y
CONFIG_LCD_ROTATE=y
CONFIG_LCD_HW_PFC=y
CONFIG_LCD_HW_DECODE=y
CONFIG_LCD_SW_DECODE=y
# end of lcd function macro

CONFIG_DMA2D=y
CONFIG_JPEGDEC_HW=y
CONFIG_JPEGDEC_SW=y
CONFIG_HW_SCALE=y
# end of Video

#
# CALENDAR
#
CONFIG_CALENDAR=n
# end of CALENDAR

#
# System control
#
# CONFIG_SYS_REDUCE_NORMAL_POWER is not set
CONFIG_PM_V2=y
# CONFIG_XTAL_FREQ_40M is not set
CONFIG_XTAL_FREQ_26M=y
CONFIG_XTAL_FREQ=26000000
CONFIG_DCO_FREQ=120000000
CONFIG_SYSTEM_CLOCK=y
# end of System control

#
# PHY
#
# CONFIG_PTA is not set
# end of PHY

#
# I2S
#
CONFIG_I2S=y
CONFIG_I2S_TEST=y
# end of I2S

#
# pwm
#
CONFIG_PWM=n
CONFIG_PWM_V1PX=y
# end of pwm

# CONFIG_SUPPORT_IRDA is not set

#
# efuse
#
CONFIG_EFUSE=n

#
# vfs
#
CONFIG_VFS=y
CONFIG_VFS_TEST=y

# end of Driver

#
# LwIP 2.0.2
#
CONFIG_LWIP=y
CONFIG_DHCP=y
CONFIG_TASK_LWIP_PRIO=4
# CONFIG_LWIP_MEM_DEFAULT is not set
CONFIG_LWIP_MEM_REDUCE=y

# end of LwIP 2.0.2

#
# LwIP 2.1.2
#
# end of LwIP 2.1.2

#
# Bk_netif
#
CONFIG_BK_NETIF=y
CONFIG_NETIF_LWIP=y
# end of Bk_netif

# CONFIG_MP3PLAYER is not set
# CONFIG_PCM_RESAMPLER is not set

#
# Power Save
#
# CONFIG_AP_IDLE is not set
# CONFIG_FAKE_RTC_PS is not set
# CONFIG_PM_MODEM_PWD is not set
# CONFIG_PM_STANDALONE is not set
CONFIG_PM_V2=y
# end of Power Save

#
# PWR_CLK
#
CONFIG_PM_DEMO_ENABLE=y
CONFIG_PM_CLI_ENABLE=y
CONFIG_PM_LV_SUBCORES_ON=y
# end of PWR_CLK

#
# RF Test
#
CONFIG_TX_EVM_TEST=y
CONFIG_RX_SENSE_TEST=y
# end of RF Test

#
# WiFi RWNX Interface
#
CONFIG_WIFI_KMSG_TASK_PRIO=3
CONFIG_WIFI_KMSG_TASK_STACK_SIZE=4096
CONFIG_WIFI_CORE_TASK_PRIO=2
CONFIG_WIFI_CORE_TASK_STACK_SIZE=2048
CONFIG_RWNX_QOS_MSDU=y
CONFIG_RWNX_SW_TXQ=n
CONFIG_RWNX_FAST_CONNECT=y
# end of WiFi RWNX Interface


CONFIG_SARADC=y
CONFIG_SARADC_MB=y
# CONFIG_SARADC_CALI=y
# CONFIG_SPIDMA is not set
CONFIG_TEMP_DETECT=n
CONFIG_SARADC_NEED_FLUSH=n
CONFIG_SARADC_RANGE_DIVIDE=y
# CONFIG_UART_DEBUG is not set
# CONFIG_UDISK_MP3 is not set
# CONFIG_WFA_CA is not set

#
# Supplicant
#
CONFIG_TASK_WPAS_PRIO=5
CONFIG_WPA3=y
CONFIG_PMF=y
CONFIG_WPA_CTRL_IFACE=y
CONFIG_AP_HT_IE=y
CONFIG_AP_VHT=y
CONFIG_AP_HE=y
# CONFIG_WPA_TWT_TEST is not set
CONFIG_STA_AUTO_RECONNECT=y
# CONFIG_WPA_LOG is not set
# end of Supplicant
# end of Components Configuration
# end of ARMINO Configuration

#
# DEMOS_CONFIG
#
CONFIG_FFT=n
# end of DEMOS_CONFIG

CONFIG_TFM=n
CONFIG_SDMADC=y
CONFIG_SDMADC_TEST=y

CONFIG_HW_ROTATE_PFC=y
CONFIG_HW_ROTT_TEST=n
#
# CONFIG_FREERTOS_USE_TICKLESS_IDLE
#
CONFIG_FREERTOS_USE_TICKLESS_IDLE=1
#
# CONFIG_SYSTICK_32K
#
CONFIG_SYSTICK_32K=y

CONFIG_TIMER_US=y
CONFIG_TIMER_SUPPORT_ID_BITS=56

CONFIG_UART_LOW_VOLTAGE_SUPPORT=y
#
#GPIO for Power Save: WANIING: modify it should check properties/soc/bk7256/bk7256.defconfig also
#
CONFIG_GPIO_WAKEUP_SUPPORT=n
CONFIG_GPIO_DYNAMIC_WAKEUP_SUPPORT=n
CONFIG_GPIO_DYNAMIC_WAKEUP_SOURCE_MAX_CNT=4
CONFIG_GPIO_WAKEUP_DEBUG=n
CONFIG_GPIO_DEFAULT_SET_SUPPORT=n
CONFIG_WIFI_VNET_CONTROLLER=y

CONFIG_CAN=n
CONFIG_CAN_TEST=n

CONFIG_NTP_SYNC_RTC=n
CONFIG_AON_RTC_KEEP_TIME_SUPPORT=y

#
#ETH config
#
CONFIG_ETH=n
CONFIG_PHY_SMSC=y
CONFIG_ETH_PIN_GROUP1=y
CONFIG_ETH_DHCP=n

#
# Bk_Modem
#
CONFIG_BK_MODEM=n
CONFIG_LWIP_PPP_SUPPORT=n
CONFIG_USB_CDC_MODEM=n
CONFIG_USB_CDC=n
```

## t5_os/cp/components/bk_bluetooth/Kconfig
```kconfig
menu "Bk_ble"
	depends on BLUETOOTH

	config BT
		bool "Enable Bt"
		default n

	config BLE
		bool "Enable Ble"
		default y

	choice BLE_STACK
		prompt "Select Ble Version"
		depends on (BLE || BT)
		default BLE_5_X

		config BLE_5_X
			bool "BLE 5.X"
		config BLE_4_2
			bool "BLE 4.2"
		config BTDM_5_2
			bool "BTDM 5.2"
		config BTDM_5_2_MINDTREE
			bool "BTDM 5.2 Mindtree Host"
	endchoice

	config BTDM_CONTROLLER_ONLY
		bool "BTDM controller only"
		default y

	config BLUETOOTH_RELEASE_CODESIZE
		bool "reduce ble stack size"
		depends on BLE
		default n
		help
			This option is used to reduce ble stack size for IoT scenarios that
			only use ble provisioning network.It supports two ble advertise,
			one ble link, and ble scan at the same time.it does not support SMP and central role.
			when config this option,BLUETOOTH_BLE_SLAVE_ONLY will be invalid.

	config BLUETOOTH_BLE_SLAVE_ONLY
		bool "only supports ble slave"
		depends on !BLUETOOTH_RELEASE_CODESIZE
		default n

    config BLUETOOTH_BLE_DISCOVER_AUTO
        bool "auto ble discover. Only used when single ble host"
        default y
    config BLUETOOTH_SUPPORT_LPO_ROSC
        bool "support lpo rosc"
        default n
    config BLUETOOTH_SUPPORT_IPC
        bool "bt support ipc"
        default y

endmenu
```

## t5_os/cp/components/bk_phy/Kconfig
```kconfig
#TODO optimize it
menu "Bk_Phy"

	config PHY_LOG_ENABLE
		bool "Enable voltage detect"
		default n

	config PHY_SERVER
		bool "Enable PHY server"
		default y

	config PHY_MB
		bool "Enable PHY mailbox"
		default y

endmenu
```
