## t5_os/cp/components/bk_rtos/Kconfig
```kconfig
menu "Bk_rtos"

	config CUSTOMIZE_HEAP_SIZE
		int "Set Customize Heap Size"
		default 163840
		help
			customize heap size, default 160k
    
	config PSRAM_HEAP_INIT_SET_ZERO
		bool "Set psram content zero"
		default n
		help
			when initialising psram memory,its contents are 
			automatically zeroed.

	menu "Modify FreeRTOS Config"
		config FREERTOS
			bool "Enable FreeRTOS"
			default y

		config FREERTOS_FPU_ENABLE
			bool "Enable FreeRTOS FPU"
			default y

		config FREERTOS_USE_QUEUE_SETS
			depends on FREERTOS
			bool "Enable FreeRTOS Queue_Sets"
			default n

		config MEM_MGMT
			bool "Enable Mem Mgmt"
			default n
			help
				Enable heap management module

		choice FREERTOS_VER
			depends on FREERTOS
			prompt "Select FreeRTOS Version"
			default FREERTOS_V9

			config FREERTOS_V9
				bool "FreeRTOS v9.0.0"
			config FREERTOS_V10
				bool "FreeRTOS v10"
			config FREERTOS_SMP
				bool "FreeRTOS SMP v10"
		endchoice

		config FREERTOS_POSIX
			depends on FREERTOS_V10 || FREERTOS_SMP
			bool "Enable FreeRTOS Posix"
			default n

		config FREERTOS_TRACE
			depends on FREERTOS_V10
			bool "FreeRTOS Trace"
			default n

		config TASK_STACK_IN_PSRAM
			depends on FREERTOS_V10
			bool "Create FreeRTOS Task stack in psram"
			default n
		
		config QUEUE_IN_PSRAM
			depends on FREERTOS_V10
			bool "Create FreeRTOS queue in psram"
			default n

		config FREERTOS_ALLOW_OS_API_IN_IRQ_DISABLED
			depends on FREERTOS_SMP
			bool "Allow Call OS API in IRQ disabled"
			default n
			help
				Allow call some OS API in irq disabled, and scheduler will not enable
				the irq but left the user app to restore previous irq status.

		config FREERTOS_SMP_TEMP
			depends on FREERTOS_SMP
			bool "SMP TEMP code"
			default n

		config FREERTOS_RTT_MONITOR
			depends on FREERTOS_SMP
			bool "FreeRTOS Segger Real-Time Transfer"
			default n

		config FREERTOS_USE_TICKLESS_IDLE
			depends on FREERTOS_V10 || FREERTOS_SMP
			int "Set FreeRTOS Use Tickless Idle"
			default 2
			help
				Use tickless idle, can be 0/1/2

		config FREERTOS_TICK_RATE_HZ
			depends on FREERTOS
			int "Set FreeRTOS tick count per second"
			default 1000
			help
				System tick count per second, can be 1-1000
        
        config BK_OS_TIMER_DEBUG
            bool "Enable OS timer Debug"
            default n
            help
				when turn on the marco,the current task TCB information
				will be added every time the software timer command is sent
        
		config DEBUG_RTOS_TIMER
			bool "Enable OS adapter layer timer Debug"
			default n
			help
				when turn on the marco, the System will output timer related
				debug information

		config RTOS_TIMER_DEBUG_CNT
            depends on DEBUG_RTOS_TIMER
			int "OS adapter layer timer Debug count value"
			default 128
			help
				set OS adapter layer timer Debug count value       

	endmenu

	menu "Modify LITEOS_M Config"

		config LITEOS_M
			bool "Enable Liteos_m"
			default n

		config LITEOS_M_V3
			bool "Enable Liteos_m_v3"
			default n
			help
				liteos_m v3.0.1-LTS

		config LITEOS_M_BK
			depends on LITEOS_M_V3
			bool "Enable Liteos_m_bk"
			default n
			help
				liteos_m bk adapter

	endmenu

	menu "Modify NON_OS Config"

		config NON_OS
			bool "Enable Non_os"
			default n

	endmenu

	menu "Modify Memory Debug Config"

		config MALLOC_STATIS
			bool "Enable Malloc Statis"
			default n
			help
				enable malloc statistics

		config MEM_DEBUG
			bool "Enable Mem Debug"
			default n
			help
				When this option is enable, more memory will be consumed because
				a fixed length debug block will be appended to every memory allocated
				from heap.
				Moreover, suggest disable task/watchdog when this option is enabled
				in case os_dump_memory_stats() triggers watchdog.

		config MEM_DEBUG_FUNC_NAME
			depends on MEM_DEBUG
			bool "Enable Mem Debug Func Name"
			default y

		config MEM_DEBUG_FUNC_NAME_LEN
			depends on MEM_DEBUG_FUNC_NAME
			int "Set Mem Debug Func Name Len"
			default 16
			help
				set memory debug function name length

		config MEM_DEBUG_TASK_NAME
			depends on MEM_DEBUG
			bool "Enable Mem Debug Task Name"
			default y

		config MEM_DEBUG_TASK_NAME_LEN
			depends on MEM_DEBUG_TASK_NAME
			int "Set Mem Debug Task Name Len"
			default 8
			help
				set memory debug task name length
        
        config MEM_DEBUG_OVERFLOW
			bool "Enable memory overflow debug"
			default n
        
		config MEM_OVERFLOW_FREE_RECORD_MAX
			depends on MEM_DEBUG_OVERFLOW
			int "Set memory overflow free record len"
			default 512
        
        config MEM_OVERFLOW_MALLOC_RECORD_MAX
			depends on MEM_DEBUG_OVERFLOW
			int "Set memory overflow malloc record len"
			default 256
        
        config MEM_OVERFLOW_FREELIST_RECORD_MAX
			depends on MEM_DEBUG_OVERFLOW
			int "Set memory overflow freelist record len"
			default 128

	endmenu

endmenu
```

## t5_os/cp/components/controller_if/Kconfig
```kconfig
menu "Controller IF"
	config CTRL_IF_TP
		bool "Controller Interface Throughput debug"
		default n
	config CONTROLLER_RX_DIRECT_PSH
		bool "Controller RX Buf Directly push to AP"
		default y
	config CONTROLLER_WAR
		bool "Controller RX Buf Directly push to AP"
		default y
	config CONTROLLER_DEBUG
		bool "Controller Debug"
		default n
endmenu
```

## t5_os/cp/middleware/driver/saradc/Kconfig
```kconfig
menu "SARADC"
	config SARADC
		bool "Enable saradc"
		default y

	config SARADC_SERVER
		bool "Enable SARADC server"
		depends on SARADC
		default y

	config SARADC_NEED_FLUSH
		bool "SARADC whether need flush data"
		default y

	config SARADC_RANGE_DIVIDE
		bool "Enable saradc measure range divide"
		default n

	config SARADC_PM_CB_SUPPORT
		bool "saradc pm support"
		depends on SARADC
		default n

	config ADC_BUF_SIZE
		int "config adc receive buffer size"
		default 32
		
	config SARADC_TEST
		depends on SARADC && DRIVER_TEST
		bool "Enable saradc test"
		default y

	config SADC_API_TEST
		bool "saradc api test"
		depends on SARADC
		default n

	config ADC_API_TEST
		depends on SARADC
		bool "Enable adc api test"
		default n

	config SARADC_MB
		bool "Enable SARADC mailbox"
		depends on SARADC
		default n

endmenu	
```

## t5_os/cp/middleware/soc/bk7258/bk7258.defconfig
```kconfig
CONFIG_SOC_ARCH="cm33"
CONFIG_SOC_BK7236XX=y
CONFIG_SOC_BK7236_V5=y
CONFIG_SOC_BK7258=y
CONFIG_SOC_STR="bk7258"
CONFIG_ARCH_CM33=y
CONFIG_CMSIS=y
CONFIG_BUILD_DEFAULT_VERSION=y
# CONFIG_DEFAULT_CMSIS_START is not set
CONFIG_FPGA=y
CONFIG_SPE=1
CONFIG_CPU_CNT=3
# CONFIG_ASSERT_HALT is not set
# CONFIG_ASSERT_REBOOT is not set
# CONFIG_JTAG is not set
CONFIG_FREERTOS_TRACE=n
CONFIG_LWIP_V2_1=y
CONFIG_NO_HOSTED=y
# CONFIG_SEMI_HOSTED is not set
# CONFIG_FULLY_HOSTED is not set
# CONFIG_WIFI_SENSOR is not set
# CONFIG_DEMO_TEST is not set
# CONFIG_FTPD_UPGRADE is not set
CONFIG_OTA_HTTP=y
# CONFIG_OTA_TFTP is not set
CONFIG_AT=y
CONFIG_AT_SUPPORT_MULTICORE=n
CONFIG_DEFAULT_AT_PORT=0
CONFIG_WIFI_AT_ENABLE=y
CONFIG_MISC_AT_ENABLE=y
CONFIG_BT_AT_ENABLE=y
CONFIG_BLE_AT_ENABLE=y
CONFIG_NETIF_AT_ENABLE=y
CONFIG_AT_CMD=n

CONFIG_CALI=y
CONFIG_MANUAL_CALI=y
CONFIG_TPC_PA_MAP=y
CONFIG_ATE=y
CONFIG_ATE_TEST=n
CONFIG_BLE=y
CONFIG_BLE_5_X=n
CONFIG_BTDM_5_2=y
CONFIG_BTDM_5_T_MINDTREE=n
CONFIG_BT=n
# CONFIG_BLE_4_2 is not set
CONFIG_CLI=y
CONFIG_LOG_LEVEL=6
CONFIG_BKREG=y
# CONFIG_TCP_SERVER_TEST is not set
# CONFIG_AIRKISS_TEST is not set
# CONFIG_WIFI_RAW_TX_TEST is not set
# CONFIG_UART_TEST is not set
# CONFIG_PERI_TEST is not set
# CONFIG_RF_OTA_TEST is not set
CONFIG_SHELL_ASYNCLOG=y
CONFIG_DYM_LOG_MEM_MAX=0x10000
CONFIG_RF_POLICY_BLE_REQ=y
# CONFIG_RF_POLICY_WIFI_REQ is not set
# CONFIG_RF_POLICY_CO_REQ is not set
CONFIG_CHECK_MISMATCH=y
CONFIG_MCU_PS=y
# CONFIG_DEEP_PS is not set
CONFIG_TICK_CALI=y
CONFIG_STA_PS=y
CONFIG_FREERTOS=y
# CONFIG_LITEOS_M is not set
CONFIG_FREERTOS_V9=n
CONFIG_FREERTOS_V10=y
# CONFIG_MALLOC_STATIS is not set
CONFIG_MEM_DEBUG=y
CONFIG_CM_BACKTRACE=y
CONFIG_APP_MAIN_TASK_PRIO=4
CONFIG_APP_MAIN_TASK_STACK_SIZE=4096
CONFIG_FLASH_SIZE_4M=y
CONFIG_FLASH_QUAD_ENABLE=y
CONFIG_FLASH_MB=y
# CONFIG_BASE_MAC_FROM_EFUSE is not set
# CONFIG_BASE_MAC_FROM_RF_OTP_FLASH is not set
CONFIG_NEW_MAC_POLICY=y
CONFIG_BK_MAC_ADDR_CHECK=y

#
# Spinlock
#
CONFIG_SPINLOCK=y
CONFIG_SPINLOCK_SECTION=y
CONFIG_SPINLOCK_DYNAMIC_CNT=512
CONFIG_SPINLOCK_STATIC_CNT=128
# end of Spinlock

#
# Mbedtls
#
CONFIG_PSA_MBEDTLS=y
CONFIG_FULL_MBEDTLS=n
CONFIG_MBEDTLS_USE_PSA_CRYPTO=n
CONFIG_TRUSTENGINE=n
CONFIG_SW_CRYPTO=y
CONFIG_TE200_ENTROPY=n
CONFIG_MBEDTLS_LOG_LEVEL="OFF"
CONFIG_PSA_MBEDTLS_TEST=n
CONFIG_TRUSTENGINE_TEST=n
# end of Mbedtls

#
# USB configuration
#
CONFIG_USB=n
# end of USB configuration

CONFIG_WIFI_IP_AX_NEXT=y
CONFIG_WIFI6_CODE_STACK=y
CONFIG_WIFI6=y
CONFIG_WIFI4=y
CONFIG_MSDU_RESV_TAIL_LENGTH=16
CONFIG_TASK_RECONNECT_PRIO=4
CONFIG_WIFI_MAC_VERSION="V22"
CONFIG_WIFI_MDM_VERSION="v32"
CONFIG_WIFI_PLF_VERSION="v32"
CONFIG_MM_PS_SET_LISTEN_INTERVAL_VALUE=30
CONFIG_MOBILE_CONNECT_SAP_STATISTICS=y
# CONFIG_AP_MONITOR_COEXIST is not set
CONFIG_WIFI_FAST_CONNECT=y
# CONFIG_BSSID_CONNECT is not set
# CONFIG_WFA_CERT is not set
# CONFIG_LESS_MEMERY_IN_RWNX is not set
# CONFIG_AP_PROBEREQ_CB is not set
# CONFIG_MM_PS_BASED_ON_LISTEN_INTERVAL is not set
CONFIG_WIFI6_IP_DEBUG=y
CONFIG_BLE_PS=y
# CONFIG_BLE_HOST_NONE is not set
CONFIG_BLE_HOST_RW=y
# CONFIG_BLE_HOST_ZEPHYR is not set
CONFIG_BLE_MESH_NONE=y
# CONFIG_BLE_MESH_RW is not set
CONFIG_BLE_ADV_NUM=1
CONFIG_BLE_SCAN_NUM=1
CONFIG_BLE_INIT_NUM=1
CONFIG_BLE_CONN_NUM=1
CONFIG_AON_RTC=y
CONFIG_AON_RTC_64BIT=y
CONFIG_AON_RTC_MANY_USERS=y
CONFIG_AON_RTC_DEBUG=n
CONFIG_SYSTEM_CTRL=y
CONFIG_HAL_DEBUG_SYS=y
CONFIG_AON_PMU=y
CONFIG_INT_WDT=y
CONFIG_INT_WDT_PERIOD_MS=8000
CONFIG_TASK_WDT=y
CONFIG_TASK_WDT_PERIOD_MS=16000
CONFIG_NMI_WDT_EN=y
CONFIG_AON_WDT=n
CONFIG_INT_AON_WDT=n
CONFIG_INT_AON_WDT_PERIOD_MS=8000
CONFIG_UART0=y
CONFIG_UART1=y
CONFIG_UART2=y
CONFIG_UART_ATE_PORT=0
CONFIG_SYS_PRINT_DEV_UART=y
CONFIG_SYS_PRINT_DEV_MAILBOX=n
CONFIG_UART_PRINT_PORT=0
CONFIG_PRINTF_BUF_SIZE=256
# CONFIG_BACKGROUND_PRINT is not set
CONFIG_KFIFO_SIZE=128
CONFIG_UART_ERR_INTERRUPT=y
CONFIG_UART0_FLOW_CTRL=n
# CONFIG_UART_STATIS is not set
CONFIG_UART_PM_CB_SUPPORT=n
CONFIG_TRNG_SUPPORT=y
CONFIG_RANDOM_MAC_ADDR=y
CONFIG_MAC_PHY_BYPASS=y

# CONFIG_CALENDAR is not set
# CONFIG_SYS_REDUCE_NORMAL_POWER is not set
# CONFIG_XTAL_FREQ_40M is not set
CONFIG_XTAL_FREQ_26M=y
CONFIG_XTAL_FREQ=26000000
CONFIG_DCO_FREQ=120000000
CONFIG_SYSTEM_CLOCK=y
# CONFIG_PTA is not set
CONFIG_I2S=y
CONFIG_MAILBOX=y
CONFIG_MAILBOX_V2_0=y
CONFIG_SLAVE_HEART_BEAT=y
CONFIG_EASY_FLASH=y
CONFIG_EASY_FLASH_V4=y

CONFIG_DHCP=y

#
# LwIP
#
CONFIG_LWIP=y
CONFIG_TASK_LWIP_PRIO=4
# CONFIG_LWIP_MEM_DEFAULT is not set
CONFIG_LWIP_MEM_REDUCE=y
# Enable LWIP mem/memp malloc from HEAP
CONFIG_LWIP_MEM_LIBC_MALLOC=y
CONFIG_LWIP_MEMP_MEM_MALLOC=y
# end of LwIP

# CONFIG_MP3PLAYER is not set
# CONFIG_PCM_RESAMPLER is not set
# CONFIG_AP_IDLE is not set
# CONFIG_FAKE_RTC_PS is not set
# CONFIG_PM_MODEM_PWD is not set
# CONFIG_PM_STANDALONE is not set
CONFIG_PM_V2=y
CONFIG_TX_EVM_TEST=y
CONFIG_RX_SENSE_TEST=y
CONFIG_WIFI_KMSG_TASK_PRIO=3
CONFIG_WIFI_KMSG_TASK_STACK_SIZE=4096
CONFIG_WIFI_CORE_TASK_PRIO=2
CONFIG_WIFI_CORE_TASK_STACK_SIZE=2048
CONFIG_RWNX_QOS_MSDU=y
CONFIG_RWNX_SW_TXQ=y
CONFIG_RWNX_FAST_CONNECT=y
CONFIG_TEMP_DETECT=y
CONFIG_VOLT_DETECT=y
CONFIG_PHY_LOG_ENABLE=n
CONFIG_SARADC_NEED_FLUSH=n
CONFIG_SARADC_RANGE_DIVIDE=n
CONFIG_SARADC_PM_CB_SUPPORT=y
# CONFIG_UART_DEBUG is not set
# CONFIG_UDISK_MP3 is not set
# CONFIG_WFA_CA is not set
CONFIG_TASK_WPAS_PRIO=5
CONFIG_WPA3=y
CONFIG_PMF=y
CONFIG_WPA_CTRL_IFACE=y
CONFIG_AP_HT_IE=y
CONFIG_AP_VHT=y
CONFIG_AP_HE=y
# CONFIG_WPA_TWT_TEST is not set
CONFIG_STA_AUTO_RECONNECT=n
# CONFIG_WPA_LOG is not set
CONFIG_LCD_TEST=n
CONFIG_DMA2D_TEST=n
#CONFIG_DOORBELL=y
CONFIG_FFT=n
CONFIG_CKMN=y
CONFIG_TFM=n
CONFIG_SDMADC=y
CONFIG_SDMADC_TEST=y
CONFIG_FREERTOS_USE_TICKLESS_IDLE=2
CONFIG_SYSTICK_32K=y
CONFIG_TIMER_US=y
CONFIG_TIMER_SUPPORT_ID_BITS=7
CONFIG_TIMER_PM_CB_SUPPORT=y
CONFIG_UART_LOW_VOLTAGE_SUPPORT=y
CONFIG_GPIO_WAKEUP_SUPPORT=y
CONFIG_GPIO_DYNAMIC_WAKEUP_SUPPORT=y
CONFIG_GPIO_DYNAMIC_WAKEUP_SOURCE_MAX_CNT=4
CONFIG_GPIO_WAKEUP_DEBUG=n
CONFIG_GPIO_DEFAULT_SET_SUPPORT=y
CONFIG_OTP_V1=y
CONFIG_OTP_TEST=y
CONFIG_PHY_RFCALI_TO_OTP=n
CONFIG_PUF_TEST=y
CONFIG_WIFI_ADAPTER=y
CONFIG_NET_PARAM_INTF=y
CONFIG_BLUETOOTH=y
CONFIG_TOUCH_TEST=y
CONFIG_SPE_TEST=n
CONFIG_INTERRUPT_TEST=y
CONFIG_AON_PMU_TEST=y
CONFIG_CACHE_ENABLE=n
CONFIG_MPU=y
CONFIG_TOUCH=y

#
# PSRAM
#
CONFIG_PSRAM=y
CONFIG_PSRAM_TEST=y
CONFIG_PSRAM_AS_SYS_MEMORY=y

CONFIG_PSRAM_WRITE_THROUGH=y
CONFIG_PSRAM_CALIBRATE=y
CONFIG_PSRAM_AUTO_DETECT=y
# end of PSRAM

CONFIG_LDO_SELF_LOW_POWER_MODE_ENA=y
CONFIG_VND_CAL=y
CONFIG_ANA_REG_WRITE_POLL_REG_B=n
CONFIG_OBJDUMP=n
#
# PWR_CLK
#
CONFIG_EXTERN_32K=n
CONFIG_LPO_SRC_26M32K=n
CONFIG_BUCK_ENABLE=y
CONFIG_RX_OPTIMIZE=n
CONFIG_BAKP_POWER_DOMAIN_DISABLE=y
CONFIG_PSRAM_POWER_DOMAIN_LV_DISABLE=n
CONFIG_AHBP_POWER_DOMAIN_LV_DISABLE=n
CONFIG_CPU_DEFAULT_FREQ_60M=y
CONFIG_DCO_CLK_ENABLE=n
CONFIG_VBSPBUFLP1V_ENABLE=y
CONFIG_LV_FLASH_ENTER_LP_ENABLE=n
CONFIG_LPO_MP_A_FORCE_USE_EXT32K=y
CONFIG_ROSC_CALIB_SW=y
CONFIG_LP_VOL=0x6
CONFIG_DIGLDO_LOW_VOLTAGE_ENABLE=n
CONFIG_PM_LV_TIME_COST_DEBUG=n
CONFIG_PM_26M_STABILITY_DELAY_TIME_HARDWARE=1800
CONFIG_PM_LV_SUBCORES_ON=y
# end of PWR_CLK
CONFIG_LIN=n
CONFIG_LIN_DEVICE_MASTER=n
CONFIG_GENERAL_DMA=y
CONFIG_DMA_LOGIC_CHAN_CNT=4
CONFIG_DMA_LOGIC_CHAN_ID_MIN=12
#
# bk7258 sram
#
CONFIG_DTCM_SIZE=0x3FE0
# end of bk7258 sram

CONFIG_PM_ENABLE=y
CONFIG_PM_SUPER_DEEP_SLEEP=y
CONFIG_RTC_ANA_WAKEUP_SUPPORT=y
CONFIG_GPIO_ANA_WAKEUP_SUPPORT=y
CONFIG_BAKP_POWER_DOMAIN_PM_CONTROL=y

CONFIG_GET_UID_ENABLE=y
CONFIG_GET_UID_TEST=y
CONFIG_GPIO_RETENTION_SUPPORT=y
CONFIG_FLASH_WRITE_STATUS_VOLATILE=n

CONFIG_WIFI_VNET_CONTROLLER=y
CONFIG_MINIMUM_SCAN_RESULTS=y
```
