## t5_os/ap/components/bk_audio/audio_streams/uac_speaker_stream/Kconfig
```kconfig
menu "Adk::Audio_streams::Uac_speaker_stream"
	config ADK_UAC_SPEAKER_STREAM
		depends on ADK
		depends on USBH_UAC
		bool "Enable uac speaker stream"
		default n

	config ADK_UAC_SPEAKER_STREAM_TEST
		depends on ADK_UAC_SPEAKER_STREAM
		depends on ADK_RAW_STREAM
		bool "Enable uac speaker stream test"
		default n

endmenu
```

## t5_os/ap/components/bk_audio/audio_streams/uart_stream/Kconfig
```kconfig
menu "Adk::Audio_streams::Uart_stream"
	config ADK_UART_STREAM
		depends on ADK
		bool "Enable uart stream"
		default n

	config ADK_UART_STREAM_TEST
		depends on ADK_UART_STREAM
		bool "Enable uart stream test"
		default n

endmenu
```

## t5_os/ap/components/bk_audio/audio_streams/vfs_stream/Kconfig
```kconfig
menu "Adk::Audio_streams::Vfs_stream"
	config ADK_VFS_STREAM
		depends on ADK
		depends on VFS
		bool "Enable Audio VFS stream"
		default n

	config ADK_VFS_STREAM_TEST
		depends on ADK_VFS_STREAM
		bool "Enable Audio VFS stream test"
		default n

endmenu
```

## t5_os/ap/components/bk_audio/audio_utils/Kconfig
```kconfig
menu "Adk::Audio_utils"

	config ADK_UTILS
		bool "Enable ADK Debug Utils"
		default y

	config ADK_UART_UTIL
		depends on ADK_UTILS
		bool "Enable ADK Uart Debug Util"
		default y

	config ADK_COUNT_UTIL
		depends on ADK_UTILS
		bool "Enable ADK Count Debug Util"
		default y

	config ADK_VFS_UTIL
		depends on ADK_UTILS && VFS
		bool "Enable ADK Vfs Debug Util"
		default y

endmenu
```

## t5_os/ap/components/bk_bluetooth/Kconfig
```kconfig
menu "Bk_ble"
	config BLUETOOTH_AP
		bool "bluetooth ap"
		default y

    config BLUETOOTH_HOST_ONLY
		bool "bluetooth host only"
		depends on BLUETOOTH_AP
		default y

	config BT
		bool "Enable Bt"
		depends on BLUETOOTH_HOST_ONLY
		default n

	config BLE
		bool "Enable Ble"
		depends on BLUETOOTH_HOST_ONLY
		default y

	config BLUETOOTH_RELEASE_CODESIZE
		bool "reduce ble stack size"
		depends on BLE
		default n
		help
			This option is used to reduce ble stack size for IoT scenarios that
			only use ble provisioning network.It supports two ble advertise,
			one ble link, and ble scan at the same time.it does not support SMP and central role.
			when config this option,BLUETOOTH_BLE_SLAVE_ONLY will be invalid.

	config BLUETOOTH_BLE_SLAVE_ONLY
		bool "only supports ble slave"
		depends on !BLUETOOTH_RELEASE_CODESIZE
		default n

    config BLUETOOTH_BLE_DISCOVER_AUTO
        bool "auto ble discover. Only used when single ble host"
        default y

    config BLUETOOTH_SUPPORT_IPC
        bool "bt support ipc"
		depends on BLUETOOTH_AP
        default y

endmenu
```

## t5_os/ap/components/bk_draw_blend/Kconfig
```kconfig
menu "Draw Blend"

	config BLEND
        depends on MEDIA
		bool "Enable Draw Blend"
		default y

	config BLEND_TASK_STACK_SIZE
        depends on MEDIA
		int "blend task stack size"
		default 4096

endmenu
```

## t5_os/ap/components/bk_dvp/Kconfig
```kconfig
menu "CAMERA"
	config DVP_CAMERA
		bool "Enable Camera"
		depends on YUV_BUF
		depends on GENERAL_DMA
		default n
		help
			Enable camera interface

	config DVP_CAMERA_I2C_ID
		int "Set Camera I2c Id"
		range 0 2
		default 0
		help
			The value should be changed if need to change i2c id

	config DVP_POWER_GPIO_CTRL
		bool "Enable dvp camera power gpio ctrl"
		default n

	config DVP_CTRL_POWER_GPIO_ID
		int "the gpio id control dvp camera power"
		default 9

	config ENCODE_BUF_NOT_FREE
		bool "encode buffer when repeate malloc and free, cannot malloc success, so not free, until close all vidoe function"
		default n

	config JPEG_FRAME_SIZE
		int "config a jpeg frame size unit(byte), range 0-200k, default 100k"
		range 0 204800
		default 102400

	config H264_FRAME_SIZE
		int "config a h264 NALU size unit(byte), range 0-200k, default 100k"
		range 0 204800
		default 102400

endmenu
```

## t5_os/ap/components/bk_player_service/Kconfig
```kconfig
menu "Bk_player_service"

	config PLAYER_SERVICE
		bool "Enable bk_player_service"
		depends on ADK
		default n
		help
			Enable the bk_player_service Interface API for playing prompt tones or music

	config PLAYER_SERVICE_TEST
		depends on PLAYER_SERVICE
		bool "Enable bk_player_service Test"
		default n
		help
			Enable bk_player_service test to test bk_player_service by cli command

endmenu
```

## t5_os/ap/components/bk_usb/Kconfig
```kconfig
menu "Bk_usb"

	config USB
		bool "Enable Usb"
		default n

	config USB_VBAT_CONTROL_GPIO_ID
		depends on USB
		hex "Vbat control gpio id"
		default 0xFF
		help
			USB VBAT CONTROL GPIO ID

	menu "Modify Usb Config"
		depends on USB

		config USB_HOST
			bool "Enable USB Host Mode"
			default y
	
		config USB_DEVICE
			bool "Enable USB Device Mode"
			default n

		config TASK_USB_PRIO
			int "Set Task Usb Prio"
			range 1 10
			default 7
			help
				Priority of USB task

		config USB_DMA_ENABLE
			bool "Enable usb ip DMA"
			default n

		config USB_HUB
			depends on USB_HOST
			bool "Enable USB hub"
			default y

		menu "USB_HUB_MULTIPLE_DEVICES_IDENTIFICATION"
			depends on USB_HUB
				config USB_HUB_MULTIPLE_DEVICES
					bool "Enable MULTIPLE DEVICE IDENTIFICATION by hub"
					default n
					help
						Enable MULTIPLE DEVICE IDENTIFICATION by hub
						
				config USB_HUB_MULTIPLE_DEVICES_DEBUG
					bool "Enable MULTIPLE DEVICE IDENTIFICATION by hub"
					default n
					help
						Enable MULTIPLE DEVICE IDENTIFICATION debug
						
				config USBHOST_HUB_MAX_EHPORTS
					int "Set hub port number"
					range 1 10
					default 4
					help
						HUB MAX EHPORTS

				config USBHOST_HUB_PORT_SUPPORT_MAX_DEVICE
					int "SUPPORT_MAX_DEVICE"
					range 1 10
					default 3
					help
						SUPPORT_MAX_DEVICE

				config USBHOST_HUB_PORT_1_VBAT_CONTROL_GPIO_ID
					hex "Vbat control gpio id"
					default 0xFF
					help
					USB usb hub port index Vbus control gpio_id
		endmenu

		config USBH_MSC
			bool "Enable Usb Host MSC"
			depends on FATFS
			default n

		config USBD_MSC
			bool "Enable Usb Device MSC"
			default n

		config USBH_UVC
			bool "Enable Usb Host Uvc"
			default n
		
		config USBD_UVC
			bool "Enable Usb Device Uvc"
			default n

		config USBH_UAC
			bool "Enable Usb Host Uac"
			default n

		config USBD_UAC
			bool "Enable Usb Device Uac"
			default n

		config USBH_HID
			bool "Enable Usb Hid"
			default n

		config USBD_HID
			bool "Enable Usb Hid"
			default n

        config USB_UPC
            bool "Enable Usb Upc"
            default n

		config USB_CDC
			bool "Enable Usb Cdc"
			default n

		config USB_CHARGE
			bool "Enable Usb Charge"
			default n

		config USBH_SERIAL_CH340
			bool "Enable Usbh simulate serial ch340"
			default n
		config USBH_SERIAL_CH340_TEST
			bool "Enable Usbh simulate serial ch340"
			default n
	endmenu

    config STANDARD_DUALSTREAM
        bool "Standard dual stream"
        default n
    
    config UVC_DUAL_DEVICE
        #depends on STANDARD_DUALSTREAM
        int "the num for uvc_device"
        range 1 2
        default 1 if !STANDARD_DUALSTREAM
        default 2 if STANDARD_DUALSTREAM

    config USB_CDC_MODEM
        bool "Enable device usb cdc for 4G module"
        help
            This macro needs to be opened on cp0 and cp1 when USB in cp1.
        default n

    config USBHOST_MAX_CDC_ACM_CLASS
    	depends on USB_CDC
        int "the num for CDC"
        default 1

endmenu
```

## t5_os/ap/components/bk_uvc/Kconfig
```kconfig
menu "USB Camera"

	config USB_CAMERA
		depends on USBH_UVC
		bool "Enable USB Camera"
		default y
		help
			Enable USB Camera

	config UVC_CHECK_BULK_JPEG_HEADER
		depends on USB_CAMERA
		bool "Check JPEG (ff d8) header in bulk payload"
		default y

	config UVC_URB_NUM
		int "UVC URB count"
		range 0 64
		default 8
		help
			URB number advice large than camera_num * 4

	config UVC_NUM_PACKET_PER_URB
		int "The packets per urb contain"
		range 0 32
		default 8
		help
			because high speed 125us generate a packet

endmenu
```

## t5_os/ap/components/bk_websocket/Kconfig
```kconfig
menu "Bk_websocket"

	config WEBSOCKET
		bool "Enable Websocket"
		default n
	config WEBSOCKET_TLS
		depends on PSA_MBEDTLS
		bool "Enable Websocket"
		default n
endmenu
```

## t5_os/ap/components/bk_wifi_driver/Kconfig
```kconfig
#TODO optimize it
menu "WiFi Driver"
	config WIFI_VNET_CONTROLLER
		bool "Enable Wifi WIFI_VNET_CONTROLLER"
		default n
	config CONTROLLER_RX_DIRECT_PSH
		bool "Controller RX Buf Directly push to AP"
		default y
	config CONTROLLER_DEBUG
		bool "Controller Debug"
		default n
endmenu
```

## t5_os/ap/components/display_service/Kconfig
```kconfig
menu "Display Service"

	config MEDIA_DISPLAY_SERVICE
		depends on MEDIA
		bool "Enable Display Service"
		default y

	config LCD_SPI_DISPLAY
		depends on SPI
		bool "Enable LCD SPI Display"
		default y

	config LCD_QSPI_DISPLAY
		depends on LCD_QSPI
		bool "Enable LCD QSPI Display"
		default y

	config LCD_EXAMPLE
		depends on SPI
		bool "Enable LCD SPI Display"
		default n
endmenu
```

## t5_os/ap/components/multimedia/Kconfig
```kconfig
menu "Media"

	config MEDIA
		bool "Enable Media"
		default n
		help
			Enable media service

	config MEDIA_MAJOR
		bool "Enable Media"
		default n

	config MEDIA_APP
		bool "Enable Media"
		default n

	config MEDIA_MINOR
		bool "Enable Media"
		default n

	config WIFI_TRANSFER
		depends on MEDIA
		bool "Enable Wifi Transfer"
		default n

	config LCD_FLASH_JPEG_DISPLAY
		depends on LCD
		bool "Enable Lcd Flash Jpeg Display"
		default n
		help
			enable lcd display flash img

	config LCD_DMA2D_BLEND
		depends on DMA2D
		bool "Enable Lcd Dma2d Blend Flash Img"
		default n
		help
			enable lcd dma2d blend flash logo

	config BLEND_USE_GUI
		depends on LCD
		bool "Enable Blend Use Gui"
		default n
		help
			enable lcd dma2d blend from gui

	config BLEND_GUI_OUTPUT_888
		depends on LCD
		bool "Enable Blend Gui Output 888"
		default n
		help
			enable lcd dma2d blend from gui, gui data is rgb888

	config LCD_FONT_BLEND
		depends on LCD
		bool "Enable Lcd Font Blend"
		default n
		help
			enable lcd blend by font logo

	config IMAGE_STORAGE
		depends on MEDIA
		bool "enable image storage function"
		default n
		help
			enable image save and read image

	config EXTENTED_PSRAM_LAYOUT
		bool "Externally controlling the PSRAM range of the framebuffer"
		default n
		help
			extern external fb_layout variable

	config TRANS_APP_TASK_SIZE
		int "Set transfer app task size"
		default 1024

	config LCD_ROTATE
		depends on LCD
		bool "Enable Lcd rotate function"
		default n

	config LCD_HW_PFC
		depends on LCD
		bool "Enable Lcd hw pixel convert"
		default n

	config LCD_HW_DECODE
		depends on LCD
		bool "Enable Lcd hw decode"
		default n

	config SW_ROTATE_TO_YUYV_AND_DMA2D_TO_YUYV_NOT_RGB888
		depends on LCD
		bool "Enable Lcd hw decode"
		default n

	config LCD_SW_DECODE
		depends on LCD
		bool "Enable Lcd sw decode"
		default n

	config LCD_AUTO_FILL_FULL
		depends on LCD
		bool "Enable Lcd sw decode"
		default n

	config MEDIA_SCALE
		depends on LCD
		bool "Enable Lcd scale"
		default n

	config MEDIA_PIPELINE
		depends on LCD
		bool "Enable Lcd scale"
		default n

	config MEDIA_BT_AUDIO
		bool "BT USE AUDIO Module"
		default n
		help
			BT Module Will Use AUDIO Module

	config SOFTWARE_DECODE_SRAM_MAPPING
		bool "Enable Software Decode Sram Mapping"
		default n

	config MEDIA_PSRAM_SIZE_4M
		bool "The PSRAM used by the media is within 4M."
			default n

	config CLI_MEDIA
		bool "enable audio asr"
		default n

	config JPEG_SW_DECODE_SUPPORT_BY_FRAME
		bool "Enable JPEG software decode by frame"
		default y

	config JPEG_SW_DECODE_SUPPORT_BY_LINE
		bool "Enable JPEG software decode by line"
		default y

endmenu
```

## t5_os/ap/middleware/driver/flash/Kconfig
```kconfig
menu "FLASH"
	config FLASH
		bool "Enable flash"
		default y

	config FLASH_QUAD_ENABLE
		bool "Enable flash quad enable"
		default n

	config FLASH_SRC_CLK_60M
		bool "Enable flash source clock 60M"
		default n

	config FLASH_MB
		bool "Enable flash mailbox channel"
		depends on MAILBOX
		default n

	config FLASH_TEST
		depends on FLASH
		bool "Enable flash test"
		default y

	config PARTITION_TEST
		depends on FLASH
		bool "Enable pattition test"
		default y

	config FLASH_API_TEST
		depends on FLASH
		bool "Enable flash_api test"
		default n

	config FLASH_WRITE_STATUS_VOLATILE
		bool "Enable write volatile status register"
		default n

	config FLASH_PARTITION_CHECK_VALID
		depends on FLASH
		bool "Enable flash driver check write permission and address range"
		default y

	config FLASH_CLK_120M
		depends on FLASH
		bool "Enable flash clk using 120M"
		default n

	config FLASH_BYPASS_OTP_OPERATION
		bool "Bypass flash to operate otp in flash"
		default n
endmenu
```

## t5_os/ap/middleware/driver/spi/Kconfig
```kconfig
menu "SPI"
	#TODO optimize SPI_DMA and GENERAL_DMA when optimize driver
	config SPI_DMA
		bool "Enable SPI DMA"
		default y

	config SPI_STATIS
		bool "Enable SPI Statis"
		default n
			
	config SPI_SUPPORT_TX_FIFO_WR_READY
		bool "Support TX FIFO Write Ready"
		default y

	config SPI_MST_FLASH
		bool "SPI Flash"
		depends on SPI
		default n
		help
			BEKEN Chip sets SPI interface as a master device, the slave device is a flash,
			then BEKEN Chip can access the flash with SPI interface.
			The application can read/writes data to flash directly by SPI Flash API,
			or reads/writes by file system API if enable relates macro, I.E. CONFIG_FATFS, CONFIG_LITTLEFS, CONFIG_VFS...

	config SPI_PM_CB_SUPPORT
		bool "SPI PM Support"
		default n
	config SPI
		bool "SPI ENABLE"
		default n

	config SPI_BYTE_INTERVAL
		bool "SPI byte interval"
		default n

endmenu
```
