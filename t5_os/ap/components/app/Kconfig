## t5_os/ap/components/app/Kconfig
```kconfig
menu "App"

	config DEMO_TEST
		bool "Enable Demo Test"
		default n

	#TODO does UPGRADE here means OTA?
	config FTPD_UPGRADE
		bool "Enable Ftpd Upgrade"
		default n

	config OTA_HTTP
		bool "Enable Ota Http"
		default y if NO_HOSTED
		default n if !NO_HOSTED

	#TODO what's the relationship between HTTP and TFTP OTA, exculsive?
	config OTA_TFTP
		bool "Enable Ota Tftp"
		default n

	config NTP_SYNC_RTC
		depends on AON_RTC
		bool "Enable Ntp Sync Rtc"
		default n

	config SECURITY_OTA
		bool "Enable Seucirty Ota API"
		default n

	config NTP_SYNC_RTC_TASK_STACK_SIZE
		int "Set NTP Sync Task Stack Size"
		default 3072
		help
			Stack size of NTP Sync task

	config FTP_SERVER
		bool "Enable FTP server"
		default n
endmenu
```

## t5_os/ap/components/audio_algorithm/aud_ns/Kconfig
```kconfig
menu "Demos::Media::Audio::Aud_ns"
	config AUDIO_NS_TEST
		depends on FATFS
		bool "Enable Audio Ns Test"
		default n
		help
			Enable AUDIO Noise Suppression Test
endmenu
```

## t5_os/ap/components/audio_codec/aac_decode/Kconfig
```kconfig
config AUDIO_AACDEC_TEST
	#depends on FATFS
	bool "Enable Audio AacDec Test"
	default n
```

## t5_os/ap/components/audio_codec/aac_encode_demo/Kconfig
```kconfig
menu "Audio_codec::AAC_encode_demo"
	config AAC_ENCODE_TEST
		depends on FATFS
		bool "Enable AAC Encode Test"
		default n
endmenu
```

## t5_os/ap/components/audio_codec/flac/Kconfig
```kconfig
menu "Demos::Media::Audio::Flac"
	config AUDIO_FLAC_TEST
		depends on FATFS
		bool "Enable Audio Flac Test"
		default n
		help
			Enable Audio FLAC Encoder and Decoder Test
endmenu
```

## t5_os/ap/components/audio_codec/mp3/Kconfig
```kconfig
menu "Demos::Media::Audio::Mp3"
	config AUDIO_MP3_TEST
		depends on AUDIO_DAC
		depends on FATFS
		bool "Enable Audio MP3 Test"
		default n
endmenu
```

## t5_os/ap/components/audio_codec/opus/Kconfig
```kconfig
menu "Demos::Media::Audio::Opus"
	config AUDIO_OPUS_TEST
		depends on FATFS
		bool "Enable Audio Opus Test"
		default n
endmenu
```

## t5_os/ap/components/audio_play/Kconfig
```kconfig
menu "Audio Play"

	config AUDIO_PLAY
		depends on AUDIO_DAC
		bool "Enable Audio Play"
		default n

endmenu
```

## t5_os/ap/components/audio_record/Kconfig
```kconfig
menu "Audio Record"

	config AUDIO_RECORD
		depends on AUDIO_ADC
		bool "Enable Audio Record"
		default n

endmenu
```

## t5_os/ap/components/bk_aud_param_ctrl/Kconfig
```kconfig
menu "Audio Parameters"

	config AUD_PARAM_CTRL
		bool "Enable audio tool debug audio parameters"
		default y

endmenu
```

## t5_os/ap/components/bk_event/Kconfig
```kconfig
config EVENT_TASK_STACK_SIZE
    int "Set Event Task Stack Size"
    default 3072
    help
        Stack size of Event task
```

## t5_os/ap/components/bk_modem/Kconfig
```kconfig
#TODO add depens 
menu "Mcu_4g_modem"
	config BK_MODEM
	bool "Enable Beken Modem"
	default n

endmenu
```

## t5_os/ap/components/bk_netif/Kconfig
```kconfig
menu "Bk_netif"

	config BK_NETIF
		bool "Enable Bk Netif" 
		default y

	config NETIF_LWIP
		depends on BK_NETIF
		bool "Netif use LWIP"
		default y
endmenu
```

## t5_os/ap/components/bk_peripheral/Kconfig
```kconfig
menu "bk peripheral"
	source "${ARMINO_AP_DIR}/components/bk_peripheral/src/lcd/rgb/Kconfig"
	source "${ARMINO_AP_DIR}/components/bk_peripheral/src/lcd/mcu/Kconfig"
	source "${ARMINO_AP_DIR}/components/bk_peripheral/src/lcd/qspi/Kconfig"
	source "${ARMINO_AP_DIR}/components/bk_peripheral/src/lcd/spi/Kconfig"
	source "${ARMINO_AP_DIR}/components/bk_peripheral/src/dvp/Kconfig"
	source "${ARMINO_AP_DIR}/components/bk_peripheral/src/tp/Kconfig" 
endmenu
```

## t5_os/ap/components/bk_peripheral/src/lcd/rgb/Kconfig
```kconfig
menu "RGB LCD"

	config LCD_GC9503V
		depends on LCD
		bool "Enable LCD_GC9503V API"
		default n

	config LCD_H050IWV
		depends on LCD
		bool "Enable LCD_H050IWV API"
		default n

	config LCD_HX8282
		depends on LCD
		bool "Enable LCD_HX8282 API"
		default n

	config LCD_MD0430R
		depends on LCD
		bool "Enable LCD_MD0430R API"
		default n

	config LCD_MD0700R
		depends on LCD
		bool "Enable LCD_MD0700R API"
		default n

	config LCD_NT35512
		depends on LCD
		bool "Enable LCD_NT35512 API"
		default n

	config LCD_NT35510
		depends on LCD
		bool "Enable LCD_NT35510 API"
		default n

	config LCD_ST7282
		depends on LCD
		bool "Enable LCD_ST7282 API"
		default n

	config LCD_ST7701S_LY
		depends on LCD
		bool "Enable LCD_ST7701S_LY API"
		default n

	config LCD_ST7701S
		depends on LCD
		bool "Enable LCD_ST7701S API"
		default n
   
	config LCD_ST7701SN
		depends on LCD
		bool "Enable LCD_ST7701SN API"
		default n

	config LCD_AML01
		depends on LCD
		bool "Enable LCD_AML01 API"
		default n

endmenu
```

## t5_os/ap/components/bk_peripheral/src/lcd/spi/Kconfig
```kconfig
menu "SPI LCD"

	config LCD_SPI_ST7796U
		bool "Enable LCD_SPI_ST7796U"
		default n

endmenu
```

## t5_os/ap/components/bk_peripheral/src/tp/Kconfig
```kconfig
menu "TP"
	config TP_GT911
		depends on TP
		bool "Enable TP_GT911 API"
		default n

	config TP_GT1151
		depends on TP
		bool "Enable TP_GT1151 API"
		default n

	config TP_FT6336
		depends on TP
		bool "Enable TP_FT6336 API"
		default n

	config TP_HY4633
		depends on TP
		bool "Enable TP_HY4633 API"
		default n

	config TP_CST816D
		depends on TP
		bool "Enable TP_CST816D API"
		default n
endmenu
```

## t5_os/ap/components/bk_pm/Kconfig
```kconfig
menu "PM"
	config PM_ENABLE
		bool "pm enable"
		default n

	config PM_SUPER_DEEP_SLEEP
		bool "Enable super deep sleep"
		default n
	config PM_LV_TIME_COST_DEBUG
		bool "Enable low voltage sleep time cost debug"
		default n
endmenu
```

## t5_os/ap/components/bk_thirdparty/asr/wanson/Kconfig
```kconfig
menu "Bk_thirdparty::Wanson"

	config WANSON_ASR
		bool "Enable Wanson ASR"
		default n
		help
			Enable Wanson Automatic Speech Recognition

    config WANSON_NEW_LIB_SEG
        depends on WANSON_ASR
        bool "WANSON_NEW_LIB_SEG"
        default y
    
    config WANSON_SIMD
        #depends on SYS_CPU2
        bool "WANSON_SIMD"
        default n
        

endmenu
```

## t5_os/ap/components/bk_uid/Kconfig
```kconfig
menu "bk_uid"

	config GET_UID_ENABLE
		bool "Enable get UID"
		default n
	
	config GET_UID_TEST
		depends on GET_UID_ENABLE
		bool "Enable get UID test"
		default n
endmenu
```

## t5_os/ap/components/bk_vfs/Kconfig
```kconfig
menu "Bk_vfs"
	config VFS
		bool "Enable Vfs"
		depends on LITTLEFS || FATFS
		default n
		help
			Virtual file system, it provides posix file system API for applications to access files.
			The lower layer file system can be littlefs, fatfs.
			The memory devices can be internal flash, spi-flash, qspi-flash, sd-card, udisk...
			of cause, the hardware(board) should have relate memory devices.

	config VFS_MAX_FD_NUM
			int "bk vfs max file fd num"
			default 20
			help
				bk vfs max file fd num
endmenu
```

## t5_os/ap/components/bk_voice_service/Kconfig
```kconfig
menu "Voice Service"

	config VOICE_SERVICE
		bool "Enable Voice Service"
		depends on ADK && ADK_RAW_STREAM && (ADK_ONBOARD_MIC_STREAM || ADK_ONBOARD_DUAL_DMIC_MIC_STREAM) && ADK_ONBOARD_SPEAKER_STREAM && ADK_G711_ENCODER && ADK_G711_DECODER && (ADK_AEC_ALGORITHM || ADK_AEC_V3_ALGORITHM)
		default n
		help
			Enable Voice Service Interface API used for voice call
	
	choice VOICE_SERVICE_USE_MEMORY
		depends on VOICE_SERVICE
		prompt "Select voice service use memory"
		default VOICE_SERVICE_USE_SRAM

		config VOICE_SERVICE_USE_SRAM
			bool "Enable voice service use sram"
			help
				Voice service use sram memory

		config VOICE_SERVICE_USE_PSRAM
			depends on PSRAM
			bool "Enable Voice service use psram"
			help
				Voice service use psram memory
	endchoice

	config VOICE_READ_SERVICE
		depends on VOICE_SERVICE 
		bool "Enable Voice Read Service"
		default n
		help
			Enable Voice Service to read voice service mic data

	config VOICE_WRITE_SERVICE
		depends on VOICE_SERVICE 
		bool "Enable Voice Write Service"
		default n
		help
			Enable Voice Service to write voice service speaker data

	config VOICE_SERVICE_TEST
		depends on VOICE_READ_SERVICE && VOICE_WRITE_SERVICE
		bool "Enable Voice Service Test"
		default n
		help
			Enable Voice Service test to test voice service by cli command

	config VOICE_SERVICE_AAC_ENCODER
		depends on ADK_AAC_ENCODER
		bool "Enable Voice Service Support AAC Encoder"
		default n

	config VOICE_SERVICE_AAC_DECODER
		depends on ADK_AAC_DECODER
		bool "Enable Voice Service Support AAC Decoder"
		default n

	config VOICE_SERVICE_G722_ENCODER
		depends on ADK_G722_ENCODER
		bool "Enable Voice Service Support G722 Encoder"
		default n

	config VOICE_SERVICE_G722_DECODER
		depends on ADK_G722_DECODER
		bool "Enable Voice Service Support G722 Decoder"
		default n

	config VOICE_SERVICE_EQ
		depends on ADK_EQ_ALGORITHM
		bool "Enable Voice Service Support EQ"
		default n

	config VOICE_SERVICE_OPUS_ENCODER
		depends on ADK_OPUS_ENCODER
		bool "Enable Voice Service Support Opus Encoder"
		default n

	config VOICE_SERVICE_OPUS_DECODER
		depends on ADK_OPUS_DECODER
		bool "Enable Voice Service Support Opus Decoder"
		default n
endmenu
```

## t5_os/ap/components/codec/image_convert/Kconfig
```kconfig
menu "CODEC"

	config VIDEO_DTCM
		bool "video data in dtcm"
		default n
		help
			video data in dtcm

	config VIDEO_ITCM
		bool "video funcs in itcm"
		default n
		help
			video funcs in itcm

	config VIDEO_DTCM_ALL
		bool "video data in dtcm"
		default n
		help
			all video data in dtcm
endmenu
```

## t5_os/ap/components/fatfs/Kconfig
```kconfig
menu "FATFS"
	config FATFS
		bool "Support FATFS"
		depends on FATFS_SDCARD || FATFS_SPI_0_FLASH || FATFS_SPI_1_FLASH || FATFS_QSPI_0_FLASH || FATFS_QSPI_1_FLASH
		default n

	config FATFS_SDCARD
		bool "Support FATFS with SDCARD"
		depends on SDCARD
		default n
		help
			BEKEN Chip sets SDIO as a master device, the slave device is a SDCARD/SD-NAND.
			The SDCARD/SD-NAND memory device is mounted with FATFS.
			The application can read/writes data to SDCARD/SD-NAND by FATFS file system API, or the upper layer of VFS posix API.

	config FATFS_SPI_0_FLASH
		bool "Support FATFS with SPI-0 FLASH"
		depends on SPI_MST_FLASH
		default n
		help
			BEKEN Chip sets SPI-0 as master device, the slave device is a flash.
			The flash device is mounted with FATFS.
			The application can read/writes data to flash by FATFS file system API, or the upper layer of VFS posix API.

	config FATFS_SPI_1_FLASH
		bool "Support FATFS with SPI-1 FLASH"
		depends on SPI_MST_FLASH
		default n
		help
			BEKEN Chip sets SPI-1 as master device, the slave device is a flash.
			The flash memory device is mounted with FATFS.
			The application can read/writes data to flash by FATFS file system API, or the upper layer of VFS posix API.

	config FATFS_QSPI_0_FLASH
		bool "Support FATFS with QSPI-0 FLASH"
		depends on QSPI_MST_FLASH
		default n
		help
			BEKEN Chip sets QSPI-0 as master device, the slave device is a flash.
			The flash device is mounted with FATFS.
			The application can read/writes data to flash by FATFS file system API, or the upper layer of VFS posix API.

	config FATFS_QSPI_1_FLASH
		bool "Support FATFS with QSPI-1 FLASH"
		depends on QSPI_MST_FLASH
		default n
		help
			BEKEN Chip sets QSPI-1 as master device, the slave device is a flash.
			The flash device is mounted with FATFS.
			The application can read/writes data to flash by FATFS file system API, or the upper layer of VFS posix API.
endmenu
```

## t5_os/ap/components/http/Kconfig
```kconfig
menu "Http"
	depends on LWIP_V2_1
	config HTTP
		bool "Enable Http"
		default y

	config HTTP_OTA_WITH_BLE
		bool "Enable Http Ota With Ble"
		default n

	config LITE_LOG_ENABLED
		bool "Enable Lite Log Enable"
		default n
		help
			Enable http log
		
endmenu
```
