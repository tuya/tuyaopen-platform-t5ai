## t5_os/cp/middleware/driver/can/Kconfig
```kconfig
menu "CAN"
	config CAN
		bool "Enable CAN"
		default n
	config CAN_PM_CB_SUPPORT
		bool "CAN pm callback support"
		depends on CAN
		default n
	config CAN_TEST
		depends on CAN
		bool "Enable can test"
		default n
	config CAN_DEMO
		depends on CAN
		bool "Enable can demo"
		default n
endmenu
```

## t5_os/cp/middleware/driver/mailbox/Kconfig
```kconfig
menu "MAILBOX"
	config MAILBOX
		bool "Enable mail_box"
		default n

	config MAILBOX_V2_0
		bool "Use mailbox v2.0 driver"
		default n

	config MAILBOX_IPC
		bool "Enable mailbox socket ipc driver"
		default y
    
    config SLAVE_HEART_BEAT
		depends on MAILBOX
		bool "Enable heartbeat mechanism when dual core communication"
		default n
endmenu
```

## t5_os/cp/middleware/driver/otp/Kconfig
```kconfig
menu "OTP"
	config OTP_V1
		bool "Enable OTP_V1"
		default n

	config PHY_RFCALI_TO_OTP
		bool "Enable rfcali_to_otp"
		default n
		help
			Use OTP to save rfcali data

	config AON_ENCP
		bool "Always enable encp"
		default n
endmenu
```

## t5_os/cp/middleware/driver/rtc/Kconfig
```kconfig
menu "AON_RTC"
	config AON_RTC
		bool "Enable AON_RTC"
		default n

	config AON_RTC_64BIT
		bool "Enable AON_RTC_64BIT"
		default n

	config AON_RTC_MANY_USERS
		bool "Enable AON_RTC support many users"
		default n

	config AON_RTC_DEBUG
		bool "Enable AON_RTC Debug"
		default n

	config RTC_ANA_WAKEUP_SUPPORT
		bool "Enable RTC wakeup system from analog channel"
		default n
		help
			This is for super deep sleep

	config AON_RTC_DYNAMIC_CLOCK_SUPPORT
		bool "Enable AON RTC dynamic clock"
		default n

endmenu
```

## t5_os/cp/middleware/soc/Kconfig
```kconfig
menu "SOC_CONFIG"

	choice SOC
		prompt "ARMINO SoC"
		default SOC_BK7258 if "$ARMINO_SOC" = "bk7258"
		default SOC_BK7257 if "$ARMINO_SOC" = "bk7257"

		config SOC_BK7258
			select SOC_BK7236XX
			bool "BK7258"

		config SOC_BK7257
			select SOC_BK7236XX
			bool "BK7257"

	endchoice

	config CPU_CNT
			int "System CPU count: 1: single core, 2: dual core, etc."
			default 1

	config SOC_STR
		string "SoC string"
		default "bk7258_cp"  if SOC_BK7258
		default "bk7257_cp"  if SOC_BK7257
		default "$ARMINO_SOC"

	config SOC_ARCH
		string "Soc arch"
		default "unknown"

	config SOC_BK7236XX
		bool "For bk7236 series chipset"
		default n

	config SOC_SMP
		bool "For soc smp feature"
		default n


endmenu
```

## t5_os/cp/middleware/soc/bk7257/Kconfig
```kconfig
menu "bk7257"

	config ITCM_SIZE
		hex "Total ITCM size"
		default 0x4000

	config DTCM_SIZE
		hex "Total DTCM size"
		default 0x4000

	config ANA_REG_WRITE_POLL_REG_B
		bool "Write analog register polls sys reg0xb"
		default y

	config PM_HAL_DEBUG
		bool "Enable PM hal debug"
		default n

	config PM_HAL_CTRL
		bool "Enable PM hal debug"
		default n

        config TZ
                bool "Supported TrustZone"
                default y

        config SPE
                int "Enable SPE"
                default 0

	config RX_OPTIMIZE
		bool "Optimize rx current"
		default n

	config BT_REUSE_MEDIA_MEMORY
		bool "BT reuse media memory at beging of cpu1"
		default n

endmenu
```

## t5_os/projects/bluetooth/headset/ap/Kconfig.projbuild
```kconfig
menu "Headset Example Configuration"

    config A2DP_SINK_DEMO
        bool "a2dp sink demo"
        depends on BT
        default y

    config HFP_HF_DEMO
        bool "hfp hf demo"
        depends on BT
        default n
endmenu
```

## t5_os/projects/lvgl/86box_smart_panel/main/Kconfig.projbuild
```kconfig
menu "LVGL 86box Smart Panel Configuration"
    config LV_USE_DEMO_86BOX
        bool "LVGL 86Box"
        default n

	choice 86BOX_SMART_PANEL_VERSION
		prompt "Select 86box Smart Panel Language Version"
		default 86BOX_SMART_PANEL_VERSION_CN

		config 86BOX_SMART_PANEL_VERSION_CN
			bool "Select Chinese Version"
			help
				Select Chinese Version

		config 86BOX_SMART_PANEL_VERSION_EN
			bool "Select English Version"
			help
				Select English Version
	endchoice

endmenu
```

## t5_os/projects/lvgl/camera/main/Kconfig.projbuild
```kconfig
menu "LVGL Meter Configuration"

    config INTEGRATION_DOORBELL
        bool "Doorbell integration"
        default n

    config INTEGRATION_DOORBELL_CS2
        bool "Doorbell integration CS2"
        default n

    config LV_USE_DEMO_METER
        bool "LVGL Meter"
        default n
		
    config VFS_DEMO_USE_FATFS
        bool "use fatfs of sdcard for lvgl image show"
        default n
		
    config VFS_DEMO_USE_LITTLEFS
        bool "use littlefs for lvgl image show"
        default n

	config LVGL_DEMO
		bool "Enable Lvgl Demo"
		default n
endmenu
```

## t5_os/projects/media/av_server/main/Kconfig.projbuild
```kconfig
menu "INTEGRATION_DOORBELL"

    config INTEGRATION_DOORBELL
        bool "Doorbell integration"
        default n
    config INTEGRATION_DOORBELL_CS2
        bool "Doorbell integration CS2"
        default n
    config AV_DEMO_MODE_TCP
        bool "AV DEMO TCP MODE"
        default n
endmenu
```
