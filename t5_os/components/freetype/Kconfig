## t5_os/components/media/Kconfig
```kconfig
menu "Media"

	config MEDIA
		depends on DVP_CAMERA || USB_UVC || LCD
		bool "Enable Media"
		default n
		help
			Enable media service
	config WIFI_TRANSFER
		depends on MEDIA && WIFI_ENABLE
		bool "Enable Wifi Transfer"
		default n
	config LCD_FLASH_JPEG_DISPLAY
		depends on LCD
		bool "Enable Lcd Flash Jpeg Display"
		default n
		help
			enable lcd display flash img
	config LCD_DMA2D_BLEND
		depends on DMA2D
		bool "Enable Lcd Dma2d Blend Flash Img"
		default n
		help
			enable lcd dma2d blend flash logo
	config BLEND_USE_GUI
		depends on LCD
		bool "Enable Blend Use Gui"
		default n
		help
			enable lcd dma2d blend from gui
	config BLEND_GUI_OUTPUT_888
		depends on LCD
		bool "Enable Blend Gui Output 888"
		default n
		help
			enable lcd dma2d blend from gui, gui data is rgb888
	config LCD_FONT_BLEND
		depends on LCD
		bool "Enable Lcd Font Blend"
		default n
		help
			enable lcd blend by font logo
	config FACE_DETECTION
		bool "Enable Face Detection"
		default n

	config IMAGE_STORAGE
		depends on MEDIA
		bool "enable image storage function"
		default n
		help
			enable image save and read image

	config EXTENTED_PSRAM_LAYOUT
		bool "Externally controlling the PSRAM range of the framebuffer"
		default n
		help
			extern external fb_layout variable

    config TRANSFER_TASK_STACK_SIZE
        int "transfer_task stack size"
        default 1536

    config MEDIA_MAJOR_THREAD_STACK_SIZE
        int "media_major_thread stack size"
        default 3584

		config LCD_MEDIA
		depends on LCD
		bool "Enable Lcd rotate function"
		default n
		
		config LCD_ROTATE
		depends on LCD_MEDIA
		bool "Enable Lcd rotate function"
		default n

	config LCD_HW_PFC
		depends on LCD_MEDIA
		bool "Enable Lcd hw pixel convert"
		default n

	config LCD_HW_DECODE
		depends on LCD_MEDIA
		bool "Enable Lcd hw decode"
		default n

	config LCD_SW_DECODE
		depends on LCD_MEDIA
		bool "Enable Lcd sw decode"
		default n
endmenu
```

## t5_os/components/media_unit_test/Kconfig
```kconfig
menu "Media Unit Test"

	config MEDIA_UNIT_TEST
		bool "Enable Media Unit Test"
		default y
		help
			Enable Media Unit Test
endmenu
```

## t5_os/components/media_utils/Kconfig
```kconfig
menu "Media Utils"

	config MEDIA_IPC
		depends on MAILBOX
		bool "Enable Media"
		default y
		help
			Enable media ipc

	config PSRAM_MEM_SLAB_USER_SIZE
		depends on PSRAM
		int "size of psram user need to use"
		default 102400

	config PSRAM_MEM_SLAB_AUDIO_SIZE
		depends on PSRAM
		int "size of psram audio need to use"
		default 102400

	config PSRAM_MEM_SLAB_ENCODE_SIZE
		depends on PSRAM
		int "size of psram encode function need to use"
		default 1433600

	config PSRAM_MEM_SLAB_DISPLAY_SIZE
		depends on PSRAM
		int "size of psram display need to use"
		default 5701632
endmenu
```

## t5_os/components/multimedia/Kconfig
```kconfig
menu "Media"

	config MEDIA
		bool "Enable Media"
		default n
		help
			Enable media service

	config MEDIA_MAJOR
		bool "Enable Media"
		default n

	config MEDIA_APP
		bool "Enable Media"
		default n

	config MEDIA_MINOR
		bool "Enable Media"
		default n

	config MEDIA_UI_TASK_STACK_SIZE
		int "Set media ui task stack size"
		default 2048

	config WIFI_TRANSFER
		depends on MEDIA
		bool "Enable Wifi Transfer"
		default n

	config USB_TRANSFER
		depends on MEDIA
		bool "Enable usb Transfer"
		default n

	config LCD_FLASH_JPEG_DISPLAY
		depends on LCD
		bool "Enable Lcd Flash Jpeg Display"
		default n
		help
			enable lcd display flash img

	config LCD_DMA2D_BLEND
		depends on DMA2D
		bool "Enable Lcd Dma2d Blend Flash Img"
		default n
		help
			enable lcd dma2d blend flash logo

	config BLEND_USE_GUI
		depends on LCD
		bool "Enable Blend Use Gui"
		default n
		help
			enable lcd dma2d blend from gui

	config BLEND_GUI_OUTPUT_888
		depends on LCD
		bool "Enable Blend Gui Output 888"
		default n
		help
			enable lcd dma2d blend from gui, gui data is rgb888

	config LCD_FONT_BLEND
		depends on LCD
		bool "Enable Lcd Font Blend"
		default n
		help
			enable lcd blend by font logo

	config IMAGE_STORAGE
		depends on MEDIA
		bool "enable image storage function"
		default n
		help
			enable image save and read image

	config JPEG_YUV_MIX
		depends on DVP_CAMERA
		bool "enable jpeg module for jpeg and yuv mix mode"
		default n
		help
			enable jpeg work method: encode and yuv by turns

	config EXTENTED_PSRAM_LAYOUT
		bool "Externally controlling the PSRAM range of the framebuffer"
		default n
		help
			extern external fb_layout variable

	config TRANS_APP_TASK_SIZE
		int "Set transfer app task size"
		default 1024

	config LCD_ROTATE
		depends on LCD
		bool "Enable Lcd rotate function"
		default n

	config LCD_HW_PFC
		depends on LCD
		bool "Enable Lcd hw pixel convert"
		default n

	config LCD_HW_DECODE
		depends on LCD
		bool "Enable Lcd hw decode"
		default n

	config SW_ROTATE_TO_YUYV_AND_DMA2D_TO_YUYV_NOT_RGB888
		depends on LCD
		bool "Enable Lcd hw decode"
		default n

	config LCD_SW_DECODE
		depends on LCD
		bool "Enable Lcd sw decode"
		default n

	config LCD_AUTO_FILL_FULL
		depends on LCD
		bool "Enable Lcd sw decode"
		default n

	config MEDIA_SCALE
		depends on LCD
		bool "Enable Lcd scale"
		default n

	config MEDIA_PIPELINE
		depends on LCD
		bool "Enable Lcd scale"
		default n

	config AUD_INTF_TEST
		bool "Enable Aud intf test"
		default n

	choice AUD_TRAS_USE_MEMORY
		prompt "Select AUD TRAS use memory"
		default AUD_TRAS_USE_PSRAM

		config AUD_TRAS_USE_SRAM
		bool "Enable AUD TRAS use sram"
		help
			AUD TRAS use sram memory

		config AUD_TRAS_USE_PSRAM
		bool "Enable AUD TRAS use psram"
		help
			AUD TRAS use psram memory
	endchoice

	config AUD_TRAS_DAC_PA_CTRL
		depends on AUDIO_DAC
		bool "Enable Aud Tras Dac Pa Ctrl"
		default n
		help
			Audio Transfer DAC PA Control Enable

	config AUD_RING_BUFF_SAFE_INTERVAL
		int "Set Aud Ring Buff Safe Interval"
		range 0 320
		default 0
		help
			Audio ring buff safe interval

    config MEDIA_BT_AUDIO
		bool "BT USE AUDIO Module"
		default n
		help
			BT Module Will Use AUDIO Module

    config SOFTWARE_DECODE_SRAM_MAPPING
        bool "Enable Software Decode Sram Mapping"
		default n
endmenu
```

## t5_os/components/wifi_transfer/Kconfig
```kconfig
menu "Wifi Transfer"

	config MEDIA_DROP_STRATEGY_ENABLE
		bool "Enable Media Drop Strategy"
		default n
		help
			Enable media drop strategy
endmenu
```

## t5_os/cp/components/bk_bluetooth/mesh/Kconfig
```kconfig
menu "BK_MESH"
	depends on BLUETOOTH

	config BLE_MESH_ZEPHYR
        bool "Enable mesh"
		default n
        select BTDM_CONTROLLER_ONLY

    config BT_MESH_ADV_LEGACY
        depends on BLE_MESH_ZEPHYR
        bool "enable BT_MESH_ADV_LEGACY"
        default n

    config BT_MESH_ADV_EXT
        depends on BLE_MESH_ZEPHYR
        bool "enable BT_MESH_ADV_EXT"
        default y

    config BT_MESH_SETTINGS
        depends on BLE_MESH_ZEPHYR
        bool "enable BT_SETTINGS"
        default n

    config BT_MESH_LOW_POWER
        depends on BLE_MESH_ZEPHYR
        bool "enable BT_MESH_LOW_POWER"
        default y

    config BT_MESH_FRIEND
        depends on BLE_MESH_ZEPHYR
        bool "enable BT_MESH_FRIEND"
        default y

    config BT_MESH_PROV
        depends on BLE_MESH_ZEPHYR
        bool "enable BT_MESH_PROV"
        default y

    config BT_MESH_GATT_PROXY
        depends on BLE_MESH_ZEPHYR
        bool "enable BT_MESH_GATT_PROXY"
        default y

    config BT_MESH_PROV_DEVICE
        depends on BLE_MESH_ZEPHYR
        bool "enable BT_MESH_PROV_DEVICE"
        default y

    config BT_MESH_PROVISIONER
        depends on BLE_MESH_ZEPHYR
        bool "enable BT_MESH_PROVISIONER"
        default y

    config BT_MESH_PB_ADV
        depends on BLE_MESH_ZEPHYR
        bool "enable BT_MESH_PB_ADV"
        default y

    config BT_MESH_PB_GATT
        depends on BLE_MESH_ZEPHYR
        bool "enable BT_MESH_PB_GATT"
        default y

    config BT_MESH_GATT_SERVER
        depends on BLE_MESH_ZEPHYR
        bool "enable BT_MESH_GATT_SERVER"
        default y

    config BT_MESH_GATT
        depends on BLE_MESH_ZEPHYR
        bool "enable BT_MESH_GATT"
        default y

    config BT_MESH_CFG_CLI
        depends on BLE_MESH_ZEPHYR
        bool "enable BT_MESH_CFG_CLI"
        default y

    config BT_MESH_HEALTH_CLI
        depends on BLE_MESH_ZEPHYR
        bool "enable BT_MESH_HEALTH_CLI"
        default y

    config BT_MESH_SELF_TEST
        depends on BLE_MESH_ZEPHYR
        bool "enable BT_MESH_SELF_TEST"
        default y

    config BT_MESH_SHELL
        depends on BLE_MESH_ZEPHYR
        bool "enable BT_MESH_SHELL"
        default y

    config BT_MESH_CDB
        depends on BLE_MESH_ZEPHYR
        bool "enable BT_MESH_CDB"
        default y

    config BT_MESH_DEBUG
        depends on BLE_MESH_ZEPHYR
        bool "enable BT_MESH_DEBUG"
        default y

    config BT_MESH_CONN
        depends on BLE_MESH_ZEPHYR
        bool "enable BT_MESH_CONN"
        default y

    config BT_MESH_SMP
        depends on BLE_MESH_ZEPHYR
        bool "enable BT_MESH_SMP"
        default y
    
    config BT_MESH_ISO
        depends on BLE_MESH_ZEPHYR
        bool "enable BT_MESH_ISO"
        default n
    
    config BT_MESH_HOST_CCM
        depends on BLE_MESH_ZEPHYR
        bool "enable BT_MESH_HOST_CCM"
        default y
  
    config ACLSEMI_BT_MESH_DEBUG_LEVEL
        int "set ACLSEMI_BT_MESH_DEBUG_LEVEL"
        default 2
        range 0 5
        help
            Mesh debugging level.

endmenu
```

## t5_os/cp/components/bk_cli/uart_debug/Kconfig
```kconfig
menu "modules::uart_debug"
	config UART_DEBUG
		depends on UART_ATE_PORT
		bool "Enable Uart Debug"
		default n

	config ATE
		bool "Enable ATE"
		default y

	config ATE_TEST
		depends on ATE
		bool "Enable ATE Test"
		default n
endmenu
```

## t5_os/cp/components/bk_netif/Kconfig
```kconfig
menu "Bk_netif"

	config BK_NETIF
		depends on WIFI_ENABLE
		bool "Enable Bk Netif" 
		default y

	config NETIF_LWIP
		depends on BK_NETIF
		bool "Netif use LWIP"
		default y
endmenu
```

## t5_os/cp/components/bk_pm/Kconfig
```kconfig
menu "PM"
	config PM_ENABLE
		bool "pm enable"
		default n

	config PM_SUPER_DEEP_SLEEP
		bool "Enable super deep sleep"
		default n
	config PM_LV_TIME_COST_DEBUG
		bool "Enable low voltage sleep time cost debug"
	config PM_ENTER_LV_TIME_OUT_PERIOD_MS
		int "Enter LV time out"
		default 30000
		help
			enter LV time out time(unit:ms)
	config PM_LV_WDT_PROTECTION
		bool "add protection for hardware enter low voltage fail when application abnormal operate, using wdt to reboot"
		default n
endmenu
```

## t5_os/cp/components/psa_mbedtls/Kconfig
```kconfig
menu "PSA Mbedtls"
	config PSA_MBEDTLS
		bool "Enable psa mbedtls v3.5.2"
		default n
		help
			enable psa mbedtls v3.5.2

	menu "PSA Mbedtls Options"
		depends on PSA_MBEDTLS

		config PSA_MBEDTLS_TEST
			bool "Enable psa interface test"
			default n
			help
				control PSA interface cli testing code

		config MBEDTLS_SSL_IN_CONTENT_LEN
			int "Config MBEDTLS_SSL_IN_CONTENT_LEN"
			default 4096
	
		config MBEDTLS_SSL_OUT_CONTENT_LEN
			int "Config MBEDTLS_SSL_OUT_CONTENT_LEN"
			default 4096
	
		config TE200_ENTROPY
			bool "Enable TE200 entropy"
			default n
	
		config TRUSTENGINE_TEST
			bool "Enable psa mbedtls cli test"
			default n
			help
				control mbedtls cli testing code

		config TRUSTENGINE
			bool "Enable hardware crypto engine"
			default n
			help
				mbedtls is implemented using hardware acceleration trustengine

		config SW_CRYPTO
			bool "Enable software crypto"
			default n
			help
				mbedtls is implemented using pure software

		config MBEDTLS_USE_PSA_CRYPTO
			bool "Enable use PSA crypto"
			default n
			help
				tls use PSA interface to implement encryption

		config FULL_MBEDTLS
			bool "Enable Full Mbedtls"
			default n
			help
				mbedtls support more algorithms(enabled in xxx_config.h)

		config MBEDTLS_LOG_LEVEL
			string "Set Mbedtls Log Level"
			default "INFO"
			help
				Set mbedtls log level: OFF/ERROR/WARNING/INFO/DEBUG
	endmenu

endmenu
```

## t5_os/cp/middleware/arch/cm33/Kconfig
```kconfig
menu "Arch::Cm33"
	config ARCH_CM33
		bool "Enable Cortex-M33"
		default n
	
	menu "Modify Arch Cm33 Config"
		depends on ARCH_CM33

		config FPGA
			bool "Enable FPGA"
			default n

		config MPU
			bool "Enable Memory Protect Unit Feature"
			default n
	
		config CPU_FREQ_HZ
			int "Set Cpu Freq Hz"
			default 120000000
			help
				CPU frequency

		config ARCH_INT_STATIS
			bool "Enable Arch Int Statis"
			default n
			help
				Enable interrupt statis

		config SYSTICK_32K
			bool "Systick use external 32K clock"
			default n
			
		config CACHE_ENABLE
                	depends on MPU
			bool "Enable DCache"
			default n
			help
				Enable DCache

		config HEAP_IN_CACHE
			depends on CACHE_ENABLE
			bool "Enable Heap in Cache"
			default y
			help
				Custom enable heap in Cache

		config SWD_DEBUG_MODE
			bool "Enable SWD Debug Mode"
			default n
			help
				Enable SWD Debug Mode

		config DUMP_ENABLE
			bool "Enable Dump Feature"
			default n
			help
				Dump all memory when exception happen

		config DUMP_UART_PRINT_PORT
			int "Config DumpUart Print Port"
			range 0 2
			default 0
			help
			Default 0 mean use UART0

		config DUMP_TEST
			bool "Enable Dump Test"
			default n
			help
				Enable Dump Test

		config MEMDUMP_ALL
			bool "Enable Memdump All"
			default y
			help
				Dump all memory when exception happen
        
		config INTERRUPT_DEBUG_RECORDER
			bool "Enable interrupt debug"
			default n
			help
				interrupt debug
        
		config INTERRUPT_RECORDER_CNT
			int "Set recorder interrupt count"
			default 40
			help
				interrupt recorder count

	endmenu
endmenu
```

## t5_os/cp/middleware/driver/Kconfig
```kconfig
menu "Driver"
	source "${ARMINO_PATH}/middleware/driver/device/Kconfig"
	source "${ARMINO_PATH}/middleware/driver/wdt/Kconfig"
	source "${ARMINO_PATH}/middleware/driver/aon_wdt/Kconfig"
	source "${ARMINO_PATH}/middleware/driver/uart/Kconfig"
	source "${ARMINO_PATH}/middleware/driver/trng/Kconfig"
	source "${ARMINO_PATH}/middleware/driver/rtc/Kconfig"
	source "${ARMINO_PATH}/middleware/driver/gpio/Kconfig"
	source "${ARMINO_PATH}/middleware/driver/pmu/Kconfig"
	source "${ARMINO_PATH}/middleware/driver/general_dma/Kconfig"
	source "${ARMINO_PATH}/middleware/driver/touch/Kconfig"
	source "${ARMINO_PATH}/middleware/driver/sbc/Kconfig"
	source "${ARMINO_PATH}/middleware/driver/psram/Kconfig"
	source "${ARMINO_PATH}/middleware/driver/calendar/Kconfig"
	source "${ARMINO_PATH}/middleware/driver/sys_ctrl/Kconfig"
	source "${ARMINO_PATH}/middleware/driver/phy/Kconfig"
	source "${ARMINO_PATH}/middleware/driver/i2s/Kconfig"
	source "${ARMINO_PATH}/middleware/driver/icu/Kconfig"
	source "${ARMINO_PATH}/middleware/driver/timer/Kconfig"
	source "${ARMINO_PATH}/middleware/driver/saradc/Kconfig"
	source "${ARMINO_PATH}/middleware/driver/flash/Kconfig"
	source "${ARMINO_PATH}/middleware/driver/sdmadc/Kconfig"
	source "${ARMINO_PATH}/middleware/driver/pwr_clk/Kconfig"
	source "${ARMINO_PATH}/middleware/driver/otp/Kconfig"
	source "${ARMINO_PATH}/middleware/driver/fft/Kconfig"
	source "${ARMINO_PATH}/middleware/driver/irda/Kconfig"
	source "${ARMINO_PATH}/middleware/driver/reset_reason/Kconfig"
	source "${ARMINO_PATH}/middleware/driver/efuse/Kconfig"
	source "${ARMINO_PATH}/middleware/driver/mailbox/Kconfig"
	source "${ARMINO_PATH}/middleware/driver/tp/Kconfig"
	source "${ARMINO_PATH}/middleware/driver/chip_support/Kconfig"
	source "${ARMINO_PATH}/middleware/driver/ckmn/Kconfig"
	source "${ARMINO_PATH}/middleware/driver/lin/Kconfig"
	source "${ARMINO_PATH}/middleware/driver/scr/Kconfig"
	source "${ARMINO_PATH}/middleware/driver/spinlock/Kconfig"
	source "${ARMINO_PATH}/middleware/driver/slcd/Kconfig"
endmenu
```
