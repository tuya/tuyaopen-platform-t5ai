## t5_os/projects/media/doorbell_720p/main/Kconfig.projbuild
```kconfig
menu "INTEGRATION_DOORBELL"

    config INTEGRATION_DOORBELL
        bool "Doorbell integration"
        default n
    config INTEGRATION_DOORBELL_CS2
        bool "Doorbell integration CS2"
        default n
	config SUPPORTED_IMAGE_MAX_720P
		bool "Supported image max 720P"
        default n
endmenu
```

## t5_os/projects/media/dual_device_voice_call/main/Kconfig.projbuild
```kconfig
menu "dual_device_voice_call"

	choice DUAL_DEVOCE_VOICE_CALL_MODE
		prompt "Select dual device voice call Mode"
		default DUAL_DEVOCE_VOICE_CALL_MODE_UDP

		config DUAL_DEVOCE_VOICE_CALL_MODE_UDP
			bool "dual device voice call work in UDP"
			help
				dual device voice call work in UDP

		config DUAL_DEVOCE_VOICE_CALL_MODE_TCP
			bool "dual device voice call work in TCP"
			help
				dual device voice call work in TCP

	endchoice

	choice DUAL_DEVOCE_VOICE_CALL_ROLE
		prompt "Select dual device voice call role"
		default DUAL_DEVOCE_VOICE_CALL_ROLE_STA

		config DUAL_DEVOCE_VOICE_CALL_ROLE_AP
			bool "dual device voice call work role is AP"
			help
				dual device voice call work role is AP

		config DUAL_DEVOCE_VOICE_CALL_ROLE_STA
			bool "dual device voice call work role is station"
			help
				dual device voice call work role is station

	endchoice

endmenu
```

## t5_os/projects/tuya_app/main/Kconfig.projbuild
```kconfig
menu "TUYA_APP"

    config TUYA_APP_PARAM1
        bool "TUYA_APP_PARAM1"
        default n
    config TUYA_APP_PARAM2
        bool "TUYA_APP_PARAM2"
        default n

endmenu
```
